AUTOSAR XML (schema 00047)
package /mb/platform
  adaptive application sw component type x6aa_em_state_client_app_swc_type
  executable x6aa_em_state_client_app: category=APPLICATION_LEVEL
    root sw component prototype x6aa_em_state_client_app_root_swc: application-type=x6aa_em_state_client_app_root_swc_type
