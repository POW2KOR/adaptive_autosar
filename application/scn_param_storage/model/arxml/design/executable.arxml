AUTOSAR XML (schema 00047)
package /mb/Design
  adaptive application sw component type ScnParamStorage
  executable scn_param_storage: category=APPLICATION_LEVEL
    root sw component prototype ScnParamStorageRootSwc: application-type=ScnParamStorage
