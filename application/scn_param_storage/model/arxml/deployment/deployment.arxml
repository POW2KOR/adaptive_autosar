AUTOSAR XML (schema 00047)
package /mb/Deployment
  process scn_param_storage: executable=scn_param_storage, state-dependent-startup-config{function-group-state=MachineState.Running, startup-config=STARTUP_CONFIG_DEFAULT}
  process to machine mapping set MbAppsToMachineMapping
    process to machine mapping ScnParamStorageToMachineMapping: machine=IDC6_M_P1_XAVIER, process=scn_param_storage
