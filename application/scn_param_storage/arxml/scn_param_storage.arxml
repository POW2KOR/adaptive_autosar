AUTOSAR XML (schema 00047)
package /mb
  executable scn_param_storage: category=APPLICATION_LEVEL
  process scn_param_storage_process: executable=scn_param_storage, state-dependent-startup-config{function-group-state=MachineState.Running, startup-config=scn_param_storage_startup_config}
    process state machine PROCESS_STATE_MACHINE: type=MachineStates
  startup config set startup_config_set
    startup config scn_param_storage_startup_config: scheduling-policy=SCHEDULING-POLICY-FIFO, scheduling-priority=32, startup-option{option-argument=./etc/logging_config.json, option-kind=COMMAND-LINE-SHORT-FORM, option-name=l}
  process to machine mapping set adaptive_process_to_machine_mapping_set
    process to machine mapping sw_update_client_minerva_adapter_process_to_machine_mapping: design=scn_param_storage_process_design_to_machine_design_mapping, machine=IDC_M_P, process=scn_param_storage_process
  process design to machine design mapping set adaptive_process_design_to_machine_mapping_set
    process design to machine design mapping scn_param_storage_process_design_to_machine_design_mapping: machine-design=IDC_M_PDesign, process-design=scn_param_storage_process_design
  process design scn_param_storage_process_design: executable=scn_param_storage
