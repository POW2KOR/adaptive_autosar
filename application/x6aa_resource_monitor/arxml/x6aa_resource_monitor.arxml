AUTOSAR XML (schema 00047)
package /mb/Design
  adaptive application sw component type x6aa_resource_monitor_sample
  executable x6aa_resource_monitor: category=APPLICATION_LEVEL
    root sw component prototype x6aa_resource_monitor_sample_root_swc: application-type=x6aa_resource_monitor_sample
