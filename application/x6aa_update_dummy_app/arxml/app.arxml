AUTOSAR XML (schema 00047)
package /mb/platform
  adaptive application sw component type x6aa_update_dummy_app_swc_type
  executable x6aa_update_dummy_v1_app: category=APPLICATION_LEVEL
    root sw component prototype x6aa_update_dummy_app_root_swc: application-type=x6aa_update_dummy_app_swc_type
  executable x6aa_update_dummy_v2_app: category=APPLICATION_LEVEL
    root sw component prototype x6aa_update_dummy_app_root_swc: application-type=x6aa_update_dummy_app_swc_type
  process x6aa_update_dummy_v1: executable=x6aa_update_dummy_v1_app, state-dependent-startup-config{function-group-state=MachineState.Running, startup-config=STARTUP_CONFIG_DEFAULT}
  process x6aa_update_dummy_v2: executable=x6aa_update_dummy_v2_app, state-dependent-startup-config{function-group-state=MachineState.Running, startup-config=STARTUP_CONFIG_DEFAULT}
  process to machine mapping set x6aa_update_dummy_process_to_machine_mapping
    process to machine mapping x6aa_update_dummy_v1_to_machine_mapping: machine=IDC6_M_P1_XAVIER, process=x6aa_update_dummy_v1_app
    process to machine mapping x6aa_update_dummy_v2_to_machine_mapping: machine=IDC6_M_P1_XAVIER, process=x6aa_update_dummy_v2_app
