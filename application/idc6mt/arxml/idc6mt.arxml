AUTOSAR XML (schema 00047)
package /mb/Design
  adaptive application sw component type Idc6MtDaemon
  executable idc6mt: category=APPLICATION_LEVEL
    root sw component prototype Idc6MtDaemonRootSwc: application-type=Idc6MtDaemon
package /mb/Deployment
  process idc6mt: executable=idc6mt, state-dependent-startup-config{function-group-state=MachineState.Running, startup-config=STARTUP_CONFIG_DEFAULT}
  process to machine mapping set MbAppsToMachineMapping
    process to machine mapping Idc6MtdToMachineMapping: machine=IDC6_M_P1_XAVIER, process=idc6mt
