AUTOSAR XML (schema 00047)
package /Application/AdaptiveApplicationSwComponentTypes
  adaptive application sw component type amsr_vector_fs_log_daemon_swc
package /Application/Executables
  executable amsr_vector_fs_log_daemon: category=PLATFORM_LEVEL, version=1.00.00.0000
    root sw component prototype amsr_vector_fs_log_daemon_root_type: application-type=amsr_vector_fs_log_daemon_swc
package /ApplicationDeployment/Processes
  process LogDaemonDefaultProcess: executable=amsr_vector_fs_log_daemon, log-trace-default-log-level=INFO, log-trace-log-mode=CONSOLE, log-trace-process-desc=The Adaptive AUTOSAR Log Daemon, log-trace-process-id=LOGD, state-dependent-startup-config{function-group-state=[MachineState.Startup, MachineState.Shutdown, MachineState.Restart, MachineState.Running], startup-config=STARTUP_CONFIG_RUNNING}
    process state machine amsr_vector_fs_log_daemon_process_mode: type=ApplicationSatates
  process to machine mapping set LogProcessToMachineMapping
    process to machine mapping LogProcToMachineMapping: machine=IDC6_M_P1_XAVIER, non-os-module-instantiation=LogAndTraceInstantiation, process=LogDaemonDefaultProcess
  startup config set log_daemon_startup_config
    startup config STARTUP_CONFIG_RUNNING: scheduling-policy=SCHEDULING-POLICY-FIFO, scheduling-priority=80, startup-option{option-argument=./etc/logging_config.json, option-kind=COMMAND-LINE-SHORT-FORM, option-name=l}
package /DataTypes/ModelManagement
  mode declaration group ApplicationStates
    mode Running: value=0
    mode Terminating: value=1
