AUTOSAR XML (schema 00047)
package /mb
  adaptive application sw component type AdaptiveApplicationSwComponentType
    provide port ProvideSwdlPluginPort: provided-interface=SwdlPlugin
  executable sw_update_client_minerva_adapter_app: category=APPLICATION_LEVEL
    root sw component prototype RootSwComponentPrototype: application-type=AdaptiveApplicationSwComponentType
  process sw_update_client_minerva_adapter_app_process: executable=sw_update_client_minerva_adapter_app, state-dependent-startup-config{function-group-state=MachineState.Running, startup-config=sw_update_client_minerva_adapter_app_startup_config}
    process state machine PROCESS_STATE_MACHINE: type=MachineStates
  startup config set startup_config_set
    startup config sw_update_client_minerva_adapter_app_startup_config: scheduling-policy=SCHEDULING-POLICY-FIFO, scheduling-priority=32, startup-option{option-argument=./etc/logging_config.json, option-kind=COMMAND-LINE-SHORT-FORM, option-name=l}
  process to machine mapping set adaptive_process_to_machine_mapping_set
    process to machine mapping sw_update_client_minerva_adapter_process_to_machine_mapping: design=sw_update_client_minerva_adapter_app_process_design_to_machine_design_mapping, machine=IDC_M_P, process=sw_update_client_minerva_adapter_app_process
  process design to machine design mapping set adaptive_process_design_to_machine_mapping_set
    process design to machine design mapping sw_update_client_minerva_adapter_app_process_design_to_machine_design_mapping: machine-design=IDC_M_PDesign, process-design=sw_update_client_minerva_adapter_app_process_design
  process design sw_update_client_minerva_adapter_app_process_design: executable=sw_update_client_minerva_adapter_app
