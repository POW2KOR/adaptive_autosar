AUTOSAR XML (schema 00047)
package /mb
  adaptive application sw component type AdaptiveApplicationSwComponentType
    provide port ProvideSwdlPluginPort: provided-interface=SwdlPlugin
  executable sw_update_client_minerva_adapter_executable
    root sw component prototype RootSwComponentPrototype: application-type=AdaptiveApplicationSwComponentType
  process sw_update_client_minerva_adapter_app_Process: executable=sw_update_client_minerva_adapter_executable
