AUTOSAR XML (schema 00047)
package /mb
  adaptive application sw component type AdaptiveApplicationSwComponentType
    provide port ProvideSwdlPluginPort: provided-interface=SwdlPlugin
  executable sw_update_client_minerva_adapter_app: category=APPLICATION_LEVEL
    root sw component prototype RootSwComponentPrototype: application-type=AdaptiveApplicationSwComponentType
  process sw_update_client_minerva_adapter_app_process: executable=sw_update_client_minerva_adapter_app, state-dependent-startup-config{function-group-state=MachineState.Running, startup-config=sw_update_client_minerva_adapter_app_startup_config}
    process state machine PROCESS_STATE_MACHINE: type=MachineStates
  startup config set startup_config_set
    startup config sw_update_client_minerva_adapter_app_startup_config: scheduling-policy=SCHEDULING-POLICY-FIFO, scheduling-priority=32, startup-option{option-argument=./etc/logging_config.json, option-kind=COMMAND-LINE-SHORT-FORM, option-name=l}
  process to machine mapping set adaptive_process_to_machine_mapping_set
    process to machine mapping sw_update_client_minerva_adapter_process_to_machine_mapping: design=sw_update_client_minerva_adapter_app_process_design_to_machine_design_mapping, machine=IDC_M_P, process=sw_update_client_minerva_adapter_app_process
  process design to machine design mapping set adaptive_process_design_to_machine_mapping_set
    process design to machine design mapping sw_update_client_minerva_adapter_app_process_design_to_machine_design_mapping: machine-design=IDC_M_PDesign, process-design=sw_update_client_minerva_adapter_app_process_design
  process design sw_update_client_minerva_adapter_app_process_design: executable=sw_update_client_minerva_adapter_app
  someip service interface deployment sw_update_client_minderva_adapter: service-interface=SwdlPlugin, service-interface-id=0, service-interface-version={major-version=1, minor-version=0}
    someip field deployment progress: field=progress
      get getProgress: method-id=1, transport-protocol=UDP
      notifier onProgress: event-id=2, transport-protocol=UDP
    someip field deployment status: field=status
      get getStatus: method-id=3, transport-protocol=UDP
      notifier onStatus: event-id=4, transport-protocol=UDP
    6 x someip method deployment, all with transport-protocol=UDP:
      WriteData: method=WriteData, method-id=5
      CancelSession: method=CancelSession, method-id=6
      StartSession: method=StartSession, method-id=7
      CheckMemory: method=CheckMemory, method-id=8
      SwitchNewVersion: method=SwitchNewVersion, method-id=9
      GetResumePosition: method=GetResumePosition, method-id=10
    someip event group SomeipEventGroup: event-group-id=1, event=[onProgress, onStatus]
  provided someip service instance sw_update_client_minderva_adapter_001: service-interface=sw_update_client_minderva_adapter, sd-server-config=sw_update_client_minderva_adapter_003, service-instance-id=1
    someip provided event group SomeipEventGroup: event-group=SomeipEventGroup, multicast-threshold=0
  service instance to port prototype mapping sw_update_client_minderva_adapter_002: port-prototype=RootSwComponentPrototype.ProvideSwdlPluginPort, process=sw_update_client_minerva_adapter_app_process, service-instance=sw_update_client_minderva_adapter_001
  someip sd server service instance config sw_update_client_minderva_adapter_003: initial-offer-behavior={initial-delay-max-value=0.1, initial-delay-min-value=0.01, initial-repetitions-base-delay=0.2, initial-repetitions-max=3}, offer-cyclic-delay=2, request-response-delay={max-value=1.5, min-value=1.5}, service-offer-time-to-live=10
