AUTOSAR XML (schema 00047)
package /mb/Design
  adaptive application sw component type StubApplicationSample
  executable stub_application: category=APPLICATION_LEVEL
    root sw component prototype StubApplicationSampleRootSwc: application-type=StubApplicationSample
package /mb/Deployment
  process stub_application: executable=stub_application, state-dependent-startup-config{function-group-state=MachineState.Running, startup-config=STARTUP_CONFIG_DEFAULT}
  process to machine mapping set MbAppsToMachineMapping
    process to machine mapping StubApplicationToMachineMapping: machine=IDC6_M_P1_XAVIER, process=stub_application
