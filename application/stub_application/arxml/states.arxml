AUTOSAR XML (schema 00047)
package /DataTypes/ModelManagement
  mode declaration group MachineStates: initial-mode=Startup
    5 x mode:
      Running: value=0
      Restart: value=3
      Off: value=4
      Startup: value=1
      Shutdown: value=2
package /Machine
  machine IDC6_M_P1_XAVIER: machine-design=IDC_Adpative
    function-groups:
      mode declaration group prototype MachineState: type=MachineStates
    processor IDC6_M_P1
      6 x processor core:
        IDC6_M_Core{0..5}: core-id={0..5}
package /Machine/StartupConfigSets
  startup config set startupConf
    startup config STARTUP_CONFIG_DEFAULT: scheduling-policy=SCHEDULING-POLICY-ROUND-ROBIN, scheduling-priority=20, startup-option{option-argument=./etc/application.json, option-kind=COMMAND-LINE-SHORT-FORM, option-name=c}
