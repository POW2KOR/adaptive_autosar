AUTOSAR XML (schema 00047)
package /deployment
  persistency key value database MyPersistencyKvsDatabase: update-strategy=KEEP-EXISTING, uri=./var/key_value_storage
