AUTOSAR XML (schema 00047)
package /design
  persistency key value database interface IF_Persistency_KVS: redundancy=NONE, update-strategy=DELETE, data-type-for-serialization=uint32_t
