AUTOSAR XML (schema 00047)
package /PersistencyPortPrototypeMapping
  persistency port prototype to key value database mapping PortPrototypeToKvsMapping: key-value-storage=MyPersistencyKvsDatabase, port-prototype=X6AA_Cnfg_Mngr_ExecutableRootSwc.MyPersistencyKvsPrPortPrototype, process=Process_X6AA_Cnfg_Mngr_SWC
