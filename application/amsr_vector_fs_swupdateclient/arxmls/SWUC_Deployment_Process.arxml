AUTOSAR XML (schema 00047)
package /SWUC
  process amsr_swupdateclient_process: design=amsr_swupdateclient_process_design, executable=amsr_swupdateclient, log-trace-default-log-level=INFO, log-trace-process-desc=Software Update Client, log-trace-process-id=SWUC, state-dependent-startup-config{function-group-state=MachineState.Running, startup-config=StartupModeIndependent}
