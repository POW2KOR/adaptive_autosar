AUTOSAR XML (schema 00047)
package /SWUC/DiagCore/Persistency_Design/Port_Interfaces
  persistency key value database interface PersistencyInterface_DiagCore_KeyValueStorage: data-type-for-serialization=[HCPSoftwareInformation, RegulationSoftwareIdentification, StringVector, Uint16Vector, VersionInformation, VersionInformationList, SoftwareCluster, SoftwareClusterList, FingerPrint, TransferId, CurrentTransferSession]
