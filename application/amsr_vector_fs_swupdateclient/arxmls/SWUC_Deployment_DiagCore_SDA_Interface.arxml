AUTOSAR XML (schema 00047)
package /SWUC/DiagCore/SDA_Interface_Deployment
  service instance to port prototype mapping SDA_Interface_ServiceInstanceToPortPrototypeMapping: port-prototype=RootSwc.SDA_Interface, process=amsr_swupdateclient_process, service-instance=SDA_Interface_ProvidedUserDefinedServiceInstance
  provided user defined service instance SDA_Interface_ProvidedUserDefinedServiceInstance: service-interface=SWUC_SDA_Interface_Deployment
