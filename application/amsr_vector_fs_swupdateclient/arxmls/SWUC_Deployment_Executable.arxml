AUTOSAR XML (schema 00047)
package /SWUC
  executable amsr_swupdateclient: category=APPLICATION_LEVEL, version=1.00.00.0000
    root sw component prototype RootSwc: application-type=SoftwareUpdateClientSwcType
