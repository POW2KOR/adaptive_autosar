AUTOSAR XML (schema 00047)
package /SWUC/TPUM/Persistency_Deployment
  persistency port prototype to file array mapping TPUM_PersistencyPortProtToFileArrayMapping: persistency-file-array=TPUM_FileStorage, port-prototype=TPUM_FileStorage, process=amsr_swupdateclient_process
  persistency file array TPUM_FileStorage: maximum-allowed-size=16384, minimum-sustained-size=512, update-strategy=KEEP-EXISTING, uri=../../per/amsr_swupdateclient/var/sw_packages
  persistency port prototype to key value database mapping TPUM_SwPackage_PersistencyPortPrototypeToKeyValueDatabaseMapping: key-value-storage=TPUM_SwPackage_KeyValueStorage, port-prototype=TPUM_SwPackage_KeyValueStorage, process=amsr_swupdateclient_process
  persistency key value database TPUM_SwPackage_KeyValueStorage: maximum-allowed-size=0, minimum-sustained-size=0, update-strategy=KEEP-EXISTING, uri=../../per/amsr_swupdateclient/var/sw_package_db
    persistency key value pair database_dir_path: init-value=../../per/amsr_swupdateclient/var/sw_packages/, value-data-type=String
    persistency key value pair post_restart_verification: init-value=false, value-data-type=bool
  persistency key value database TPUM_SwCluster_KeyValueStorage: update-strategy=KEEP-EXISTING, uri=../../per/amsr_swupdateclient/var/sw_cluster_db
    persistency key value pair SoftwareClusterPlatform: init-value=fields=[name:SoftwareClusterPlatform, version:21.24.0, state:0], value-data-type=SwClusterInfoType
  persistency port prototype to key value database mapping PersistencyPortPrototypeToKeyValueDatabaseMapping: key-value-storage=TPUM_SwCluster_KeyValueStorage, port-prototype=TPUM_SwCluster_KeyValueStorage, process=amsr_swupdateclient_process
