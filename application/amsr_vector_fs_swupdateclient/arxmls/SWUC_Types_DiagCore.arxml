AUTOSAR XML (schema 00047)
package /SWUC/DiagCore/Types
  12 x std cpp implementation data type, all with type-emitter=TYPE_EMITTER_ARA:
    RegulationSoftwareIdentification: category=STRUCTURE
      namespaces:
        symbol props ns0: symbol=amsr
        symbol props ns1: symbol=swuc
      cpp implementation data type element regulation_identification: type-reference=StringType
      cpp implementation data type element software_identification: type-reference=StringType
    RoutineCheckMemorySignature: category=ARRAY, array-size=64, cpp-template-argument=uint8_t
      namespaces:
        symbol props ns0: symbol=amsr
        symbol props ns1: symbol=swuc
    Signature_Value: category=ARRAY, array-size=64, cpp-template-argument=uint8_t
      namespaces:
        symbol props ns0: symbol=amsr
        symbol props ns1: symbol=swuc
    ControllerID: category=ARRAY, array-size=10, cpp-template-argument=uint8_t
      namespaces:
        symbol props ns0: symbol=amsr
        symbol props ns1: symbol=swuc
    ReprogrammingAttemptCounter: category=STRUCTURE
      namespaces:
        symbol props ns0: symbol=amsr
        symbol props ns1: symbol=swuc
      cpp implementation data type element number_reprogramming_attempts: type-reference=uint16_t
      cpp implementation data type element max_number_reprogramming_attempts: type-reference=uint16_t
    ReprogrammingAttemptCounterList: category=VECTOR, cpp-template-argument=ReprogrammingAttemptCounter
      namespaces:
        symbol props ns0: symbol=amsr
        symbol props ns1: symbol=swuc
    FingerPrint: category=STRUCTURE
      namespaces:
        symbol props ns0: symbol=amsr
        symbol props ns1: symbol=swuc
      9 x cpp implementation data type element:
        programming_user_id: type-reference=FingerPrintId
        year: type-reference=uint8_t
        month: type-reference=uint8_t
        day: type-reference=uint8_t
        software_programmed_valid: type-reference=bool
        software_mismatch: type-reference=bool
        hardware_mismatch: type-reference=bool
        memory_status_information: type-reference=bool
        reprogramming_process_state: type-reference=ReprogrammingProcessState
    CurrentTransferSession: category=STRUCTURE
      namespaces:
        symbol props ns0: symbol=amsr
        symbol props ns1: symbol=swuc
      5 x cpp implementation data type element:
        transfer_id: type-reference=TransferId
        max_block_size: type-reference=uint32_t
        logical_block_id: type-reference=uint64_t
        current_memory_address: type-reference=uint64_t
        current_block_number: type-reference=uint64_t
    TransferId: category=ARRAY, array-size=16, cpp-template-argument=uint8_t
      namespaces:
        symbol props ns0: symbol=amsr
        symbol props ns1: symbol=swuc
    FingerPrints: category=VECTOR, cpp-template-argument=FingerPrint
      namespaces:
        symbol props ns0: symbol=amsr
        symbol props ns1: symbol=swuc
    FingerPrintId: category=ARRAY, array-size=16, cpp-template-argument=uint8_t
      namespaces:
        symbol props ns0: symbol=amsr
        symbol props ns1: symbol=swuc
    ReprogrammingProcessState: compu {0=block_valid, 1=memory_erase_started, 2=memory_erase_finished, 3=reprogramming_started, 4=memory_check_successful, 5=memory_check_unsuccessful, 6=sw_hw_check_unsuccessful}, type-reference=uint8_t
      namespaces:
        symbol props ns0: symbol=amsr
        symbol props ns1: symbol=swuc
  std cpp implementation data type SoftwareCluster: category=STRUCTURE, type-emitter=TYPE_EMITTER_ARA
    namespaces:
      symbol props ns0: symbol=amsr
      symbol props ns1: symbol=swuc
    8 x cpp implementation data type element:
      finger_print: type-reference=FingerPrint
      reprogramming_attempt_counter: type-reference=ReprogrammingAttemptCounter
      software_cluster_name: type-reference=StringType
      logical_block_id: type-reference=uint64_t
      memory_start_address: type-reference=uint64_t
      memory_end_address: type-reference=uint64_t
      current_memory_address: type-reference=uint64_t
      sw_part_number: type-reference=StringType
  std cpp implementation data type SoftwareClusterList: category=VECTOR, cpp-template-argument=SoftwareCluster, type-emitter=TYPE_EMITTER_ARA
    namespaces:
      symbol props ns0: symbol=amsr
      symbol props ns1: symbol=swuc
package /SWUC/DiagCore/Types/Diag
  8 x std cpp implementation data type, all with type-emitter=TYPE_EMITTER_ARA:
    InstanceHandle: type-reference=uint32_t
      namespaces:
        symbol props ns0: symbol=amsr
        symbol props ns1: symbol=diag
        symbol props ns2: symbol=com_api
    DiagRequestType: category=STRUCTURE
      namespaces:
        symbol props ns0: symbol=amsr
        symbol props ns1: symbol=diag
        symbol props ns2: symbol=com_api
      5 x cpp implementation data type element:
        handle: type-reference=HandleType
        instance_handle: type-reference=InstanceHandle
        conversation_handle: type-reference=ConversationHandle
        job_identifier: type-reference=JobIdentifier
        value: type-reference=ByteVectorType
    ConversationHandle: type-reference=uint16_t
      namespaces:
        symbol props ns0: symbol=amsr
        symbol props ns1: symbol=diag
        symbol props ns2: symbol=com_api
    HandleType: type-reference=uint16_t
      namespaces:
        symbol props ns0: symbol=amsr
        symbol props ns1: symbol=diag
        symbol props ns2: symbol=com_api
    MetaInfoType: category=ASSOCIATIVE_MAP, template-arguments=[string, string]
      namespaces:
        symbol props ns0: symbol=amsr
        symbol props ns1: symbol=diag
        symbol props ns2: symbol=com_api
    JobIdentifier: type-reference=uint32_t
      namespaces:
        symbol props ns0: symbol=amsr
        symbol props ns1: symbol=diag
        symbol props ns2: symbol=com_api
    DaemonRequestResponseType: category=STRUCTURE
      namespaces:
        symbol props ns0: symbol=amsr
        symbol props ns1: symbol=diag
        symbol props ns2: symbol=com_api
      cpp implementation data type element response_type: type-reference=HandleType
      cpp implementation data type element job_identifier: type-reference=JobIdentifier
      cpp implementation data type element value: type-reference=ByteVectorType
    string: category=STRING
      namespaces:
        symbol props ns0: symbol=ara
        symbol props ns1: symbol=diag
