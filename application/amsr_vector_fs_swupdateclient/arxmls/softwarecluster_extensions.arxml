AUTOSAR XML (schema 00047)
package /SoftwareDistribution/SoftwareCluster
  software cluster SoftwareClusterPlatform: contained-process=amsr_swupdateclient_process, vendor-id=4660, version=1.0.0.0000
package /SoftwareDistribution/SoftwareClusterDesign
  software cluster design temporarySoftwareClusterDesignPer: contained-process=amsr_swupdateclient_process_design, intended-target-machine=IDC_Adpative
