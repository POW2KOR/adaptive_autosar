AUTOSAR XML (schema 00047)
package /SWUC/TPUM/Persistency_Design/Port_Interfaces
  persistency key value database interface PersistencyInterface_TPUM_SwCluster_KeyValueStorage: data-type-for-serialization=SwClusterInfoType
  persistency file proxy interface PersistencyInterface_TPUM_FileStorage: category=text, encoding=utf-8, max-number-of-files=4096
  persistency key value database interface PersistencyInterface_TPUM_SwPackage_KeyValueStorage: data-type-for-serialization=SwPackage
