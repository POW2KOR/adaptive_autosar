AUTOSAR XML (schema 00047)
package /SWUC
  process design amsr_swupdateclient_process_design: executable=amsr_swupdateclient
