AUTOSAR XML (schema 00047)
package /SWUC
  process amsr_swupdateclient_process: design=amsr_swupdateclient_process_design, executable=amsr_swupdateclient, log-trace-default-log-level=INFO, log-trace-process-desc=Software Update Client, log-trace-process-id=SWUC, state-dependent-startup-config{function-group-state=MachineState.Running, startup-config=StartupModeIndependent}
  startup config set StartupConfigs
    startup config StartupModeIndependent: scheduling-policy=SCHEDULING-POLICY-ROUND-ROBIN, scheduling-priority=15
  process to machine mapping set Process_MachineMappingSet
    process to machine mapping Process_MachineMapping: machine=IDC6_M_P1_XAVIER, process=amsr_swupdateclient_process
  executable amsr_swupdateclient: category=APPLICATION_LEVEL, version=1.00.00.0000
    root sw component prototype RootSwc: application-type=SoftwareUpdateClientSwcType
