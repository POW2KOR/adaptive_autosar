AUTOSAR XML (schema 00047)
package /SWUC
  startup config set StartupConfigs
    startup config StartupModeIndependent: scheduling-policy=SCHEDULING-POLICY-ROUND-ROBIN, scheduling-priority=15
