AUTOSAR XML (schema 00047)
package /SWUC/DiagCore/Diag_Deployment
  diagnostic service data identifier port mapping Diag_ServiceDataIdentifierPortMapping_ReprogrammingResumeInformation: diagnostic-data-identifier=Reprogramming_Resume_Information, process=amsr_swupdateclient_process_design, swc-service-dependency-in-executable=SwcServiceDependency_DID_GenericInterface
package /SWUC/DiagCore/Diag_Design/Port_Interfaces
  diagnostic download interface Diag_DownloadInterface
    namespaces:
      symbol props amsr
      symbol props swuc
  4 x diagnostic routine interface:
    Diag_RoutineInterface_EraseMemory
      namespaces:
        symbol props amsr
        symbol props swuc
      start Start
        4 x arg, all with type=uint8_t:
          address_format_identifier: direction=IN
          logical_block_information: direction=IN
          routine_information: direction=OUT
          erase_verification: direction=OUT
    Diag_RoutineInterface_CheckMemory
      namespaces:
        symbol props amsr
        symbol props swuc
      start Start
        4 x arg:
          signature: type=RoutineCheckMemorySignature, direction=IN
          crc: type=uint8_t, direction=IN
          routine_information: type=uint8_t, direction=OUT
          verification_result: type=uint8_t, direction=OUT
    Diag_RoutineInterface_CheckProgrammingDependencies
      namespaces:
        symbol props amsr
        symbol props swuc
      start Start
        arg routine_information: type=uint8_t, direction=OUT
        arg check_verification_result: type=uint8_t, direction=OUT
    Diag_RoutineInterface_VerifyMemoryContent
      namespaces:
        symbol props amsr
        symbol props swuc
      start Start
        5 x arg:
          logical_block_number: type=uint8_t, direction=IN
          num_of_crc_bytes_n: type=uint16_t, direction=IN
          crc_values: type=uint32_t, direction=IN
          routine_information: type=uint8_t, direction=OUT
          check_verification_result: type=uint8_t, direction=OUT
  diagnostic data identifier generic interface Diag_DataIdentifierGenericInterface
    namespaces:
      symbol props amsr
      symbol props swuc
