AUTOSAR XML (schema 00047)
package /SWUC/DiagCore/Diag_Deployment
  service instance to port prototype mapping Diag_ProvidedBindingServiceInstance_DiagComApi_toPort: port-prototype=RootSwc.amsr_DiagComApi, process=amsr_swupdateclient_process, service-instance=Diag_ProvidedBindingServiceInstance_DiagComApi
  provided user defined service instance Diag_ProvidedBindingServiceInstance_DiagComApi: service-interface=DiagComApi_Binding
  4 x diagnostic service sw mapping, all with process=amsr_swupdateclient_process_design:
    Diag_ServiceSwMapping_Routine_EraseMemory: mapped-swc-service-dependency-in-executable=SwcServiceDependency_EraseMemory, service-instance=Erase_Memory
    Diag_ServiceSwMapping_Routine_CheckMemory: mapped-swc-service-dependency-in-executable=SwcServiceDependency_CheckMemory, service-instance=Check_memory
    Diag_ServiceSwMapping_Routine_CheckProgrammingDependencies: mapped-swc-service-dependency-in-executable=SwcServiceDependency_CheckProgrammingDependencies, service-instance=CheckProgrammingDependencies
    Diag_ServiceSwMapping_Routine_CerifyMemoryContent: mapped-swc-service-dependency-in-executable=SwcServiceDependency_VerifyMemoryContent, service-instance=Verify_Memory_Content
  diagnostic service data identifier port mapping Diag_ServiceDataIdentifierPortMapping_ReadFingerPrints: diagnostic-data-identifier=Read_Software_Fingerprint_s, process=amsr_swupdateclient_process_design, swc-service-dependency-in-executable=SwcServiceDependency_DID_GenericInterface
  diagnostic service data identifier port mapping Diag_ServiceDataIdentifierPortMapping_ReprogrammingAttemptCounter: diagnostic-data-identifier=Reprogramming_Attempt_Counter, process=amsr_swupdateclient_process_design, swc-service-dependency-in-executable=SwcServiceDependency_DID_GenericInterface
  diagnostic service data identifier port mapping Diag_ServiceDataIdentifierPortMapping_WrintFingerPrint: diagnostic-data-identifier=Write_Software_Fingerprint, process=amsr_swupdateclient_process_design, swc-service-dependency-in-executable=SwcServiceDependency_DID_GenericInterface
