AUTOSAR XML (schema 00047)
package /SWUC/TPUM/Types
  std cpp implementation data type SwPackage: category=STRUCTURE, type-emitter=TYPE_EMITTER_ARA
    namespaces:
      symbol props ns0: symbol=amsr
      symbol props ns1: symbol=swuc
    17 x cpp implementation data type element:
      name: type-reference=StringType
      version: type-reference=StringType
      state: type-reference=SwPackageStateType
      id: type-reference=StringType
      manifest_size: type-reference=uint32_t
      auth_size: type-reference=uint64_t
      size: type-reference=uint64_t
      payload_size: type-reference=uint64_t
      manifest_received: type-reference=bool
      manifest_received_size: type-reference=uint64_t
      blocks_received: type-reference=uint32_t
      current_file: type-reference=uint32_t
      packages: type-reference=SwFileList
      auth_received: type-reference=bool
      auth_received_size: type-reference=uint64_t
      strategy_input: type-reference=StringType
      received: type-reference=uint64_t
  std cpp implementation data type SwPackageStateType: compu {0=kTransferring, 1=kTransferred, 2=kProcessing, 3=kProcessed, 4=kProcessingStream}, type-emitter=TYPE_EMITTER_ARA, type-reference=uint8_t
    namespaces:
      symbol props ns0: symbol=amsr
      symbol props ns1: symbol=swuc
  4 x std cpp implementation data type, all with type-emitter=TYPE_EMITTER_ARA:
    SwFile: category=STRUCTURE
      namespaces:
        symbol props ns0: symbol=amsr
        symbol props ns1: symbol=swuc
      7 x cpp implementation data type element:
        unique_name: type-reference=StringType
        filename: type-reference=StringType
        size: type-reference=uint64_t
        written: type-reference=uint64_t
        checksum: type-reference=StringType
        destination: type-reference=StringType
        path: type-reference=StringType
    SwFileList: category=VECTOR, cpp-template-argument=SwFile
      namespaces:
        symbol props ns0: symbol=amsr
        symbol props ns1: symbol=swuc
    SwClusterInfoType: category=STRUCTURE
      namespaces:
        symbol props ns0: symbol=amsr
        symbol props ns1: symbol=swuc
      cpp implementation data type element name: type-reference=StringType
      cpp implementation data type element version: type-reference=StringType
      cpp implementation data type element state: type-reference=SwClusterStateType
    SwClusterStateType: compu {0=kPresent, 1=kAdded, 2=kUpdated, 3=kRemoved}, type-reference=uint8_t
      namespaces:
        symbol props ns0: symbol=amsr
        symbol props ns1: symbol=swuc
  std cpp implementation data type String: category=STRING, type-emitter=TYPE_EMITTER_ARA
    namespaces:
      symbol props ns0: symbol=amsr
      symbol props ns1: symbol=swuc
