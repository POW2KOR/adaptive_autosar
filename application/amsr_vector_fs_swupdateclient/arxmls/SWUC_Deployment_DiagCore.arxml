AUTOSAR XML (schema 00047)
package /SWUC/DiagCore/Persistency_Deployment
  persistency port prototype to key value database mapping DiagCore_PersistencyPortProtToKeyValueDataBaseMapping: key-value-storage=DiagCore_KeyValueStorage, port-prototype=DiagCore_KeyValueStorage, process=amsr_swupdateclient_process
  persistency key value database DiagCore_KeyValueStorage: maximum-allowed-size=16384, minimum-sustained-size=512, update-strategy=KEEP-EXISTING, uri=../../per/amsr_swupdateclient/var/diag_core_data
    persistency key value pair hcp_software_information: init-value=fields=[software_id:id_XXXXXXXXXXXX, software_name:name_XXXXXXXXXXXXXXX, software_version:version_, software_type:type_XXXXXXXXXXXXXXX, current_ram_consumption:ram_XXXXXXXXXXX, rom_consumption:rom_XXXXXXXXXXX, cpu_load:cpu_, running_state:state_XXXX, origin:origin_XXXXXXXXXXXXX], update-strategy=OVERWRITE, value-data-type=HCPSoftwareInformation
    persistency key value pair software_cluster_list: init-value=[fields=[{short-label=finger_print, fields=[programming_user_id:16 x 0, year:21, month:04, day:21, software_programmed_valid:true, software_mismatch:false, hardware_mismatch:false, memory_status_information:false, reprogramming_process_state:0]}, {short-label=reprogramming_attempt_counter, fields=[number_reprogramming_attempts:0, max_number_reprogramming_attempts:0]}, software_cluster_name:SoftwareClusterPlatform, logical_block_id:0, memory_start_address:0, memory_end_address:1000000000, current_memory_address:0, sw_part_number:DUMMYPTNUM]], value-data-type=SoftwareClusterList
