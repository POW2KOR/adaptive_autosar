AUTOSAR XML (schema 00047)
package /SWUC/DiagCore/Diag_Deployment
  4 x diagnostic service sw mapping, all with process=amsr_swupdateclient_process_design:
    Diag_ServiceSwMapping_Routine_EraseMemory: mapped-swc-service-dependency-in-executable=SwcServiceDependency_EraseMemory, service-instance=Erase_Memory
    Diag_ServiceSwMapping_Routine_CheckMemory: mapped-swc-service-dependency-in-executable=SwcServiceDependency_CheckMemory, service-instance=Check_memory
    Diag_ServiceSwMapping_Routine_CheckProgrammingDependencies: mapped-swc-service-dependency-in-executable=SwcServiceDependency_CheckProgrammingDependencies, service-instance=CheckProgrammingDependencies
    Diag_ServiceSwMapping_Routine_CerifyMemoryContent: mapped-swc-service-dependency-in-executable=SwcServiceDependency_VerifyMemoryContent, service-instance=Verify_Memory_Content
  4 x diagnostic service data identifier port mapping, all with process=amsr_swupdateclient_process_design, swc-service-dependency-in-executable=SwcServiceDependency_DID_GenericInterface:
    Diag_ServiceDataIdentifierPortMapping_ReadFingerPrints: diagnostic-data-identifier=Read_Software_Fingerprint_s
    Diag_ServiceDataIdentifierPortMapping_ReprogrammingAttemptCounter: diagnostic-data-identifier=Reprogramming_Attempt_Counter
    Diag_ServiceDataIdentifierPortMapping_WrintFingerPrint: diagnostic-data-identifier=Write_Software_Fingerprint
    Diag_ServiceDataIdentifierPortMapping_ReprogrammingResumeInformation: diagnostic-data-identifier=Reprogramming_Resume_Information
