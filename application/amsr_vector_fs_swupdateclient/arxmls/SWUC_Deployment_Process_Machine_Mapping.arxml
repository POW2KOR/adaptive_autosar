AUTOSAR XML (schema 00047)
package /SWUC
  process to machine mapping set Process_MachineMappingSet
    process to machine mapping Process_MachineMapping: machine=IDC6_M_P1_XAVIER, process=amsr_swupdateclient_process
