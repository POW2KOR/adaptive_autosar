AUTOSAR XML (schema 00047)
package /SWUC/DiagCore/Diag_Deployment
  service instance to port prototype mapping Diag_ProvidedBindingServiceInstance_DiagComApi_toPort: port-prototype=RootSwc.amsr_DiagComApi, process=amsr_swupdateclient_process, service-instance=Diag_ProvidedBindingServiceInstance_DiagComApi
  provided user defined service instance Diag_ProvidedBindingServiceInstance_DiagComApi: service-interface=DiagComApi_Binding
