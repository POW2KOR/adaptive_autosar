AUTOSAR XML (schema 00047)
package /mb
  machine SwucNvAdapterTestMachine: machine-design=SwucNvAdapter_test_MachineDesign
    function-groups:
      mode declaration group prototype MachineState: type=SwucNvAdapterTestMachineMachineState
      mode declaration group prototype FunctionGroup: type=FunctionGroup
    os module instantiation Os
      resource group ControlGroup: cpu-usage=50, mem-usage=1024
    processor Processor
      processor core ProcessorCore
  process to machine mapping set MachineProcessMappingSet
    process to machine mapping MachineToSwucTestProcessMapping: machine=SwucNvAdapterTestMachine, process=SwucNvAdapter_app_Process, shall-run-on=ProcessorCore
  ethernet cluster EthernetChannel
    ethernet physical channel EthernetChannelChnl
      network endpoint EthernetDefault: network-endpoint-addresses=ipv-4-configuration=ipv-4-address=172.0.0.22
  machine design SwucNvAdapter_test_MachineDesign: service-discover-configs=someip-service-discovery={multicast-sd-ip-address=EthernetDefault, someip-service-discovery-port=30490}
    ethernet communication connector EthernetDefault: unicast-network-endpoint=EthernetDefault
  mode declaration group SwucNvAdapterTestMachineMachineState: initial-mode=SwucNvAdapterTestMachineMachineState/Off
    4 x mode:
      Off: value=0
      Startup: value=1
      Shutdown: value=2
      Restart: value=3
  mode declaration group FunctionGroup: initial-mode=FunctionGroup/Off
    mode Off: value=0
