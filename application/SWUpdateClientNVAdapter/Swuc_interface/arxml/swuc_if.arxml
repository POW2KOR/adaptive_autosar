AUTOSAR XML (schema 00047)
package /mb
  std cpp implementation data type ByteVector: category=VECTOR, cpp-template-argument=uint8_t, type-emitter=TYPE_EMITTER_ARA
    namespaces:
      symbol props ns0: symbol=mb
      symbol props ns0_001: symbol=swuc
      symbol props ns1: symbol=types
  std cpp implementation data type PluginStatus: compu {0x00=kIdle, 0x01=kWorking, 0x02=kDone, 0x03=kError}, type-emitter=TYPE_EMITTER_ARA, type-reference=uint8_t
    namespaces:
      symbol props ns0: symbol=mb
      symbol props ns1: symbol=swuc
      symbol props ns2: symbol=types
  std cpp implementation data type UcmTransferdataSeqCounter: category=VALUE, type-reference=uint8_t
  service interface SwdlPlugin: service-kind=VENDOR-SPECIFIC
    namespaces:
      4 x symbol props:
        ns0: symbol=mb
        ns1: symbol=swuc
        ns2: symbol=service_interfaces
        ns3: symbol=plugin
    field progress: type=uint8_t, has-getter=true, has-notifier=true, has-setter=false
    field status: type=PluginStatus, has-getter=true, has-notifier=true, has-setter=false
    methods:
      6 x operation:
        WriteData: fire-and-forget=true
          arg seq_counter: type=UcmTransferdataSeqCounter, direction=IN
          arg data: type=ByteVector, direction=IN
        CancelSession: fire-and-forget=true
        StartSession: fire-and-forget=true
          arg resumeOffset: type=uint64_t, direction=IN
        CheckMemory
          arg memory_ok: type=bool, direction=OUT
        SwitchNewVersion
          arg switch_ok: type=bool, direction=OUT
        GetResumePosition
          arg position: type=uint64_t, direction=OUT
          arg version: type=uint64_t, direction=OUT
          arg id: type=uint64_t, direction=OUT
