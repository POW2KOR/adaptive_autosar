AUTOSAR XML (schema 00047)
package /mb
  adaptive application sw component type AdaptiveApplicationSwComponentType
    provide port ProvideSwdlPluginPort: provided-interface=SwdlPlugin
  executable SwucNvAdapter_Executable
    root sw component prototype RootSwComponentPrototype: application-type=AdaptiveApplicationSwComponentType
  process SwucNvAdapter_app_Process: executable=SwucNvAdapter_Executable
