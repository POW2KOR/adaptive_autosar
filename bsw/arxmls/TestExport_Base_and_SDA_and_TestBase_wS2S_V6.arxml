[part 2 of 2: packages /DataTypes/ImplementationDataTypes to /SoftwareDistribution/SoftwareClusterDesign]
AUTOSAR XML (schema 00047)
package /DataTypes/ImplementationDataTypes  (continued)
  796 x std cpp implementation data type:  (continued)
    Odo_ST3: type-emitter=TYPE_EMITTER_ARA, type-reference=c24_km_0_999999k9_0k1_Invld_SNA  # Odometer (for everyone)
      namespaces:
        symbol props TypeRef
    PN14_DDP_Sw2_Stat_ST3: type-emitter=TYPE_EMITTER_ARA, type-reference=uint8_t  # Sequence counter
      namespaces:
        symbol props TypeRef
    PN14_DDP_Sw_Stat_ST3: type-emitter=TYPE_EMITTER_ARA, type-reference=uint8_t  # Sequence counter
      namespaces:
        symbol props TypeRef
    PN14_ExtBat_Charge_Actv_ST3: type-emitter=TYPE_EMITTER_ARA, type-reference=uint8_t  # Sequence counter
      namespaces:
        symbol props TypeRef
    PN14_PNSec_RechargeEnable_ST3: type-emitter=TYPE_EMITTER_ARA, type-reference=uint8_t  # Sequence counter
      namespaces:
        symbol props TypeRef
    PN14_ProdMd_BatStat_ST3: type-emitter=TYPE_EMITTER_ARA, type-reference=uint8_t  # Sequence counter
      namespaces:
        symbol props TypeRef
    PN14_ProdMd_Stat_ST3: type-emitter=TYPE_EMITTER_ARA, type-reference=uint8_t  # Sequence counter
      namespaces:
        symbol props TypeRef
    PN14_SupBat_Curr_ST3: type-emitter=TYPE_EMITTER_ARA, type-reference=uint16_t  # Sequence counter
      namespaces:
        symbol props TypeRef
    PN14_SupBat_Stat_ST3: type-emitter=TYPE_EMITTER_ARA, type-reference=uint8_t  # Sequence counter
      namespaces:
        symbol props TypeRef
    PN14_SupBat_Temp_ST3: type-emitter=TYPE_EMITTER_ARA, type-reference=uint8_t  # Sequence counter
      namespaces:
        symbol props TypeRef
    PN14_SupBat_Volt_ST3: type-emitter=TYPE_EMITTER_ARA, type-reference=uint16_t  # Sequence counter
      namespaces:
        symbol props TypeRef
    PN14_TransMd_Stat_ST3: type-emitter=TYPE_EMITTER_ARA, type-reference=uint8_t  # Sequence counter
      namespaces:
        symbol props TypeRef
    PT4_PTCoor_EngStartPN14_Stat_ST3: type-emitter=TYPE_EMITTER_ARA, type-reference=c03_EngStartPN14_Stat  # PT4 Engine Start PN14 State
      namespaces:
        symbol props TypeRef
    PT4_PTCoor_PT_Rdy_ST3: type-emitter=TYPE_EMITTER_ARA, type-reference=c02_PT_Rdy_V2  # Powertrain ready
      namespaces:
        symbol props TypeRef
    PT4_PTCoor_SSA_EngSp_ST3: type-emitter=TYPE_EMITTER_ARA, type-reference=c02_Ndef_False_True_ST3  # Stop/start automatic has engine stopped
      namespaces:
        symbol props TypeRef
    REC_CR_FL_Detection_ST3: category=STRUCTURE, type-emitter=TYPE_EMITTER_ARA
      namespaces:
        symbol props CR_Types_Namespace
      31 x cpp implementation data type element, all with is-optional=false:
        CR_FL_Dtctn_Existence_Prob_ST3: type-reference=CR_FL_Dtctn_Existence_Prob_ST3
        CR_FL_Dtctn_Azi_ST3: type-reference=CR_FL_Dtctn_Azi_ST3
        CR_FL_Dtctn_Elev_ST3: type-reference=CR_FL_Dtctn_Elev_ST3
        CR_FL_Dtctn_Dist_ST3: type-reference=CR_FL_Dtctn_Dist_ST3
        CR_FL_Dtctn_Azi_StdDev_ST3: type-reference=CR_FL_Dtctn_Azi_StdDev_ST3
        CR_FL_Dtctn_Elev_StdDev_ST3: type-reference=CR_FL_Dtctn_Elev_StdDev_ST3
        CR_FL_Dtctn_Dist_StdDev_ST3: type-reference=CR_FL_Dtctn_Dist_StdDev_ST3
        CR_FL_Dtctn_RadRelVelo_ST3: type-reference=CR_FL_Dtctn_RadRelVelo_ST3
        CR_FL_Dtctn_RadRelVelo_StdDev_ST3: type-reference=CR_FL_Dtctn_RadRelVelo_StdDev_ST3
        CR_FL_Dtctn_RadRelVelo_Ambgt_Resolv_ST3: type-reference=CR_FL_Dtctn_RadRelVelo_Ambgt_Resolv_ST3
        CR_FL_Dtctn_RCS_ST3: type-reference=CR_FL_Dtctn_RCS_ST3
        CR_FL_Dtctn_RCS_Err_ST3: type-reference=CR_FL_Dtctn_RCS_Err_ST3
        CR_FL_Dtctn_SNR_ST3: type-reference=CR_FL_Dtctn_SNR_ST3
        CR_FL_Dtct_SNR_Err_ST3: type-reference=CR_FL_Dtct_SNR_Err_ST3
        CR_FL_Dtctn_MultiTrgt_Probb_ST3: type-reference=CR_FL_Dtctn_MultiTrgt_Probb_ST3
        CR_FL_Dtctn_Ambgt_ID_ST3: type-reference=CR_FL_Dtctn_Ambgt_ID_ST3
        CR_FL_Dtctn_Ambgt_Probb_ST3: type-reference=CR_FL_Dtctn_Ambgt_Probb_ST3
        CR_FL_Dtctn_FreeSp_Probb_ST3: type-reference=CR_FL_Dtctn_FreeSp_Probb_ST3
        CR_FL_Dtctn_Micro_Doppler_Val_ST3: type-reference=CR_FL_Dtctn_Micro_Doppler_Val_ST3
        CR_FL_Dtctn_Azi_Qual_ST3: type-reference=CR_FL_Dtctn_Azi_Qual_ST3
        CR_FL_Dtctn_Elev_Qual_ST3: type-reference=CR_FL_Dtctn_Elev_Qual_ST3
        CR_FL_Dtctn_Dist_Qual_ST3: type-reference=CR_FL_Dtctn_Dist_Qual_ST3
        CR_FL_Dtctn_RadVelo_Qual_ST3: type-reference=CR_FL_Dtctn_RadVelo_Qual_ST3
        CR_FL_Dtctn_Meas_Model_ST3: type-reference=CR_FL_Dtctn_Meas_Model_ST3
        CR_FL_Dtctn_StaticObj_Stat_ST3: type-reference=CR_FL_Dtctn_StaticObj_Stat_ST3
        CR_FL_Dtctn_RxSig_Strength_ST3: type-reference=CR_FL_Dtctn_RxSig_Strength_ST3
        CR_FL_Dtctn_PeakDtct_Thrsld_ST3: type-reference=CR_FL_Dtctn_PeakDtct_Thrsld_ST3
        CR_FL_Dtctn_MaskAnglSect_Azi_ST3: type-reference=CR_FL_Dtctn_MaskAnglSect_Azi_ST3
        CR_FL_Dtctn_MaskAnglSect_Elev_ST3: type-reference=CR_FL_Dtctn_MaskAnglSect_Elev_ST3
        CR_FL_Dtctn_ID_Part1_ST3: type-reference=CR_FL_Dtctn_ID_Part1_ST3
        CR_FL_Dtctn_ID_Part2_ST3: type-reference=CR_FL_Dtctn_ID_Part2_ST3
    REC_CR_FL_Gen_Header_ST3: category=STRUCTURE, type-emitter=TYPE_EMITTER_ARA
      namespaces:
        symbol props CR_Types_Namespace
      11 x cpp implementation data type element, all with is-optional=false:
        CR_FL_SW_VerID_Major_ST3: type-reference=CR_FL_SW_VerID_Major_ST3
        CR_FL_SW_VerID_Minor_ST3: type-reference=CR_FL_SW_VerID_Minor_ST3
        CR_FL_SW_VerID_Patch_ST3: type-reference=CR_FL_SW_VerID_Patch_ST3
        CR_FL_SensorID_ST3: type-reference=CR_FL_SensorID_ST3
        CR_FL_Interface_ID_ST3: type-reference=CR_FL_Interface_ID_ST3
        CR_FL_Meas_TmStmp_ST3: type-reference=CR_FL_Meas_TmStmp_ST3
        CR_FL_Meas_Dur_ST3: type-reference=CR_FL_Meas_Dur_ST3
        CR_FL_Cycl_Count_ST3: type-reference=CR_FL_Cycl_Count_ST3
        CR_FL_Interface_CyclTime_ST3: type-reference=CR_FL_Interface_CyclTime_ST3
        CR_FL_Interface_CyclTime_Var_ST3: type-reference=CR_FL_Interface_CyclTime_Var_ST3
        CR_FL_Data_Qual_ST3: type-reference=CR_FL_Data_Qual_ST3
    REC_CR_FL_Radar_Header_ST3: category=STRUCTURE, type-emitter=TYPE_EMITTER_ARA
      namespaces:
        symbol props CR_Types_Namespace
      13 x cpp implementation data type element, all with is-optional=false:
        CR_FL_RadVelo_UpLmt_ST3: type-reference=CR_FL_RadVelo_UpLmt_ST3
        CR_FL_RadVelo_LowLmt_ST3: type-reference=CR_FL_RadVelo_LowLmt_ST3
        CR_FL_Dist_Range__ST3: type-reference=CR_FL_Dist_Range__ST3
        CR_FL_AziAngl_UpLmt_ST3: type-reference=CR_FL_AziAngl_UpLmt_ST3
        CR_FL_AziAngl_LowLmt_ST3: type-reference=CR_FL_AziAngl_LowLmt_ST3
        CR_FL_ElevAngl_UpLmt_ST3: type-reference=CR_FL_ElevAngl_UpLmt_ST3
        CR_FL_ElevAngl_LowLmt_ST3: type-reference=CR_FL_ElevAngl_LowLmt_ST3
        CR_FL_MaxDtctn_ST3: type-reference=CR_FL_MaxDtctn_ST3
        CR_FL_Dtctn_Stat_ST3: type-reference=CR_FL_Dtctn_Stat_ST3
        CR_FL_ValidDtctn_ST3: type-reference=CR_FL_ValidDtctn_ST3
        CR_FL_Moduln_Md_ST3: type-reference=CR_FL_Moduln_Md_ST3
        CR_FL_Dist_RadVelo_Cov_ST3: type-reference=CR_FL_Dist_RadVelo_Cov_ST3
        CR_FL_LowDist_Dtctn_Indicator_ST3: type-reference=CR_FL_LowDist_Dtctn_Indicator_ST3
    REC_CR_FL_SHI_Header_ST3: category=STRUCTURE, type-emitter=TYPE_EMITTER_ARA
      namespaces:
        symbol props CR_Types_Namespace
      27 x cpp implementation data type element, all with is-optional=false:
        CR_FL_Sens_Oprtn_Stat_ST3: type-reference=CR_FL_Sens_Oprtn_Stat_ST3
        CR_FL_Sens_Oprtn_Md_ST3: type-reference=CR_FL_Sens_Oprtn_Md_ST3
        CR_FL_Sens_Defect_Dtct_ST3: type-reference=CR_FL_Sens_Defect_Dtct_ST3
        CR_FL_Sens_Defect_Rsn_ST3: type-reference=CR_FL_Sens_Defect_Rsn_ST3
        CR_FL_Sens_Diag_Md_ST3: type-reference=CR_FL_Sens_Diag_Md_ST3
        CR_FL_Sens_Supp_Vtg_Stat_ST3: type-reference=CR_FL_Sens_Supp_Vtg_Stat_ST3
        CR_FL_Sens_Temp_Stat_ST3: type-reference=CR_FL_Sens_Temp_Stat_ST3
        CR_FL_Sens_Valid_InputSignals_Curr_ST3: type-reference=CR_FL_Sens_Valid_InputSignals_Curr_ST3
        CR_FL_Sens_Valid_InputSignals_Trgt_ST3: type-reference=CR_FL_Sens_Valid_InputSignals_Trgt_ST3
        CR_FL_Sens_Extern_Disturbnc_ST3: type-reference=CR_FL_Sens_Extern_Disturbnc_ST3
        CR_FL_Sens_Tx_PwrRedctn_Stat_ST3: type-reference=CR_FL_Sens_Tx_PwrRedctn_Stat_ST3
        CR_FL_Sens_Radom_Heat_Stat_ST3: type-reference=CR_FL_Sens_Radom_Heat_Stat_ST3
        CR_FL_Sens_TmSync_Stat_ST3: type-reference=CR_FL_Sens_TmSync_Stat_ST3
        CR_FL_Sens_GTS_Offset_ST3: type-reference=CR_FL_Sens_GTS_Offset_ST3
        CR_FL_Sens_Calib_Valid_Comp_ST3: type-reference=CR_FL_Sens_Calib_Valid_Comp_ST3
        CR_FL_Sens_Calib_Base_Stat_ST3: type-reference=CR_FL_Sens_Calib_Base_Stat_ST3
        CR_FL_Sens_Calib_Func_Stat_ST3: type-reference=CR_FL_Sens_Calib_Func_Stat_ST3
        CR_FL_Sens_Calib_SOC_Stat_ST3: type-reference=CR_FL_Sens_Calib_SOC_Stat_ST3
        CR_FL_Sens_Calib_Corrctn_Orient_Azi_ST3: type-reference=CR_FL_Sens_Calib_Corrctn_Orient_Azi_ST3
        CR_FL_Sens_Calib_Corrctn_Orient_Elev_ST3: type-reference=CR_FL_Sens_Calib_Corrctn_Orient_Elev_ST3
        CR_FL_Sens_Calib_Corrctn_Orient_Roll_ST3: type-reference=CR_FL_Sens_Calib_Corrctn_Orient_Roll_ST3
        CR_FL_Sens_Calib_Corrctn_UpLmt_Azi_ST3: type-reference=CR_FL_Sens_Calib_Corrctn_UpLmt_Azi_ST3
        CR_FL_Sens_Calib_Corrctn_UpLmt_Elev_ST3: type-reference=CR_FL_Sens_Calib_Corrctn_UpLmt_Elev_ST3
        CR_FL_Sens_Calib_Corrctn_UpLmt_Roll_ST3: type-reference=CR_FL_Sens_Calib_Corrctn_UpLmt_Roll_ST3
        CR_FL_Sens_Calib_Corrctn_LowLmt_Azi_ST3: type-reference=CR_FL_Sens_Calib_Corrctn_LowLmt_Azi_ST3
        CR_FL_Sens_Calib_Corrctn_LowLmt_Elev_ST3: type-reference=CR_FL_Sens_Calib_Corrctn_LowLmt_Elev_ST3
        CR_FL_Sens_Calib_Corrctn_LowLmt_Roll_ST3: type-reference=CR_FL_Sens_Calib_Corrctn_LowLmt_Roll_ST3
    REC_CR_FL_SPI_Header_ST3: category=STRUCTURE, type-emitter=TYPE_EMITTER_ARA
      namespaces:
        symbol props CR_Types_Namespace
      19 x cpp implementation data type element, all with is-optional=false:
        CR_FL_Sens_Origin_Pos_X_ST3: type-reference=CR_FL_Sens_Origin_Pos_X_ST3
        CR_FL_Sens_Origin_Pos_Y_ST3: type-reference=CR_FL_Sens_Origin_Pos_Y_ST3
        CR_FL_Sens_Origin_Pos_Z_ST3: type-reference=CR_FL_Sens_Origin_Pos_Z_ST3
        CR_FL_Sens_Origin_Pos_Err_X_ST3: type-reference=CR_FL_Sens_Origin_Pos_Err_X_ST3
        CR_FL_Sens_Origin_Pos_Err_Y_ST3: type-reference=CR_FL_Sens_Origin_Pos_Err_Y_ST3
        CR_FL_Sens_Origin_Pos_Err_Z_ST3: type-reference=CR_FL_Sens_Origin_Pos_Err_Z_ST3
        CR_FL_Sens_Orient_Azi_ST3: type-reference=CR_FL_Sens_Orient_Azi_ST3
        CR_FL_Sens_Orient_Elev_ST3: type-reference=CR_FL_Sens_Orient_Elev_ST3
        CR_FL_Sens_Orient_Roll_ST3: type-reference=CR_FL_Sens_Orient_Roll_ST3
        CR_FL_Sens_Orient_Err_Azi_ST3: type-reference=CR_FL_Sens_Orient_Err_Azi_ST3
        CR_FL_Sens_Orient_Err_Elev_ST3: type-reference=CR_FL_Sens_Orient_Err_Elev_ST3
        CR_FL_Sens_Orient_Err_Roll_ST3: type-reference=CR_FL_Sens_Orient_Err_Roll_ST3
        CR_FL_Sens_COS_Offset_X_ST3: type-reference=CR_FL_Sens_COS_Offset_X_ST3
        CR_FL_Sens_COS_Offset_Y_ST3: type-reference=CR_FL_Sens_COS_Offset_Y_ST3
        CR_FL_Sens_COS_Offset_Z_ST3: type-reference=CR_FL_Sens_COS_Offset_Z_ST3
        CR_FL_Sens_Valid_Seg_Azi_ST3: type-reference=CR_FL_Sens_Valid_Seg_Azi_ST3
        CR_FL_Sens_Valid_Seg_Elev_ST3: type-reference=CR_FL_Sens_Valid_Seg_Elev_ST3
        CR_FL_Sens_Total_Seg_Azi_ST3: type-reference=CR_FL_Sens_Total_Seg_Azi_ST3
        CR_FL_Sens_Total_Seg_Elev_ST3: type-reference=CR_FL_Sens_Total_Seg_Elev_ST3
    REC_CR_FL_Segment_ST3: category=STRUCTURE, type-emitter=TYPE_EMITTER_ARA
      namespaces:
        symbol props CR_Types_Namespace
      12 x cpp implementation data type element, all with is-optional=false:
        CR_FL_Seg_ID_ST3: type-reference=CR_FL_Seg_ID_ST3
        CR_FL_Seg_AziAngl_Begin_ST3: type-reference=CR_FL_Seg_AziAngl_Begin_ST3
        CR_FL_Seg_AziAngl_End_ST3: type-reference=CR_FL_Seg_AziAngl_End_ST3
        CR_FL_Seg_ElevAngl_Begin_ST3: type-reference=CR_FL_Seg_ElevAngl_Begin_ST3
        CR_FL_Seg_ElevAngl_End_ST3: type-reference=CR_FL_Seg_ElevAngl_End_ST3
        CR_FL_Seg_Range_Gain_ST3: type-reference=CR_FL_Seg_Range_Gain_ST3
        CR_FL_Seg_Range_Gain_RCS_ST3: type-reference=CR_FL_Seg_Range_Gain_RCS_ST3
        CR_FL_Seg_DetctnRange_Min_ST3: type-reference=CR_FL_Seg_DetctnRange_Min_ST3
        CR_FL_Seg_DetctnRange_Max_ST3: type-reference=CR_FL_Seg_DetctnRange_Max_ST3
        CR_FL_Seg_Blockage_Stat_ST3: type-reference=CR_FL_Seg_Blockage_Stat_ST3
        CR_FL_Seg_Redctn_Rsn_ST3: type-reference=CR_FL_Seg_Redctn_Rsn_ST3
        CR_FL_Seg_Redctn_Rsn_Prob_ST3: type-reference=CR_FL_Seg_Redctn_Rsn_Prob_ST3
    REC_CR_FL_Sens_OutputData_Pr7_ST3: category=STRUCTURE, type-emitter=TYPE_EMITTER_ARA
      namespaces:
        symbol props CR_Types_Namespace
      cpp implementation data type element CR_FL_Gen_Header_ST3: is-optional=false, type-reference=CR_FL_Gen_Header_ST3
      cpp implementation data type element CR_FL_Radar_Header_ST3: is-optional=false, type-reference=CR_FL_Radar_Header_ST3
      cpp implementation data type element CR_FL_Detection_ST3: is-optional=false, type-reference=CR_FL_Detection_ST3
    REC_CR_FL_SuppSens_Ifc_Pr6_ST3: category=STRUCTURE, type-emitter=TYPE_EMITTER_ARA
      namespaces:
        symbol props CR_Types_Namespace
      cpp implementation data type element CR_FL_SPI_Header_ST3: is-optional=false, type-reference=CR_FL_SPI_Header_ST3
      cpp implementation data type element CR_FL_Segment_ST3: is-optional=false, type-reference=CR_FL_Segment_ST3
      cpp implementation data type element CR_FL_SHI_Header_ST3: is-optional=false, type-reference=CR_FL_SHI_Header_ST3
    REC_CR_FR_Detection_ST3: category=STRUCTURE, type-emitter=TYPE_EMITTER_ARA
      namespaces:
        symbol props CR_Types_Namespace
      31 x cpp implementation data type element, all with is-optional=false:
        CR_FR_Dtctn_Existence_Prob_ST3: type-reference=CR_FR_Dtctn_Existence_Prob_ST3
        CR_FR_Dtctn_Azi_ST3: type-reference=CR_FR_Dtctn_Azi_ST3
        CR_FR_Dtctn_Elev_ST3: type-reference=CR_FR_Dtctn_Elev_ST3
        CR_FR_Dtctn_Dist_ST3: type-reference=CR_FR_Dtctn_Dist_ST3
        CR_FR_Dtctn_Azi_StdDev_ST3: type-reference=CR_FR_Dtctn_Azi_StdDev_ST3
        CR_FR_Dtctn_Elev_StdDev_ST3: type-reference=CR_FR_Dtctn_Elev_StdDev_ST3
        CR_FR_Dtctn_Dist_StdDev_ST3: type-reference=CR_FR_Dtctn_Dist_StdDev_ST3
        CR_FR_Dtctn_RadRelVelo_ST3: type-reference=CR_FR_Dtctn_RadRelVelo_ST3
        CR_FR_Dtctn_RadRelVelo_StdDev_ST3: type-reference=CR_FR_Dtctn_RadRelVelo_StdDev_ST3
        CR_FR_Dtctn_RadRelVelo_Ambgt_Resolv_ST3: type-reference=CR_FR_Dtctn_RadRelVelo_Ambgt_Resolv_ST3
        CR_FR_Dtctn_RCS_ST3: type-reference=CR_FR_Dtctn_RCS_ST3
        CR_FR_Dtctn_RCS_Err_ST3: type-reference=CR_FR_Dtctn_RCS_Err_ST3
        CR_FR_Dtctn_SNR_ST3: type-reference=CR_FR_Dtctn_SNR_ST3
        CR_FR_Dtct_SNR_Err_ST3: type-reference=CR_FR_Dtct_SNR_Err_ST3
        CR_FR_Dtctn_MultiTrgt_Probb_ST3: type-reference=CR_FR_Dtctn_MultiTrgt_Probb_ST3
        CR_FR_Dtctn_Ambgt_ID_ST3: type-reference=CR_FR_Dtctn_Ambgt_ID_ST3
        CR_FR_Dtctn_Ambgt_Probb_ST3: type-reference=CR_FR_Dtctn_Ambgt_Probb_ST3
        CR_FR_Dtctn_FreeSp_Probb_ST3: type-reference=CR_FR_Dtctn_FreeSp_Probb_ST3
        CR_FR_Dtctn_Micro_Doppler_Val_ST3: type-reference=CR_FR_Dtctn_Micro_Doppler_Val_ST3
        CR_FR_Dtctn_Azi_Qual_ST3: type-reference=CR_FR_Dtctn_Azi_Qual_ST3
        CR_FR_Dtctn_Elev_Qual_ST3: type-reference=CR_FR_Dtctn_Elev_Qual_ST3
        CR_FR_Dtctn_Dist_Qual_ST3: type-reference=CR_FR_Dtctn_Dist_Qual_ST3
        CR_FR_Dtctn_RadVelo_Qual_ST3: type-reference=CR_FR_Dtctn_RadVelo_Qual_ST3
        CR_FR_Dtctn_Meas_Model_ST3: type-reference=CR_FR_Dtctn_Meas_Model_ST3
        CR_FR_Dtctn_StaticObj_Stat_ST3: type-reference=CR_FR_Dtctn_StaticObj_Stat_ST3
        CR_FR_Dtctn_RxSig_Strength_ST3: type-reference=CR_FR_Dtctn_RxSig_Strength_ST3
        CR_FR_Dtctn_PeakDtct_Thrsld_ST3: type-reference=CR_FR_Dtctn_PeakDtct_Thrsld_ST3
        CR_FR_Dtctn_MaskAnglSect_Azi_ST3: type-reference=CR_FR_Dtctn_MaskAnglSect_Azi_ST3
        CR_FR_Dtctn_MaskAnglSect_Elev_ST3: type-reference=CR_FR_Dtctn_MaskAnglSect_Elev_ST3
        CR_FR_Dtctn_ID_Part1_ST3: type-reference=CR_FR_Dtctn_ID_Part1_ST3
        CR_FR_Dtctn_ID_Part2_ST3: type-reference=CR_FR_Dtctn_ID_Part2_ST3
    REC_CR_FR_Gen_Header_ST3: category=STRUCTURE, type-emitter=TYPE_EMITTER_ARA
      namespaces:
        symbol props CR_Types_Namespace
      11 x cpp implementation data type element, all with is-optional=false:
        CR_FR_SW_VerID_Major_ST3: type-reference=CR_FR_SW_VerID_Major_ST3
        CR_FR_SW_VerID_Minor_ST3: type-reference=CR_FR_SW_VerID_Minor_ST3
        CR_FR_SW_VerID_Patch_ST3: type-reference=CR_FR_SW_VerID_Patch_ST3
        CR_FR_SensorID_ST3: type-reference=CR_FR_SensorID_ST3
        CR_FR_Interface_ID_ST3: type-reference=CR_FR_Interface_ID_ST3
        CR_FR_Meas_TmStmp_ST3: type-reference=CR_FR_Meas_TmStmp_ST3
        CR_FR_Meas_Dur_ST3: type-reference=CR_FR_Meas_Dur_ST3
        CR_FR_Cycl_Count_ST3: type-reference=CR_FR_Cycl_Count_ST3
        CR_FR_Interface_CyclTime_ST3: type-reference=CR_FR_Interface_CyclTime_ST3
        CR_FR_Interface_CyclTime_Var_ST3: type-reference=CR_FR_Interface_CyclTime_Var_ST3
        CR_FR_Data_Qual_ST3: type-reference=CR_FR_Data_Qual_ST3
    REC_CR_FR_Radar_Header_ST3: category=STRUCTURE, type-emitter=TYPE_EMITTER_ARA
      namespaces:
        symbol props CR_Types_Namespace
      13 x cpp implementation data type element, all with is-optional=false:
        CR_FR_RadVelo_UpLmt_ST3: type-reference=CR_FR_RadVelo_UpLmt_ST3
        CR_FR_RadVelo_LowLmt_ST3: type-reference=CR_FR_RadVelo_LowLmt_ST3
        CR_FR_Dist_Range__ST3: type-reference=CR_FR_Dist_Range__ST3
        CR_FR_AziAngl_UpLmt_ST3: type-reference=CR_FR_AziAngl_UpLmt_ST3
        CR_FR_AziAngl_LowLmt_ST3: type-reference=CR_FR_AziAngl_LowLmt_ST3
        CR_FR_ElevAngl_UpLmt_ST3: type-reference=CR_FR_ElevAngl_UpLmt_ST3
        CR_FR_ElevAngl_LowLmt_ST3: type-reference=CR_FR_ElevAngl_LowLmt_ST3
        CR_FR_MaxDtctn_ST3: type-reference=CR_FR_MaxDtctn_ST3
        CR_FR_Dtctn_Stat_ST3: type-reference=CR_FR_Dtctn_Stat_ST3
        CR_FR_ValidDtctn_ST3: type-reference=CR_FR_ValidDtctn_ST3
        CR_FR_Moduln_Md_ST3: type-reference=CR_FR_Moduln_Md_ST3
        CR_FR_Dist_RadVelo_Cov_ST3: type-reference=CR_FR_Dist_RadVelo_Cov_ST3
        CR_FR_LowDist_Dtctn_Indicator_ST3: type-reference=CR_FR_LowDist_Dtctn_Indicator_ST3
    REC_CR_FR_SHI_Header_ST3: category=STRUCTURE, type-emitter=TYPE_EMITTER_ARA
      namespaces:
        symbol props CR_Types_Namespace
      27 x cpp implementation data type element, all with is-optional=false:
        CR_FR_Sens_Oprtn_Stat_ST3: type-reference=CR_FR_Sens_Oprtn_Stat_ST3
        CR_FR_Sens_Oprtn_Md_ST3: type-reference=CR_FR_Sens_Oprtn_Md_ST3
        CR_FR_Sens_Defect_Dtct_ST3: type-reference=CR_FR_Sens_Defect_Dtct_ST3
        CR_FR_Sens_Defect_Rsn_ST3: type-reference=CR_FR_Sens_Defect_Rsn_ST3
        CR_FR_Sens_Diag_Md_ST3: type-reference=CR_FR_Sens_Diag_Md_ST3
        CR_FR_Sens_Supp_Vtg_Stat_ST3: type-reference=CR_FR_Sens_Supp_Vtg_Stat_ST3
        CR_FR_Sens_Temp_Stat_ST3: type-reference=CR_FR_Sens_Temp_Stat_ST3
        CR_FR_Sens_Valid_InputSignals_Curr_ST3: type-reference=CR_FR_Sens_Valid_InputSignals_Curr_ST3
        CR_FR_Sens_Valid_InputSignals_Trgt_ST3: type-reference=CR_FR_Sens_Valid_InputSignals_Trgt_ST3
        CR_FR_Sens_Extern_Disturbnc_ST3: type-reference=CR_FR_Sens_Extern_Disturbnc_ST3
        CR_FR_Sens_Tx_PwrRedctn_Stat_ST3: type-reference=CR_FR_Sens_Tx_PwrRedctn_Stat_ST3
        CR_FR_Sens_Radom_Heat_Stat_ST3: type-reference=CR_FR_Sens_Radom_Heat_Stat_ST3
        CR_FR_Sens_TmSync_Stat_ST3: type-reference=CR_FR_Sens_TmSync_Stat_ST3
        CR_FR_Sens_GTS_Offset_ST3: type-reference=CR_FR_Sens_GTS_Offset_ST3
        CR_FR_Sens_Calib_Valid_Comp_ST3: type-reference=CR_FR_Sens_Calib_Valid_Comp_ST3
        CR_FR_Sens_Calib_Base_Stat_ST3: type-reference=CR_FR_Sens_Calib_Base_Stat_ST3
        CR_FR_Sens_Calib_Func_Stat_ST3: type-reference=CR_FR_Sens_Calib_Func_Stat_ST3
        CR_FR_Sens_Calib_SOC_Stat_ST3: type-reference=CR_FR_Sens_Calib_SOC_Stat_ST3
        CR_FR_Sens_Calib_Corrctn_Orient_Azi_ST3: type-reference=CR_FR_Sens_Calib_Corrctn_Orient_Azi_ST3
        CR_FR_Sens_Calib_Corrctn_Orient_Elev_ST3: type-reference=CR_FR_Sens_Calib_Corrctn_Orient_Elev_ST3
        CR_FR_Sens_Calib_Corrctn_Orient_Roll_ST3: type-reference=CR_FR_Sens_Calib_Corrctn_Orient_Roll_ST3
        CR_FR_Sens_Calib_Corrctn_UpLmt_Azi_ST3: type-reference=CR_FR_Sens_Calib_Corrctn_UpLmt_Azi_ST3
        CR_FR_Sens_Calib_Corrctn_UpLmt_Elev_ST3: type-reference=CR_FR_Sens_Calib_Corrctn_UpLmt_Elev_ST3
        CR_FR_Sens_Calib_Corrctn_UpLmt_Roll_ST3: type-reference=CR_FR_Sens_Calib_Corrctn_UpLmt_Roll_ST3
        CR_FR_Sens_Calib_Corrctn_LowLmt_Azi_ST3: type-reference=CR_FR_Sens_Calib_Corrctn_LowLmt_Azi_ST3
        CR_FR_Sens_Calib_Corrctn_LowLmt_Elev_ST3: type-reference=CR_FR_Sens_Calib_Corrctn_LowLmt_Elev_ST3
        CR_FR_Sens_Calib_Corrctn_LowLmt_Roll_ST3: type-reference=CR_FR_Sens_Calib_Corrctn_LowLmt_Roll_ST3
    REC_CR_FR_SPI_Header_ST3: category=STRUCTURE, type-emitter=TYPE_EMITTER_ARA
      namespaces:
        symbol props CR_Types_Namespace
      19 x cpp implementation data type element, all with is-optional=false:
        CR_FR_Sens_Origin_Pos_X_ST3: type-reference=CR_FR_Sens_Origin_Pos_X_ST3
        CR_FR_Sens_Origin_Pos_Y_ST3: type-reference=CR_FR_Sens_Origin_Pos_Y_ST3
        CR_FR_Sens_Origin_Pos_Z_ST3: type-reference=CR_FR_Sens_Origin_Pos_Z_ST3
        CR_FR_Sens_Origin_Pos_Err_X_ST3: type-reference=CR_FR_Sens_Origin_Pos_Err_X_ST3
        CR_FR_Sens_Origin_Pos_Err_Y_ST3: type-reference=CR_FR_Sens_Origin_Pos_Err_Y_ST3
        CR_FR_Sens_Origin_Pos_Err_Z_ST3: type-reference=CR_FR_Sens_Origin_Pos_Err_Z_ST3
        CR_FR_Sens_Orient_Azi_ST3: type-reference=CR_FR_Sens_Orient_Azi_ST3
        CR_FR_Sens_Orient_Elev_ST3: type-reference=CR_FR_Sens_Orient_Elev_ST3
        CR_FR_Sens_Orient_Roll_ST3: type-reference=CR_FR_Sens_Orient_Roll_ST3
        CR_FR_Sens_Orient_Err_Azi_ST3: type-reference=CR_FR_Sens_Orient_Err_Azi_ST3
        CR_FR_Sens_Orient_Err_Elev_ST3: type-reference=CR_FR_Sens_Orient_Err_Elev_ST3
        CR_FR_Sens_Orient_Err_Roll_ST3: type-reference=CR_FR_Sens_Orient_Err_Roll_ST3
        CR_FR_Sens_COS_Offset_X_ST3: type-reference=CR_FR_Sens_COS_Offset_X_ST3
        CR_FR_Sens_COS_Offset_Y_ST3: type-reference=CR_FR_Sens_COS_Offset_Y_ST3
        CR_FR_Sens_COS_Offset_Z_ST3: type-reference=CR_FR_Sens_COS_Offset_Z_ST3
        CR_FR_Sens_Valid_Seg_Azi_ST3: type-reference=CR_FR_Sens_Valid_Seg_Azi_ST3
        CR_FR_Sens_Valid_Seg_Elev_ST3: type-reference=CR_FR_Sens_Valid_Seg_Elev_ST3
        CR_FR_Sens_Total_Seg_Azi_ST3: type-reference=CR_FR_Sens_Total_Seg_Azi_ST3
        CR_FR_Sens_Total_Seg_Elev_ST3: type-reference=CR_FR_Sens_Total_Seg_Elev_ST3
    REC_CR_FR_Segment_ST3: category=STRUCTURE, type-emitter=TYPE_EMITTER_ARA
      namespaces:
        symbol props CR_Types_Namespace
      12 x cpp implementation data type element, all with is-optional=false:
        CR_FR_Seg_ID_ST3: type-reference=CR_FR_Seg_ID_ST3
        CR_FR_Seg_AziAngl_Begin_ST3: type-reference=CR_FR_Seg_AziAngl_Begin_ST3
        CR_FR_Seg_AziAngl_End_ST3: type-reference=CR_FR_Seg_AziAngl_End_ST3
        CR_FR_Seg_ElevAngl_Begin_ST3: type-reference=CR_FR_Seg_ElevAngl_Begin_ST3
        CR_FR_Seg_ElevAngl_End_ST3: type-reference=CR_FR_Seg_ElevAngl_End_ST3
        CR_FR_Seg_Range_Gain_ST3: type-reference=CR_FR_Seg_Range_Gain_ST3
        CR_FR_Seg_Range_Gain_RCS_ST3: type-reference=CR_FR_Seg_Range_Gain_RCS_ST3
        CR_FR_Seg_DetctnRange_Min_ST3: type-reference=CR_FR_Seg_DetctnRange_Min_ST3
        CR_FR_Seg_DetctnRange_Max_ST3: type-reference=CR_FR_Seg_DetctnRange_Max_ST3
        CR_FR_Seg_Blockage_Stat_ST3: type-reference=CR_FR_Seg_Blockage_Stat_ST3
        CR_FR_Seg_Redctn_Rsn_ST3: type-reference=CR_FR_Seg_Redctn_Rsn_ST3
        CR_FR_Seg_Redctn_Rsn_Prob_ST3: type-reference=CR_FR_Seg_Redctn_Rsn_Prob_ST3
    REC_CR_FR_Sens_OutputData_Pr7_ST3: category=STRUCTURE, type-emitter=TYPE_EMITTER_ARA
      namespaces:
        symbol props CR_Types_Namespace
      cpp implementation data type element CR_FR_Gen_Header_ST3: is-optional=false, type-reference=CR_FR_Gen_Header_ST3
      cpp implementation data type element CR_FR_Radar_Header_ST3: is-optional=false, type-reference=CR_FR_Radar_Header_ST3
      cpp implementation data type element CR_FR_Detection_ST3: is-optional=false, type-reference=CR_FR_Detection_ST3
    REC_CR_FR_SuppSens_Ifc_Pr6_ST3: category=STRUCTURE, type-emitter=TYPE_EMITTER_ARA
      namespaces:
        symbol props CR_Types_Namespace
      cpp implementation data type element CR_FR_SPI_Header_ST3: is-optional=false, type-reference=CR_FR_SPI_Header_ST3
      cpp implementation data type element CR_FR_Segment_ST3: is-optional=false, type-reference=CR_FR_Segment_ST3
      cpp implementation data type element CR_FR_SHI_Header_ST3: is-optional=false, type-reference=CR_FR_SHI_Header_ST3
    REC_CR_RL_Detection_ST3: category=STRUCTURE, type-emitter=TYPE_EMITTER_ARA
      namespaces:
        symbol props CR_Types_Namespace
      31 x cpp implementation data type element, all with is-optional=false:
        CR_RL_Dtctn_Existence_Prob_ST3: type-reference=CR_RL_Dtctn_Existence_Prob_ST3
        CR_RL_Dtctn_Azi_ST3: type-reference=CR_RL_Dtctn_Azi_ST3
        CR_RL_Dtctn_Elev_ST3: type-reference=CR_RL_Dtctn_Elev_ST3
        CR_RL_Dtctn_Dist_ST3: type-reference=CR_RL_Dtctn_Dist_ST3
        CR_RL_Dtctn_Azi_StdDev_ST3: type-reference=CR_RL_Dtctn_Azi_StdDev_ST3
        CR_RL_Dtctn_Elev_StdDev_ST3: type-reference=CR_RL_Dtctn_Elev_StdDev_ST3
        CR_RL_Dtctn_Dist_StdDev_ST3: type-reference=CR_RL_Dtctn_Dist_StdDev_ST3
        CR_RL_Dtctn_RadRelVelo_ST3: type-reference=CR_RL_Dtctn_RadRelVelo_ST3
        CR_RL_Dtctn_RadRelVelo_StdDev_ST3: type-reference=CR_RL_Dtctn_RadRelVelo_StdDev_ST3
        CR_RL_Dtctn_RadRelVelo_Ambgt_Resolv_ST3: type-reference=CR_RL_Dtctn_RadRelVelo_Ambgt_Resolv_ST3
        CR_RL_Dtctn_RCS_ST3: type-reference=CR_RL_Dtctn_RCS_ST3
        CR_RL_Dtctn_RCS_Err_ST3: type-reference=CR_RL_Dtctn_RCS_Err_ST3
        CR_RL_Dtctn_SNR_ST3: type-reference=CR_RL_Dtctn_SNR_ST3
        CR_RL_Dtct_SNR_Err_ST3: type-reference=CR_RL_Dtct_SNR_Err_ST3
        CR_RL_Dtctn_MultiTrgt_Probb_ST3: type-reference=CR_RL_Dtctn_MultiTrgt_Probb_ST3
        CR_RL_Dtctn_Ambgt_ID_ST3: type-reference=CR_RL_Dtctn_Ambgt_ID_ST3
        CR_RL_Dtctn_Ambgt_Probb_ST3: type-reference=CR_RL_Dtctn_Ambgt_Probb_ST3
        CR_RL_Dtctn_FreeSp_Probb_ST3: type-reference=CR_RL_Dtctn_FreeSp_Probb_ST3
        CR_RL_Dtctn_Micro_Doppler_Val_ST3: type-reference=CR_RL_Dtctn_Micro_Doppler_Val_ST3
        CR_RL_Dtctn_Azi_Qual_ST3: type-reference=CR_RL_Dtctn_Azi_Qual_ST3
        CR_RL_Dtctn_Elev_Qual_ST3: type-reference=CR_RL_Dtctn_Elev_Qual_ST3
        CR_RL_Dtctn_Dist_Qual_ST3: type-reference=CR_RL_Dtctn_Dist_Qual_ST3
        CR_RL_Dtctn_RadVelo_Qual_ST3: type-reference=CR_RL_Dtctn_RadVelo_Qual_ST3
        CR_RL_Dtctn_Meas_Model_ST3: type-reference=CR_RL_Dtctn_Meas_Model_ST3
        CR_RL_Dtctn_StaticObj_Stat_ST3: type-reference=CR_RL_Dtctn_StaticObj_Stat_ST3
        CR_RL_Dtctn_RxSig_Strength_ST3: type-reference=CR_RL_Dtctn_RxSig_Strength_ST3
        CR_RL_Dtctn_PeakDtct_Thrsld_ST3: type-reference=CR_RL_Dtctn_PeakDtct_Thrsld_ST3
        CR_RL_Dtctn_MaskAnglSect_Azi_ST3: type-reference=CR_RL_Dtctn_MaskAnglSect_Azi_ST3
        CR_RL_Dtctn_MaskAnglSect_Elev_ST3: type-reference=CR_RL_Dtctn_MaskAnglSect_Elev_ST3
        CR_RL_Dtctn_ID_Part1_ST3: type-reference=CR_RL_Dtctn_ID_Part1_ST3
        CR_RL_Dtctn_ID_Part2_ST3: type-reference=CR_RL_Dtctn_ID_Part2_ST3
    REC_CR_RL_Gen_Header_ST3: category=STRUCTURE, type-emitter=TYPE_EMITTER_ARA
      namespaces:
        symbol props CR_Types_Namespace
      11 x cpp implementation data type element, all with is-optional=false:
        CR_RL_SW_VerID_Major_ST3: type-reference=CR_RL_SW_VerID_Major_ST3
        CR_RL_SW_VerID_Minor_ST3: type-reference=CR_RL_SW_VerID_Minor_ST3
        CR_RL_SW_VerID_Patch_ST3: type-reference=CR_RL_SW_VerID_Patch_ST3
        CR_RL_SensorID_ST3: type-reference=CR_RL_SensorID_ST3
        CR_RL_Interface_ID_ST3: type-reference=CR_RL_Interface_ID_ST3
        CR_RL_Meas_TmStmp_ST3: type-reference=CR_RL_Meas_TmStmp_ST3
        CR_RL_Meas_Dur_ST3: type-reference=CR_RL_Meas_Dur_ST3
        CR_RL_Cycl_Count_ST3: type-reference=CR_RL_Cycl_Count_ST3
        CR_RL_Interface_CyclTime_ST3: type-reference=CR_RL_Interface_CyclTime_ST3
        CR_RL_Interface_CyclTime_Var_ST3: type-reference=CR_RL_Interface_CyclTime_Var_ST3
        CR_RL_Data_Qual_ST3: type-reference=CR_RL_Data_Qual_ST3
    REC_CR_RL_Radar_Header_ST3: category=STRUCTURE, type-emitter=TYPE_EMITTER_ARA
      namespaces:
        symbol props CR_Types_Namespace
      13 x cpp implementation data type element, all with is-optional=false:
        CR_RL_RadVelo_UpLmt_ST3: type-reference=CR_RL_RadVelo_UpLmt_ST3
        CR_RL_RadVelo_LowLmt_ST3: type-reference=CR_RL_RadVelo_LowLmt_ST3
        CR_RL_Dist_Range__ST3: type-reference=CR_RL_Dist_Range__ST3
        CR_RL_AziAngl_UpLmt_ST3: type-reference=CR_RL_AziAngl_UpLmt_ST3
        CR_RL_AziAngl_LowLmt_ST3: type-reference=CR_RL_AziAngl_LowLmt_ST3
        CR_RL_ElevAngl_UpLmt_ST3: type-reference=CR_RL_ElevAngl_UpLmt_ST3
        CR_RL_ElevAngl_LowLmt_ST3: type-reference=CR_RL_ElevAngl_LowLmt_ST3
        CR_RL_MaxDtctn_ST3: type-reference=CR_RL_MaxDtctn_ST3
        CR_RL_Dtctn_Stat_ST3: type-reference=CR_RL_Dtctn_Stat_ST3
        CR_RL_ValidDtctn_ST3: type-reference=CR_RL_ValidDtctn_ST3
        CR_RL_Moduln_Md_ST3: type-reference=CR_RL_Moduln_Md_ST3
        CR_RL_Dist_RadVelo_Cov_ST3: type-reference=CR_RL_Dist_RadVelo_Cov_ST3
        CR_RL_LowDist_Dtctn_Indicator_ST3: type-reference=CR_RL_LowDist_Dtctn_Indicator_ST3
    REC_CR_RL_SHI_Header_ST3: category=STRUCTURE, type-emitter=TYPE_EMITTER_ARA
      namespaces:
        symbol props CR_Types_Namespace
      27 x cpp implementation data type element, all with is-optional=false:
        CR_RL_Sens_Oprtn_Stat_ST3: type-reference=CR_RL_Sens_Oprtn_Stat_ST3
        CR_RL_Sens_Oprtn_Md_ST3: type-reference=CR_RL_Sens_Oprtn_Md_ST3
        CR_RL_Sens_Defect_Dtct_ST3: type-reference=CR_RL_Sens_Defect_Dtct_ST3
        CR_RL_Sens_Defect_Rsn_ST3: type-reference=CR_RL_Sens_Defect_Rsn_ST3
        CR_RL_Sens_Diag_Md_ST3: type-reference=CR_RL_Sens_Diag_Md_ST3
        CR_RL_Sens_Supp_Vtg_Stat_ST3: type-reference=CR_RL_Sens_Supp_Vtg_Stat_ST3
        CR_RL_Sens_Temp_Stat_ST3: type-reference=CR_RL_Sens_Temp_Stat_ST3
        CR_RL_Sens_Valid_InputSignals_Curr_ST3: type-reference=CR_RL_Sens_Valid_InputSignals_Curr_ST3
        CR_RL_Sens_Valid_InputSignals_Trgt_ST3: type-reference=CR_RL_Sens_Valid_InputSignals_Trgt_ST3
        CR_RL_Sens_Extern_Disturbnc_ST3: type-reference=CR_RL_Sens_Extern_Disturbnc_ST3
        CR_RL_Sens_Tx_PwrRedctn_Stat_ST3: type-reference=CR_RL_Sens_Tx_PwrRedctn_Stat_ST3
        CR_RL_Sens_Radom_Heat_Stat_ST3: type-reference=CR_RL_Sens_Radom_Heat_Stat_ST3
        CR_RL_Sens_TmSync_Stat_ST3: type-reference=CR_RL_Sens_TmSync_Stat_ST3
        CR_RL_Sens_GTS_Offset_ST3: type-reference=CR_RL_Sens_GTS_Offset_ST3
        CR_RL_Sens_Calib_Valid_Comp_ST3: type-reference=CR_RL_Sens_Calib_Valid_Comp_ST3
        CR_RL_Sens_Calib_Base_Stat_ST3: type-reference=CR_RL_Sens_Calib_Base_Stat_ST3
        CR_RL_Sens_Calib_Func_Stat_ST3: type-reference=CR_RL_Sens_Calib_Func_Stat_ST3
        CR_RL_Sens_Calib_SOC_Stat_ST3: type-reference=CR_RL_Sens_Calib_SOC_Stat_ST3
        CR_RL_Sens_Calib_Corrctn_Orient_Azi_ST3: type-reference=CR_RL_Sens_Calib_Corrctn_Orient_Azi_ST3
        CR_RL_Sens_Calib_Corrctn_Orient_Elev_ST3: type-reference=CR_RL_Sens_Calib_Corrctn_Orient_Elev_ST3
        CR_RL_Sens_Calib_Corrctn_Orient_Roll_ST3: type-reference=CR_RL_Sens_Calib_Corrctn_Orient_Roll_ST3
        CR_RL_Sens_Calib_Corrctn_UpLmt_Azi_ST3: type-reference=CR_RL_Sens_Calib_Corrctn_UpLmt_Azi_ST3
        CR_RL_Sens_Calib_Corrctn_UpLmt_Elev_ST3: type-reference=CR_RL_Sens_Calib_Corrctn_UpLmt_Elev_ST3
        CR_RL_Sens_Calib_Corrctn_UpLmt_Roll_ST3: type-reference=CR_RL_Sens_Calib_Corrctn_UpLmt_Roll_ST3
        CR_RL_Sens_Calib_Corrctn_LowLmt_Azi_ST3: type-reference=CR_RL_Sens_Calib_Corrctn_LowLmt_Azi_ST3
        CR_RL_Sens_Calib_Corrctn_LowLmt_Elev_ST3: type-reference=CR_RL_Sens_Calib_Corrctn_LowLmt_Elev_ST3
        CR_RL_Sens_Calib_Corrctn_LowLmt_Roll_ST3: type-reference=CR_RL_Sens_Calib_Corrctn_LowLmt_Roll_ST3
    REC_CR_RL_SPI_Header_ST3: category=STRUCTURE, type-emitter=TYPE_EMITTER_ARA
      namespaces:
        symbol props CR_Types_Namespace
      19 x cpp implementation data type element, all with is-optional=false:
        CR_RL_Sens_Origin_Pos_X_ST3: type-reference=CR_RL_Sens_Origin_Pos_X_ST3
        CR_RL_Sens_Origin_Pos_Y_ST3: type-reference=CR_RL_Sens_Origin_Pos_Y_ST3
        CR_RL_Sens_Origin_Pos_Z_ST3: type-reference=CR_RL_Sens_Origin_Pos_Z_ST3
        CR_RL_Sens_Origin_Pos_Err_X_ST3: type-reference=CR_RL_Sens_Origin_Pos_Err_X_ST3
        CR_RL_Sens_Origin_Pos_Err_Y_ST3: type-reference=CR_RL_Sens_Origin_Pos_Err_Y_ST3
        CR_RL_Sens_Origin_Pos_Err_Z_ST3: type-reference=CR_RL_Sens_Origin_Pos_Err_Z_ST3
        CR_RL_Sens_Orient_Azi_ST3: type-reference=CR_RL_Sens_Orient_Azi_ST3
        CR_RL_Sens_Orient_Elev_ST3: type-reference=CR_RL_Sens_Orient_Elev_ST3
        CR_RL_Sens_Orient_Roll_ST3: type-reference=CR_RL_Sens_Orient_Roll_ST3
        CR_RL_Sens_Orient_Err_Azi_ST3: type-reference=CR_RL_Sens_Orient_Err_Azi_ST3
        CR_RL_Sens_Orient_Err_Elev_ST3: type-reference=CR_RL_Sens_Orient_Err_Elev_ST3
        CR_RL_Sens_Orient_Err_Roll_ST3: type-reference=CR_RL_Sens_Orient_Err_Roll_ST3
        CR_RL_Sens_COS_Offset_X_ST3: type-reference=CR_RL_Sens_COS_Offset_X_ST3
        CR_RL_Sens_COS_Offset_Y_ST3: type-reference=CR_RL_Sens_COS_Offset_Y_ST3
        CR_RL_Sens_COS_Offset_Z_ST3: type-reference=CR_RL_Sens_COS_Offset_Z_ST3
        CR_RL_Sens_Valid_Seg_Azi_ST3: type-reference=CR_RL_Sens_Valid_Seg_Azi_ST3
        CR_RL_Sens_Valid_Seg_Elev_ST3: type-reference=CR_RL_Sens_Valid_Seg_Elev_ST3
        CR_RL_Sens_Total_Seg_Azi_ST3: type-reference=CR_RL_Sens_Total_Seg_Azi_ST3
        CR_RL_Sens_Total_Seg_Elev_ST3: type-reference=CR_RL_Sens_Total_Seg_Elev_ST3
    REC_CR_RL_Segment_ST3: category=STRUCTURE, type-emitter=TYPE_EMITTER_ARA
      namespaces:
        symbol props CR_Types_Namespace
      12 x cpp implementation data type element, all with is-optional=false:
        CR_RL_Seg_ID_ST3: type-reference=CR_RL_Seg_ID_ST3
        CR_RL_Seg_AziAngl_Begin_ST3: type-reference=CR_RL_Seg_AziAngl_Begin_ST3
        CR_RL_Seg_AziAngl_End_ST3: type-reference=CR_RL_Seg_AziAngl_End_ST3
        CR_RL_Seg_ElevAngl_Begin_ST3: type-reference=CR_RL_Seg_ElevAngl_Begin_ST3
        CR_RL_Seg_ElevAngl_End_ST3: type-reference=CR_RL_Seg_ElevAngl_End_ST3
        CR_RL_Seg_Range_Gain_ST3: type-reference=CR_RL_Seg_Range_Gain_ST3
        CR_RL_Seg_Range_Gain_RCS_ST3: type-reference=CR_RL_Seg_Range_Gain_RCS_ST3
        CR_RL_Seg_DetctnRange_Min_ST3: type-reference=CR_RL_Seg_DetctnRange_Min_ST3
        CR_RL_Seg_DetctnRange_Max_ST3: type-reference=CR_RL_Seg_DetctnRange_Max_ST3
        CR_RL_Seg_Blockage_Stat_ST3: type-reference=CR_RL_Seg_Blockage_Stat_ST3
        CR_RL_Seg_Redctn_Rsn_ST3: type-reference=CR_RL_Seg_Redctn_Rsn_ST3
        CR_RL_Seg_Redctn_Rsn_Prob_ST3: type-reference=CR_RL_Seg_Redctn_Rsn_Prob_ST3
    REC_CR_RL_Sens_OutputData_Pr7_ST3: category=STRUCTURE, type-emitter=TYPE_EMITTER_ARA
      namespaces:
        symbol props CR_Types_Namespace
      cpp implementation data type element CR_RL_Gen_Header_ST3: is-optional=false, type-reference=CR_RL_Gen_Header_ST3
      cpp implementation data type element CR_RL_Radar_Header_ST3: is-optional=false, type-reference=CR_RL_Radar_Header_ST3
      cpp implementation data type element CR_RL_Detection_ST3: is-optional=false, type-reference=CR_RL_Detection_ST3
    REC_CR_RL_SuppSens_Ifc_Pr6_ST3: category=STRUCTURE, type-emitter=TYPE_EMITTER_ARA
      namespaces:
        symbol props CR_Types_Namespace
      cpp implementation data type element CR_RL_SPI_Header_ST3: is-optional=false, type-reference=CR_RL_SPI_Header_ST3
      cpp implementation data type element CR_RL_Segment_ST3: is-optional=false, type-reference=CR_RL_Segment_ST3
      cpp implementation data type element CR_RL_SHI_Header_ST3: is-optional=false, type-reference=CR_RL_SHI_Header_ST3
    REC_CR_RR_Detection_ST3: category=STRUCTURE, type-emitter=TYPE_EMITTER_ARA
      namespaces:
        symbol props CR_Types_Namespace
      31 x cpp implementation data type element, all with is-optional=false:
        CR_RR_Dtctn_Existence_Prob_ST3: type-reference=CR_RR_Dtctn_Existence_Prob_ST3
        CR_RR_Dtctn_Azi_ST3: type-reference=CR_RR_Dtctn_Azi_ST3
        CR_RR_Dtctn_Elev_ST3: type-reference=CR_RR_Dtctn_Elev_ST3
        CR_RR_Dtctn_Dist_ST3: type-reference=CR_RR_Dtctn_Dist_ST3
        CR_RR_Dtctn_Azi_StdDev_ST3: type-reference=CR_RR_Dtctn_Azi_StdDev_ST3
        CR_RR_Dtctn_Elev_StdDev_ST3: type-reference=CR_RR_Dtctn_Elev_StdDev_ST3
        CR_RR_Dtctn_Dist_StdDev_ST3: type-reference=CR_RR_Dtctn_Dist_StdDev_ST3
        CR_RR_Dtctn_RadRelVelo_ST3: type-reference=CR_RR_Dtctn_RadRelVelo_ST3
        CR_RR_Dtctn_RadRelVelo_StdDev_ST3: type-reference=CR_RR_Dtctn_RadRelVelo_StdDev_ST3
        CR_RR_Dtctn_RadRelVelo_Ambgt_Resolv_ST3: type-reference=CR_RR_Dtctn_RadRelVelo_Ambgt_Resolv_ST3
        CR_RR_Dtctn_RCS_ST3: type-reference=CR_RR_Dtctn_RCS_ST3
        CR_RR_Dtctn_RCS_Err_ST3: type-reference=CR_RR_Dtctn_RCS_Err_ST3
        CR_RR_Dtctn_SNR_ST3: type-reference=CR_RR_Dtctn_SNR_ST3
        CR_RR_Dtct_SNR_Err_ST3: type-reference=CR_RR_Dtct_SNR_Err_ST3
        CR_RR_Dtctn_MultiTrgt_Probb_ST3: type-reference=CR_RR_Dtctn_MultiTrgt_Probb_ST3
        CR_RR_Dtctn_Ambgt_ID_ST3: type-reference=CR_RR_Dtctn_Ambgt_ID_ST3
        CR_RR_Dtctn_Ambgt_Probb_ST3: type-reference=CR_RR_Dtctn_Ambgt_Probb_ST3
        CR_RR_Dtctn_FreeSp_Probb_ST3: type-reference=CR_RR_Dtctn_FreeSp_Probb_ST3
        CR_RR_Dtctn_Micro_Doppler_Val_ST3: type-reference=CR_RR_Dtctn_Micro_Doppler_Val_ST3
        CR_RR_Dtctn_Azi_Qual_ST3: type-reference=CR_RR_Dtctn_Azi_Qual_ST3
        CR_RR_Dtctn_Elev_Qual_ST3: type-reference=CR_RR_Dtctn_Elev_Qual_ST3
        CR_RR_Dtctn_Dist_Qual_ST3: type-reference=CR_RR_Dtctn_Dist_Qual_ST3
        CR_RR_Dtctn_RadVelo_Qual_ST3: type-reference=CR_RR_Dtctn_RadVelo_Qual_ST3
        CR_RR_Dtctn_Meas_Model_ST3: type-reference=CR_RR_Dtctn_Meas_Model_ST3
        CR_RR_Dtctn_StaticObj_Stat_ST3: type-reference=CR_RR_Dtctn_StaticObj_Stat_ST3
        CR_RR_Dtctn_RxSig_Strength_ST3: type-reference=CR_RR_Dtctn_RxSig_Strength_ST3
        CR_RR_Dtctn_PeakDtct_Thrsld_ST3: type-reference=CR_RR_Dtctn_PeakDtct_Thrsld_ST3
        CR_RR_Dtctn_MaskAnglSect_Azi_ST3: type-reference=CR_RR_Dtctn_MaskAnglSect_Azi_ST3
        CR_RR_Dtctn_MaskAnglSect_Elev_ST3: type-reference=CR_RR_Dtctn_MaskAnglSect_Elev_ST3
        CR_RR_Dtctn_ID_Part1_ST3: type-reference=CR_RR_Dtctn_ID_Part1_ST3
        CR_RR_Dtctn_ID_Part2_ST3: type-reference=CR_RR_Dtctn_ID_Part2_ST3
    REC_CR_RR_Gen_Header_ST3: category=STRUCTURE, type-emitter=TYPE_EMITTER_ARA
      namespaces:
        symbol props CR_Types_Namespace
      11 x cpp implementation data type element, all with is-optional=false:
        CR_RR_SW_VerID_Major_ST3: type-reference=CR_RR_SW_VerID_Major_ST3
        CR_RR_SW_VerID_Minor_ST3: type-reference=CR_RR_SW_VerID_Minor_ST3
        CR_RR_SW_VerID_Patch_ST3: type-reference=CR_RR_SW_VerID_Patch_ST3
        CR_RR_SensorID_ST3: type-reference=CR_RR_SensorID_ST3
        CR_RR_Interface_ID_ST3: type-reference=CR_RR_Interface_ID_ST3
        CR_RR_Meas_TmStmp_ST3: type-reference=CR_RR_Meas_TmStmp_ST3
        CR_RR_Meas_Dur_ST3: type-reference=CR_RR_Meas_Dur_ST3
        CR_RR_Cycl_Count_ST3: type-reference=CR_RR_Cycl_Count_ST3
        CR_RR_Interface_CyclTime_ST3: type-reference=CR_RR_Interface_CyclTime_ST3
        CR_RR_Interface_CyclTime_Var_ST3: type-reference=CR_RR_Interface_CyclTime_Var_ST3
        CR_RR_Data_Qual_ST3: type-reference=CR_RR_Data_Qual_ST3
    REC_CR_RR_Radar_Header_ST3: category=STRUCTURE, type-emitter=TYPE_EMITTER_ARA
      namespaces:
        symbol props CR_Types_Namespace
      13 x cpp implementation data type element, all with is-optional=false:
        CR_RR_RadVelo_UpLmt_ST3: type-reference=CR_RR_RadVelo_UpLmt_ST3
        CR_RR_RadVelo_LowLmt_ST3: type-reference=CR_RR_RadVelo_LowLmt_ST3
        CR_RR_Dist_Range__ST3: type-reference=CR_RR_Dist_Range__ST3
        CR_RR_AziAngl_UpLmt_ST3: type-reference=CR_RR_AziAngl_UpLmt_ST3
        CR_RR_AziAngl_LowLmt_ST3: type-reference=CR_RR_AziAngl_LowLmt_ST3
        CR_RR_ElevAngl_UpLmt_ST3: type-reference=CR_RR_ElevAngl_UpLmt_ST3
        CR_RR_ElevAngl_LowLmt_ST3: type-reference=CR_RR_ElevAngl_LowLmt_ST3
        CR_RR_MaxDtctn_ST3: type-reference=CR_RR_MaxDtctn_ST3
        CR_RR_Dtctn_Stat_ST3: type-reference=CR_RR_Dtctn_Stat_ST3
        CR_RR_ValidDtctn_ST3: type-reference=CR_RR_ValidDtctn_ST3
        CR_RR_Moduln_Md_ST3: type-reference=CR_RR_Moduln_Md_ST3
        CR_RR_Dist_RadVelo_Cov_ST3: type-reference=CR_RR_Dist_RadVelo_Cov_ST3
        CR_RR_LowDist_Dtctn_Indicator_ST3: type-reference=CR_RR_LowDist_Dtctn_Indicator_ST3
    REC_CR_RR_SHI_Header_ST3: category=STRUCTURE, type-emitter=TYPE_EMITTER_ARA
      namespaces:
        symbol props CR_Types_Namespace
      27 x cpp implementation data type element, all with is-optional=false:
        CR_RR_Sens_Oprtn_Stat_ST3: type-reference=CR_RR_Sens_Oprtn_Stat_ST3
        CR_RR_Sens_Oprtn_Md_ST3: type-reference=CR_RR_Sens_Oprtn_Md_ST3
        CR_RR_Sens_Defect_Dtct_ST3: type-reference=CR_RR_Sens_Defect_Dtct_ST3
        CR_RR_Sens_Defect_Rsn_ST3: type-reference=CR_RR_Sens_Defect_Rsn_ST3
        CR_RR_Sens_Diag_Md_ST3: type-reference=CR_RR_Sens_Diag_Md_ST3
        CR_RR_Sens_Supp_Vtg_Stat_ST3: type-reference=CR_RR_Sens_Supp_Vtg_Stat_ST3
        CR_RR_Sens_Temp_Stat_ST3: type-reference=CR_RR_Sens_Temp_Stat_ST3
        CR_RR_Sens_Valid_InputSignals_Curr_ST3: type-reference=CR_RR_Sens_Valid_InputSignals_Curr_ST3
        CR_RR_Sens_Valid_InputSignals_Trgt_ST3: type-reference=CR_RR_Sens_Valid_InputSignals_Trgt_ST3
        CR_RR_Sens_Extern_Disturbnc_ST3: type-reference=CR_RR_Sens_Extern_Disturbnc_ST3
        CR_RR_Sens_Tx_PwrRedctn_Stat_ST3: type-reference=CR_RR_Sens_Tx_PwrRedctn_Stat_ST3
        CR_RR_Sens_Radom_Heat_Stat_ST3: type-reference=CR_RR_Sens_Radom_Heat_Stat_ST3
        CR_RR_Sens_TmSync_Stat_ST3: type-reference=CR_RR_Sens_TmSync_Stat_ST3
        CR_RR_Sens_GTS_Offset_ST3: type-reference=CR_RR_Sens_GTS_Offset_ST3
        CR_RR_Sens_Calib_Valid_Comp_ST3: type-reference=CR_RR_Sens_Calib_Valid_Comp_ST3
        CR_RR_Sens_Calib_Base_Stat_ST3: type-reference=CR_RR_Sens_Calib_Base_Stat_ST3
        CR_RR_Sens_Calib_Func_Stat_ST3: type-reference=CR_RR_Sens_Calib_Func_Stat_ST3
        CR_RR_Sens_Calib_SOC_Stat_ST3: type-reference=CR_RR_Sens_Calib_SOC_Stat_ST3
        CR_RR_Sens_Calib_Corrctn_Orient_Azi_ST3: type-reference=CR_RR_Sens_Calib_Corrctn_Orient_Azi_ST3
        CR_RR_Sens_Calib_Corrctn_Orient_Elev_ST3: type-reference=CR_RR_Sens_Calib_Corrctn_Orient_Elev_ST3
        CR_RR_Sens_Calib_Corrctn_Orient_Roll_ST3: type-reference=CR_RR_Sens_Calib_Corrctn_Orient_Roll_ST3
        CR_RR_Sens_Calib_Corrctn_UpLmt_Azi_ST3: type-reference=CR_RR_Sens_Calib_Corrctn_UpLmt_Azi_ST3
        CR_RR_Sens_Calib_Corrctn_UpLmt_Elev_ST3: type-reference=CR_RR_Sens_Calib_Corrctn_UpLmt_Elev_ST3
        CR_RR_Sens_Calib_Corrctn_UpLmt_Roll_ST3: type-reference=CR_RR_Sens_Calib_Corrctn_UpLmt_Roll_ST3
        CR_RR_Sens_Calib_Corrctn_LowLmt_Azi_ST3: type-reference=CR_RR_Sens_Calib_Corrctn_LowLmt_Azi_ST3
        CR_RR_Sens_Calib_Corrctn_LowLmt_Elev_ST3: type-reference=CR_RR_Sens_Calib_Corrctn_LowLmt_Elev_ST3
        CR_RR_Sens_Calib_Corrctn_LowLmt_Roll_ST3: type-reference=CR_RR_Sens_Calib_Corrctn_LowLmt_Roll_ST3
    REC_CR_RR_SPI_Header_ST3: category=STRUCTURE, type-emitter=TYPE_EMITTER_ARA
      namespaces:
        symbol props CR_Types_Namespace
      19 x cpp implementation data type element, all with is-optional=false:
        CR_RR_Sens_Origin_Pos_X_ST3: type-reference=CR_RR_Sens_Origin_Pos_X_ST3
        CR_RR_Sens_Origin_Pos_Y_ST3: type-reference=CR_RR_Sens_Origin_Pos_Y_ST3
        CR_RR_Sens_Origin_Pos_Z_ST3: type-reference=CR_RR_Sens_Origin_Pos_Z_ST3
        CR_RR_Sens_Origin_Pos_Err_X_ST3: type-reference=CR_RR_Sens_Origin_Pos_Err_X_ST3
        CR_RR_Sens_Origin_Pos_Err_Y_ST3: type-reference=CR_RR_Sens_Origin_Pos_Err_Y_ST3
        CR_RR_Sens_Origin_Pos_Err_Z_ST3: type-reference=CR_RR_Sens_Origin_Pos_Err_Z_ST3
        CR_RR_Sens_Orient_Azi_ST3: type-reference=CR_RR_Sens_Orient_Azi_ST3
        CR_RR_Sens_Orient_Elev_ST3: type-reference=CR_RR_Sens_Orient_Elev_ST3
        CR_RR_Sens_Orient_Roll_ST3: type-reference=CR_RR_Sens_Orient_Roll_ST3
        CR_RR_Sens_Orient_Err_Azi_ST3: type-reference=CR_RR_Sens_Orient_Err_Azi_ST3
        CR_RR_Sens_Orient_Err_Elev_ST3: type-reference=CR_RR_Sens_Orient_Err_Elev_ST3
        CR_RR_Sens_Orient_Err_Roll_ST3: type-reference=CR_RR_Sens_Orient_Err_Roll_ST3
        CR_RR_Sens_COS_Offset_X_ST3: type-reference=CR_RR_Sens_COS_Offset_X_ST3
        CR_RR_Sens_COS_Offset_Y_ST3: type-reference=CR_RR_Sens_COS_Offset_Y_ST3
        CR_RR_Sens_COS_Offset_Z_ST3: type-reference=CR_RR_Sens_COS_Offset_Z_ST3
        CR_RR_Sens_Valid_Seg_Azi_ST3: type-reference=CR_RR_Sens_Valid_Seg_Azi_ST3
        CR_RR_Sens_Valid_Seg_Elev_ST3: type-reference=CR_RR_Sens_Valid_Seg_Elev_ST3
        CR_RR_Sens_Total_Seg_Azi_ST3: type-reference=CR_RR_Sens_Total_Seg_Azi_ST3
        CR_RR_Sens_Total_Seg_Elev_ST3: type-reference=CR_RR_Sens_Total_Seg_Elev_ST3
    REC_CR_RR_Segment_ST3: category=STRUCTURE, type-emitter=TYPE_EMITTER_ARA
      namespaces:
        symbol props CR_Types_Namespace
      12 x cpp implementation data type element, all with is-optional=false:
        CR_RR_Seg_ID_ST3: type-reference=CR_RR_Seg_ID_ST3
        CR_RR_Seg_AziAngl_Begin_ST3: type-reference=CR_RR_Seg_AziAngl_Begin_ST3
        CR_RR_Seg_AziAngl_End_ST3: type-reference=CR_RR_Seg_AziAngl_End_ST3
        CR_RR_Seg_ElevAngl_Begin_ST3: type-reference=CR_RR_Seg_ElevAngl_Begin_ST3
        CR_RR_Seg_ElevAngl_End_ST3: type-reference=CR_RR_Seg_ElevAngl_End_ST3
        CR_RR_Seg_Range_Gain_ST3: type-reference=CR_RR_Seg_Range_Gain_ST3
        CR_RR_Seg_Range_Gain_RCS_ST3: type-reference=CR_RR_Seg_Range_Gain_RCS_ST3
        CR_RR_Seg_DetctnRange_Min_ST3: type-reference=CR_RR_Seg_DetctnRange_Min_ST3
        CR_RR_Seg_DetctnRange_Max_ST3: type-reference=CR_RR_Seg_DetctnRange_Max_ST3
        CR_RR_Seg_Blockage_Stat_ST3: type-reference=CR_RR_Seg_Blockage_Stat_ST3
        CR_RR_Seg_Redctn_Rsn_ST3: type-reference=CR_RR_Seg_Redctn_Rsn_ST3
        CR_RR_Seg_Redctn_Rsn_Prob_ST3: type-reference=CR_RR_Seg_Redctn_Rsn_Prob_ST3
    REC_CR_RR_Sens_OutputData_Pr7_ST3: category=STRUCTURE, type-emitter=TYPE_EMITTER_ARA
      namespaces:
        symbol props CR_Types_Namespace
      cpp implementation data type element CR_RR_Gen_Header_ST3: is-optional=false, type-reference=CR_RR_Gen_Header_ST3
      cpp implementation data type element CR_RR_Radar_Header_ST3: is-optional=false, type-reference=CR_RR_Radar_Header_ST3
      cpp implementation data type element CR_RR_Detection_ST3: is-optional=false, type-reference=CR_RR_Detection_ST3
    REC_CR_RR_SuppSens_Ifc_Pr6_ST3: category=STRUCTURE, type-emitter=TYPE_EMITTER_ARA
      namespaces:
        symbol props CR_Types_Namespace
      cpp implementation data type element CR_RR_SPI_Header_ST3: is-optional=false, type-reference=CR_RR_SPI_Header_ST3
      cpp implementation data type element CR_RR_Segment_ST3: is-optional=false, type-reference=CR_RR_Segment_ST3
      cpp implementation data type element CR_RR_SHI_Header_ST3: is-optional=false, type-reference=CR_RR_SHI_Header_ST3
    REC_DI_Odo_Pr5_ST3: category=STRUCTURE, type-emitter=TYPE_EMITTER_ARA
      namespaces:
        symbol props REC_DI_Odo_Pr5_ST3_
      cpp implementation data type element CRC_DI_Odo_Pr5_ST3: is-optional=false, type-reference=CRC_DI_Odo_Pr5_ST3
      cpp implementation data type element Odo_ST3: is-optional=false, type-reference=Odo_ST3
      cpp implementation data type element SQC_DI_Odo_Pr5_ST3: is-optional=false, type-reference=SQC_DI_Odo_Pr5_ST3
    REC_ECU_Stat_IDC_M_P_ST3: category=STRUCTURE, type-emitter=TYPE_EMITTER_ARA  # REC_Ign_Stat_Pr5_ST3
      namespaces:
        symbol props REC_ECU_Stat_IDC_M_P_ST3_
      7 x cpp implementation data type element, all with is-optional=false:
        ECU_Id_IDC_M_P_ST3: type-reference=ECU_Id_IDC_M_P_ST3
        NwId_Rsrv_ST3: type-reference=NwId_Rsrv_ST3
        WakeupRsn_IDC_M_P_ST3: type-reference=WakeupRsn_IDC_M_P_ST3
        Awake_Diag_Actv_IDC_M_P_ST3: type-reference=Awake_Diag_Actv_IDC_M_P_ST3
        Awake_NwStart_IDC_M_P_ST3: type-reference=Awake_NwStart_IDC_M_P_ST3
        Awake_HAD_Actv_IDC_M_P_ST3: type-reference=Awake_HAD_Actv_IDC_M_P_ST3
        Awake_Ignition_On_IDC_M_P_ST3: type-reference=Awake_Ignition_On_IDC_M_P_ST3
    REC_Ign_Stat_Pr5_ST3: category=STRUCTURE, type-emitter=TYPE_EMITTER_ARA
      namespaces:
        symbol props REC_Ign_Stat_Pr5_ST3_
      5 x cpp implementation data type element, all with is-optional=false:
        ISw_Stat_ST3: type-reference=ISw_Stat_ST3
        Veh_Op_Mode_ST3: type-reference=Veh_Op_Mode_ST3
        CRC_Ign_Stat_Pr5_ST3: type-reference=CRC_Ign_Stat_Pr5_ST3
        SQC_Ign_Stat_Pr5_ST3: type-reference=SQC_Ign_Stat_Pr5_ST3
        KG_StartSw_Psd_ST3: type-reference=KG_StartSw_Psd_ST3
    REC_MRR_Detection_ST3: category=STRUCTURE, type-emitter=TYPE_EMITTER_ARA
      namespaces:
        symbol props CR_Types_Namespace
      31 x cpp implementation data type element, all with is-optional=false:
        MRR_Dtctn_Existence_Prob_ST3: type-reference=MRR_Dtctn_Existence_Prob_ST3
        MRR_Dtctn_Azi_ST3: type-reference=MRR_Dtctn_Azi_ST3
        MRR_Dtctn_Elev_ST3: type-reference=MRR_Dtctn_Elev_ST3
        MRR_Dtctn_Dist_ST3: type-reference=MRR_Dtctn_Dist_ST3
        MRR_Dtctn_Azi_StdDev_ST3: type-reference=MRR_Dtctn_Azi_StdDev_ST3
        MRR_Dtctn_Elev_StdDev_ST3: type-reference=MRR_Dtctn_Elev_StdDev_ST3
        MRR_Dtctn_Dist_StdDev_ST3: type-reference=MRR_Dtctn_Dist_StdDev_ST3
        MRR_Dtctn_RadRelVelo_ST3: type-reference=MRR_Dtctn_RadRelVelo_ST3
        MRR_Dtctn_RadRelVelo_StdDev_ST3: type-reference=MRR_Dtctn_RadRelVelo_StdDev_ST3
        MRR_Dtctn_RadRelVelo_Ambgt_Resolv_ST3: type-reference=MRR_Dtctn_RadRelVelo_Ambgt_Resolv_ST3
        MRR_Dtctn_RCS_ST3: type-reference=MRR_Dtctn_RCS_ST3
        MRR_Dtctn_RCS_Err_ST3: type-reference=MRR_Dtctn_RCS_Err_ST3
        MRR_Dtctn_SNR_ST3: type-reference=MRR_Dtctn_SNR_ST3
        MRR_Dtct_SNR_Err_ST3: type-reference=MRR_Dtct_SNR_Err_ST3
        MRR_Dtctn_MultiTrgt_Probb_ST3: type-reference=MRR_Dtctn_MultiTrgt_Probb_ST3
        MRR_Dtctn_Ambgt_ID_ST3: type-reference=MRR_Dtctn_Ambgt_ID_ST3
        MRR_Dtctn_Ambgt_Probb_ST3: type-reference=MRR_Dtctn_Ambgt_Probb_ST3
        MRR_Dtctn_FreeSp_Probb_ST3: type-reference=MRR_Dtctn_FreeSp_Probb_ST3
        MRR_Dtctn_Micro_Doppler_Val_ST3: type-reference=MRR_Dtctn_Micro_Doppler_Val_ST3
        MRR_Dtctn_Azi_Qual_ST3: type-reference=MRR_Dtctn_Azi_Qual_ST3
        MRR_Dtctn_Elev_Qual_ST3: type-reference=MRR_Dtctn_Elev_Qual_ST3
        MRR_Dtctn_Dist_Qual_ST3: type-reference=MRR_Dtctn_Dist_Qual_ST3
        MRR_Dtctn_RadVelo_Qual_ST3: type-reference=MRR_Dtctn_RadVelo_Qual_ST3
        MRR_Dtctn_Meas_Model_ST3: type-reference=MRR_Dtctn_Meas_Model_ST3
        MRR_Dtctn_StaticObj_Stat_ST3: type-reference=MRR_Dtctn_StaticObj_Stat_ST3
        MRR_Dtctn_RxSig_Strength_ST3: type-reference=MRR_Dtctn_RxSig_Strength_ST3
        MRR_Dtctn_PeakDtct_Thrsld_ST3: type-reference=MRR_Dtctn_PeakDtct_Thrsld_ST3
        MRR_Dtctn_MaskAnglSect_Azi_ST3: type-reference=MRR_Dtctn_MaskAnglSect_Azi_ST3
        MRR_Dtctn_MaskAnglSect_Elev_ST3: type-reference=MRR_Dtctn_MaskAnglSect_Elev_ST3
        MRR_Dtctn_ID_Part1_ST3: type-reference=MRR_Dtctn_ID_Part1_ST3
        MRR_Dtctn_ID_Part2_ST3: type-reference=MRR_Dtctn_ID_Part2_ST3
    REC_MRR_Gen_Header_ST3: category=STRUCTURE, type-emitter=TYPE_EMITTER_ARA
      namespaces:
        symbol props CR_Types_Namespace
      11 x cpp implementation data type element, all with is-optional=false:
        MRR_SW_VerID_Major_ST3: type-reference=MRR_SW_VerID_Major_ST3
        MRR_SW_VerID_Minor_ST3: type-reference=MRR_SW_VerID_Minor_ST3
        MRR_SW_VerID_Patch_ST3: type-reference=MRR_SW_VerID_Patch_ST3
        MRR_SensorID_ST3: type-reference=MRR_SensorID_ST3
        MRR_Interface_ID_ST3: type-reference=MRR_Interface_ID_ST3
        MRR_Meas_TmStmp_ST3: type-reference=MRR_Meas_TmStmp_ST3
        MRR_Meas_Dur_ST3: type-reference=MRR_Meas_Dur_ST3
        MRR_Cycl_Count_ST3: type-reference=MRR_Cycl_Count_ST3
        MRR_Interface_CyclTime_ST3: type-reference=MRR_Interface_CyclTime_ST3
        MRR_Interface_CyclTime_Var_ST3: type-reference=MRR_Interface_CyclTime_Var_ST3
        MRR_Data_Qual_ST3: type-reference=MRR_Data_Qual_ST3
    REC_MRR_Radar_Header_ST3: category=STRUCTURE, type-emitter=TYPE_EMITTER_ARA
      namespaces:
        symbol props CR_Types_Namespace
      13 x cpp implementation data type element, all with is-optional=false:
        MRR_RadVelo_UpLmt_ST3: type-reference=MRR_RadVelo_UpLmt_ST3
        MRR_RadVelo_LowLmt_ST3: type-reference=MRR_RadVelo_LowLmt_ST3
        MRR_Dist_Range__ST3: type-reference=MRR_Dist_Range__ST3
        MRR_AziAngl_UpLmt_ST3: type-reference=MRR_AziAngl_UpLmt_ST3
        MRR_AziAngl_LowLmt_ST3: type-reference=MRR_AziAngl_LowLmt_ST3
        MRR_ElevAngl_UpLmt_ST3: type-reference=MRR_ElevAngl_UpLmt_ST3
        MRR_ElevAngl_LowLmt_ST3: type-reference=MRR_ElevAngl_LowLmt_ST3
        MRR_MaxDtctn_ST3: type-reference=MRR_MaxDtctn_ST3
        MRR_Dtctn_Stat_ST3: type-reference=MRR_Dtctn_Stat_ST3
        MRR_ValidDtctn_ST3: type-reference=MRR_ValidDtctn_ST3
        MRR_Moduln_Md_ST3: type-reference=MRR_Moduln_Md_ST3
        MRR_Dist_RadVelo_Cov_ST3: type-reference=MRR_Dist_RadVelo_Cov_ST3
        MRR_LowDist_Dtctn_Indicator_ST3: type-reference=MRR_LowDist_Dtctn_Indicator_ST3
    REC_MRR_SHI_Header_ST3: category=STRUCTURE, type-emitter=TYPE_EMITTER_ARA
      namespaces:
        symbol props CR_Types_Namespace
      27 x cpp implementation data type element, all with is-optional=false:
        MRR_Sens_Oprtn_Stat_ST3: type-reference=MRR_Sens_Oprtn_Stat_ST3
        MRR_Sens_Oprtn_Md_ST3: type-reference=MRR_Sens_Oprtn_Md_ST3
        MRR_Sens_Defect_Dtct_ST3: type-reference=MRR_Sens_Defect_Dtct_ST3
        MRR_Sens_Defect_Rsn_ST3: type-reference=MRR_Sens_Defect_Rsn_ST3
        MRR_Sens_Diag_Md_ST3: type-reference=MRR_Sens_Diag_Md_ST3
        MRR_Sens_Supp_Vtg_Stat_ST3: type-reference=MRR_Sens_Supp_Vtg_Stat_ST3
        MRR_Sens_Temp_Stat_ST3: type-reference=MRR_Sens_Temp_Stat_ST3
        MRR_Sens_Valid_InputSignals_Curr_ST3: type-reference=MRR_Sens_Valid_InputSignals_Curr_ST3
        MRR_Sens_Valid_InputSignals_Trgt_ST3: type-reference=MRR_Sens_Valid_InputSignals_Trgt_ST3
        MRR_Sens_Extern_Disturbnc_ST3: type-reference=MRR_Sens_Extern_Disturbnc_ST3
        MRR_Sens_Tx_PwrRedctn_Stat_ST3: type-reference=MRR_Sens_Tx_PwrRedctn_Stat_ST3
        MRR_Sens_Radom_Heat_Stat_ST3: type-reference=MRR_Sens_Radom_Heat_Stat_ST3
        MRR_Sens_TmSync_Stat_ST3: type-reference=MRR_Sens_TmSync_Stat_ST3
        MRR_Sens_GTS_Offset_ST3: type-reference=MRR_Sens_GTS_Offset_ST3
        MRR_Sens_Calib_Valid_Comp_ST3: type-reference=MRR_Sens_Calib_Valid_Comp_ST3
        MRR_Sens_Calib_Base_Stat_ST3: type-reference=MRR_Sens_Calib_Base_Stat_ST3
        MRR_Sens_Calib_Func_Stat_ST3: type-reference=MRR_Sens_Calib_Func_Stat_ST3
        MRR_Sens_Calib_SOC_Stat_ST3: type-reference=MRR_Sens_Calib_SOC_Stat_ST3
        MRR_Sens_Calib_Corrctn_Orient_Azi_ST3: type-reference=MRR_Sens_Calib_Corrctn_Orient_Azi_ST3
        MRR_Sens_Calib_Corrctn_Orient_Elev_ST3: type-reference=MRR_Sens_Calib_Corrctn_Orient_Elev_ST3
        MRR_Sens_Calib_Corrctn_Orient_Roll_ST3: type-reference=MRR_Sens_Calib_Corrctn_Orient_Roll_ST3
        MRR_Sens_Calib_Corrctn_UpLmt_Azi_ST3: type-reference=MRR_Sens_Calib_Corrctn_UpLmt_Azi_ST3
        MRR_Sens_Calib_Corrctn_UpLmt_Elev_ST3: type-reference=MRR_Sens_Calib_Corrctn_UpLmt_Elev_ST3
        MRR_Sens_Calib_Corrctn_UpLmt_Roll_ST3: type-reference=MRR_Sens_Calib_Corrctn_UpLmt_Roll_ST3
        MRR_Sens_Calib_Corrctn_LowLmt_Azi_ST3: type-reference=MRR_Sens_Calib_Corrctn_LowLmt_Azi_ST3
        MRR_Sens_Calib_Corrctn_LowLmt_Elev_ST3: type-reference=MRR_Sens_Calib_Corrctn_LowLmt_Elev_ST3
        MRR_Sens_Calib_Corrctn_LowLmt_Roll_ST3: type-reference=MRR_Sens_Calib_Corrctn_LowLmt_Roll_ST3
    REC_MRR_SPI_Header_ST3: category=STRUCTURE, type-emitter=TYPE_EMITTER_ARA
      namespaces:
        symbol props CR_Types_Namespace
      19 x cpp implementation data type element, all with is-optional=false:
        MRR_Sens_Origin_Pos_X_ST3: type-reference=MRR_Sens_Origin_Pos_X_ST3
        MRR_Sens_Origin_Pos_Y_ST3: type-reference=MRR_Sens_Origin_Pos_Y_ST3
        MRR_Sens_Origin_Pos_Z_ST3: type-reference=MRR_Sens_Origin_Pos_Z_ST3
        MRR_Sens_Origin_Pos_Err_X_ST3: type-reference=MRR_Sens_Origin_Pos_Err_X_ST3
        MRR_Sens_Origin_Pos_Err_Y_ST3: type-reference=MRR_Sens_Origin_Pos_Err_Y_ST3
        MRR_Sens_Origin_Pos_Err_Z_ST3: type-reference=MRR_Sens_Origin_Pos_Err_Z_ST3
        MRR_Sens_Orient_Azi_ST3: type-reference=MRR_Sens_Orient_Azi_ST3
        MRR_Sens_Orient_Elev_ST3: type-reference=MRR_Sens_Orient_Elev_ST3
        MRR_Sens_Orient_Roll_ST3: type-reference=MRR_Sens_Orient_Roll_ST3
        MRR_Sens_Orient_Err_Azi_ST3: type-reference=MRR_Sens_Orient_Err_Azi_ST3
        MRR_Sens_Orient_Err_Elev_ST3: type-reference=MRR_Sens_Orient_Err_Elev_ST3
        MRR_Sens_Orient_Err_Roll_ST3: type-reference=MRR_Sens_Orient_Err_Roll_ST3
        MRR_Sens_COS_Offset_X_ST3: type-reference=MRR_Sens_COS_Offset_X_ST3
        MRR_Sens_COS_Offset_Y_ST3: type-reference=MRR_Sens_COS_Offset_Y_ST3
        MRR_Sens_COS_Offset_Z_ST3: type-reference=MRR_Sens_COS_Offset_Z_ST3
        MRR_Sens_Valid_Seg_Azi_ST3: type-reference=MRR_Sens_Valid_Seg_Azi_ST3
        MRR_Sens_Valid_Seg_Elev_ST3: type-reference=MRR_Sens_Valid_Seg_Elev_ST3
        MRR_Sens_Total_Seg_Azi_ST3: type-reference=MRR_Sens_Total_Seg_Azi_ST3
        MRR_Sens_Total_Seg_Elev_ST3: type-reference=MRR_Sens_Total_Seg_Elev_ST3
    REC_MRR_Segment_ST3: category=STRUCTURE, type-emitter=TYPE_EMITTER_ARA
      namespaces:
        symbol props CR_Types_Namespace
      12 x cpp implementation data type element, all with is-optional=false:
        MRR_Seg_ID_ST3: type-reference=MRR_Seg_ID_ST3
        MRR_Seg_AziAngl_Begin_ST3: type-reference=MRR_Seg_AziAngl_Begin_ST3
        MRR_Seg_AziAngl_End_ST3: type-reference=MRR_Seg_AziAngl_End_ST3
        MRR_Seg_ElevAngl_Begin_ST3: type-reference=MRR_Seg_ElevAngl_Begin_ST3
        MRR_Seg_ElevAngl_End_ST3: type-reference=MRR_Seg_ElevAngl_End_ST3
        MRR_Seg_Range_Gain_ST3: type-reference=MRR_Seg_Range_Gain_ST3
        MRR_Seg_Range_Gain_RCS_ST3: type-reference=MRR_Seg_Range_Gain_RCS_ST3
        MRR_Seg_DetctnRange_Min_ST3: type-reference=MRR_Seg_DetctnRange_Min_ST3
        MRR_Seg_DetctnRange_Max_ST3: type-reference=MRR_Seg_DetctnRange_Max_ST3
        MRR_Seg_Blockage_Stat_ST3: type-reference=MRR_Seg_Blockage_Stat_ST3
        MRR_Seg_Redctn_Rsn_ST3: type-reference=MRR_Seg_Redctn_Rsn_ST3
        MRR_Seg_Redctn_Rsn_Prob_ST3: type-reference=MRR_Seg_Redctn_Rsn_Prob_ST3
    REC_MRR_Sens_OutputData_Pr7_ST3: category=STRUCTURE, type-emitter=TYPE_EMITTER_ARA
      namespaces:
        symbol props CR_Types_Namespace
      cpp implementation data type element MRR_Gen_Header_ST3: is-optional=false, type-reference=MRR_Gen_Header_ST3
      cpp implementation data type element MRR_Radar_Header_ST3: is-optional=false, type-reference=MRR_Radar_Header_ST3
      cpp implementation data type element MRR_Detection_ST3: is-optional=false, type-reference=MRR_Detection_ST3
    REC_MRR_SuppSens_Ifc_Pr6_ST3: category=STRUCTURE, type-emitter=TYPE_EMITTER_ARA
      namespaces:
        symbol props CR_Types_Namespace
      cpp implementation data type element MRR_SPI_Header_ST3: is-optional=false, type-reference=MRR_SPI_Header_ST3
      cpp implementation data type element MRR_Segment_ST3: is-optional=false, type-reference=MRR_Segment_ST3
      cpp implementation data type element MRR_SHI_Header_ST3: is-optional=false, type-reference=MRR_SHI_Header_ST3
    REC_PN14_Master_Stat1_ST3: category=STRUCTURE, type-emitter=TYPE_EMITTER_ARA
      namespaces:
        symbol props REC_PN14_Master_stat1_ST3
      11 x cpp implementation data type element, all with is-optional=false:
        PN14_TransMd_Stat_ST3: type-reference=PN14_TransMd_Stat_ST3
        PN14_DDP_Sw_Stat_ST3: type-reference=PN14_DDP_Sw_Stat_ST3
        PN14_ProdMd_Stat_ST3: type-reference=PN14_ProdMd_Stat_ST3
        PN14_ProdMd_BatStat_ST3: type-reference=PN14_ProdMd_BatStat_ST3
        PN14_SupBat_Stat_ST3: type-reference=PN14_SupBat_Stat_ST3
        PN14_SupBat_Volt_ST3: type-reference=PN14_SupBat_Volt_ST3
        PN14_SupBat_Curr_ST3: type-reference=PN14_SupBat_Curr_ST3
        PN14_SupBat_Temp_ST3: type-reference=PN14_SupBat_Temp_ST3
        PN14_PNSec_RechargeEnable_ST3: type-reference=PN14_PNSec_RechargeEnable_ST3
        PN14_ExtBat_Charge_Actv_ST3: type-reference=PN14_ExtBat_Charge_Actv_ST3
        PN14_DDP_Sw2_Stat_ST3: type-reference=PN14_DDP_Sw2_Stat_ST3
    REC_PT4_PTCoor4_Pr5_ST3: category=STRUCTURE, type-emitter=TYPE_EMITTER_ARA
      namespaces:
        symbol props REC_PT4_PTCoor4_Pr5_ST3_
      6 x cpp implementation data type element, all with is-optional=false:
        CRC_PT4_PTCoor4_Pr5_ST3: type-reference=CRC_PT4_PTCoor4_Pr5_ST3
        PT4_PTCoor_PT_Rdy_ST3: type-reference=PT4_PTCoor_PT_Rdy_ST3
        SQC_PT4_PTCoor4_Pr5_ST3: type-reference=SQC_PT4_PTCoor4_Pr5_ST3
        PT4_PTCoor_EngStartPN14_Stat_ST3: type-reference=PT4_PTCoor_EngStartPN14_Stat_ST3
        PT4_PTCoor_SSA_EngSp_ST3: type-reference=PT4_PTCoor_SSA_EngSp_ST3
        Rsrv1_PT4_PTCoor_PT_Rdy_Pr5_ST3: type-reference=Rsrv1_PT4_PTCoor_PT_Rdy_Pr5_ST3
    REC_StatArray_AdAR: category=STRUCTURE, type-emitter=TYPE_EMITTER_ARA
      namespaces:
        symbol props DataTypes
      cpp implementation data type element Uint8_Element_AdAR: is-optional=false, type-reference=Uint8_Element_AdAR
      cpp implementation data type element Uint16_Element_AdAR: is-optional=false, type-reference=Uint16_Element_AdAR
      cpp implementation data type element ARR_Stat_Uint16_100_Element_AdAR: is-optional=false, type-reference=ARR_Stat_Uint16_100_Element_AdAR
    REC_Uint8_Uint16_Uint16_AdAR: category=STRUCTURE, type-emitter=TYPE_EMITTER_ARA
      namespaces:
        symbol props NS_REC_Uint8_Uint16_Uint16_AdAR
      cpp implementation data type element Uint8_Element2_AdAR: is-optional=false, type-reference=uint8_t
      cpp implementation data type element Uint16_Element2_AdAR: is-optional=false, type-reference=uint16_t
      cpp implementation data type element Uint16_Element3_AdAR: is-optional=false, type-reference=uint16_t
    REC_aDummyRecord: category=STRUCTURE, type-emitter=TYPE_EMITTER_ARA
      namespaces:
        symbol props DataTypes
      5 x cpp implementation data type element, all with is-optional=false:
        dummyRecordElement1: type-reference=uint32_t
        dummyRecordElement2: type-reference=uint16_t
        dummyRecordElement3: type-reference=uint8_t
        dummyRecordElement4: type-reference=ARR_Stat_REC_100
        dummyRecordElement5: type-reference=uint32_t
    Rsrv01: type-emitter=TYPE_EMITTER_ARA, type-reference=uint8_t
      namespaces:
        symbol props TypeRef
    Rsrv1_PT4_PTCoor_PT_Rdy_Pr5_ST3: type-emitter=TYPE_EMITTER_ARA, type-reference=Rsrv01  # Reserved for future use
      namespaces:
        symbol props TypeRef
    SIZE: type-emitter=TYPE_EMITTER_ARA, type-reference=uint16_t
      namespaces:
        symbol props CR_Types_Namespace
    SIZE1: type-emitter=TYPE_EMITTER_ARA, type-reference=uint16_t
      namespaces:
        symbol props CR_Types_Namespace
    SIZE2: type-emitter=TYPE_EMITTER_ARA, type-reference=uint16_t
      namespaces:
        symbol props CR_Types_Namespace
    SIZE3: type-emitter=TYPE_EMITTER_ARA, type-reference=uint16_t
      namespaces:
        symbol props CR_Types_Namespace
    SIZE4: type-emitter=TYPE_EMITTER_ARA, type-reference=uint16_t
      namespaces:
        symbol props CR_Types_Namespace
    SQC_DI_Odo_Pr5_ST3: type-emitter=TYPE_EMITTER_ARA, type-reference=c08_0_255_1_SNA_na  # Sequence counter
      namespaces:
        symbol props TypeRef
    SQC_Ign_Stat_Pr5_ST3: type-emitter=TYPE_EMITTER_ARA, type-reference=c08_0_255_1_SNA_na  # Sequence counter
      namespaces:
        symbol props TypeRef
    SQC_PT4_PTCoor4_Pr5_ST3: type-emitter=TYPE_EMITTER_ARA, type-reference=c08_0_255_1_SNA_na  # Sequence counter
      namespaces:
        symbol props TypeRef
    Uint16_Element_AdAR: type-emitter=TYPE_EMITTER_ARA, type-reference=c16_UInt_SNA_na
      namespaces:
        symbol props DataTypes
    Uint8_Element_AdAR: type-emitter=TYPE_EMITTER_ARA, type-reference=c08_UInt_SNA_na1  # Uint16_Element_AdAR
      namespaces:
        symbol props DataTypes
    Veh_Op_Mode_ST3: type-emitter=TYPE_EMITTER_ARA, type-reference=c04_VehOpMode  # Operating Mode Vehicle
      namespaces:
        symbol props TypeRef
    WakeupRsn_IDC_M_P_ST3: type-emitter=TYPE_EMITTER_ARA, type-reference=uint16_t  # CRC-checksum of signal group according to AUTOSAR Profile 5
      namespaces:
        symbol props TypeRef
    bool: category=VALUE, type-emitter=TYPE_EMITTER_ARA  # boolean
    c02_Diag_Mode_ST3: type-emitter=TYPE_EMITTER_ARA, type-reference=uint8_t  # 02_Diag_Mode_ST3
      namespaces:
        symbol props CR_Types_Namespace
    c02_Fls_Tru: type-emitter=TYPE_EMITTER_ARA, type-reference=uint8_t  # 02_False_True
      namespaces:
        symbol props CR_Types_Namespace
    c02_Ndef_False_True_ST3: type-emitter=TYPE_EMITTER_ARA, type-reference=uint8_t  # 02_Ndef_False_True_ST3
      namespaces:
        symbol props TypeRef
    c02_PT_Rdy_V2: type-emitter=TYPE_EMITTER_ARA, type-reference=uint8_t  # 02_PT_Rdy_V2
      namespaces:
        symbol props TypeRef
    c02_Sens_Calib_Base_Stat_ST3: type-emitter=TYPE_EMITTER_ARA, type-reference=uint8_t  # 02_Sens_Calib_Base_Stat_ST3
      namespaces:
        symbol props CR_Types_Namespace
    c02_Sens_Calib_SOC_Stat_ST3: type-emitter=TYPE_EMITTER_ARA, type-reference=uint8_t  # 02_Sens_Calib_SOC_Stat_ST3
      namespaces:
        symbol props CR_Types_Namespace
    c02_Sens_Defect_Dtct_ST3: type-emitter=TYPE_EMITTER_ARA, type-reference=uint8_t  # 02_Sens_Defect_Dtct_ST3
      namespaces:
        symbol props CR_Types_Namespace
    c02_Sens_Disturbnc_Stat_ST3: type-emitter=TYPE_EMITTER_ARA, type-reference=uint8_t  # 02_Sens_Disturbnc_Stat_ST3
      namespaces:
        symbol props CR_Types_Namespace
    c02_Sens_Oprtn_Md_ST3: type-emitter=TYPE_EMITTER_ARA, type-reference=uint8_t  # 02_Sens_Oprtn_Md_ST3
      namespaces:
        symbol props CR_Types_Namespace
    c02_Sens_Oprtn_Stat_ST3: type-emitter=TYPE_EMITTER_ARA, type-reference=uint8_t  # 02_Sens_Oprtn_Stat_ST3
      namespaces:
        symbol props CR_Types_Namespace
    c02_Sens_Radom_Heat_Stat_ST3: type-emitter=TYPE_EMITTER_ARA, type-reference=uint8_t  # 02_Sens_Radom_Heat_Stat_ST3
      namespaces:
        symbol props CR_Types_Namespace
    c02_Sens_SuppVtg_Stat_ST3: type-emitter=TYPE_EMITTER_ARA, type-reference=uint8_t  # 02_Sens_SuppVtg_Stat_ST3
      namespaces:
        symbol props CR_Types_Namespace
    c02_Sens_Temp_Stat_ST3: type-emitter=TYPE_EMITTER_ARA, type-reference=uint8_t  # 02_Sens_Temp_Stat_ST3
      namespaces:
        symbol props CR_Types_Namespace
    c02_Sens_TimeSync_Stat_ST3: type-emitter=TYPE_EMITTER_ARA, type-reference=uint8_t  # 02_Sens_TimeSync_Stat_ST3
      namespaces:
        symbol props CR_Types_Namespace
    c02_Sens_TxPwrRedctn_Stat_ST3: type-emitter=TYPE_EMITTER_ARA, type-reference=uint8_t  # 02_Sens_TxPwrRedctn_Stat_ST3
      namespaces:
        symbol props CR_Types_Namespace
    c03_EngStartPN14_Stat: type-emitter=TYPE_EMITTER_ARA, type-reference=uint8_t  # 03_EngStartPN14_Stat_ST3
      namespaces:
        symbol props TypeRef
    c03_ISw_Stat: type-emitter=TYPE_EMITTER_ARA, type-reference=uint8_t  # 03_ISw_Stat
      namespaces:
        symbol props TypeRef
    c03_SegBlock_Stat_ST3: type-emitter=TYPE_EMITTER_ARA, type-reference=uint8_t  # 03_SegBlock_Stat_ST3
      namespaces:
        symbol props CR_Types_Namespace
    c03_Seg_Reduction_Rsn_ST3: type-emitter=TYPE_EMITTER_ARA, type-reference=uint8_t  # 03_Seg_Reduction_Rsn_ST3
      namespaces:
        symbol props CR_Types_Namespace
    c03_Sens_Defect_Rsn_ST3: type-emitter=TYPE_EMITTER_ARA, type-reference=uint8_t  # 03_Sens_Defect_Rsn_ST3
      namespaces:
        symbol props CR_Types_Namespace
    c04_0_15_1_SNA_na: type-emitter=TYPE_EMITTER_ARA, type-reference=uint8_t  # 04_0-15_1_SNA=-
      namespaces:
        symbol props CR_Types_Namespace
    c04_Sens_Calib_Func_Stat_ST3: type-emitter=TYPE_EMITTER_ARA, type-reference=uint8_t  # 04_Sens_Calib_Func_Stat_ST3
      namespaces:
        symbol props CR_Types_Namespace
    c04_VehOpMode: type-emitter=TYPE_EMITTER_ARA, type-reference=uint8_t  # 04_VehOpMode
      namespaces:
        symbol props TypeRef
    c06_0_32_1: type-emitter=TYPE_EMITTER_ARA, type-reference=uint8_t  # 06_0-32_1
      namespaces:
        symbol props CR_Types_Namespace
    c07_perc_0_100_1: type-emitter=TYPE_EMITTER_ARA, type-reference=uint8_t  # 07_%_0-100_1
      namespaces:
        symbol props CR_Types_Namespace
    c08_0_100_1: type-emitter=TYPE_EMITTER_ARA, type-reference=uint8_t  # 08_0-100_1
      namespaces:
        symbol props CR_Types_Namespace
    c08_0_254_1: type-emitter=TYPE_EMITTER_ARA, type-reference=uint8_t  # 08_0-254_1
      namespaces:
        symbol props CR_Types_Namespace
    c08_0_255_1_SNA_na: type-emitter=TYPE_EMITTER_ARA, type-reference=uint8_t  # 08_0-255_1_SNA=-
      namespaces:
        symbol props TypeRef
    c08_0_to_3_1_SNA_255: category=ARRAY, array-size=4, cpp-template-argument=ARRAY_ELEMENT5, type-emitter=TYPE_EMITTER_ARA  # 08_0-3_1_SNA=255
      namespaces:
        symbol props CR_Types_Namespace
    c08_Sens_Data_Qual_ST3: type-emitter=TYPE_EMITTER_ARA, type-reference=uint8_t  # 08_Sens_Data_Qual_ST3
      namespaces:
        symbol props CR_Types_Namespace
    c08_Sens_Dtctn_Stat_ST3: type-emitter=TYPE_EMITTER_ARA, type-reference=uint8_t  # 08_Sens_Dtctn_Stat_ST3
      namespaces:
        symbol props CR_Types_Namespace
    c08_Sens_MeasModel_ST3: type-emitter=TYPE_EMITTER_ARA, type-reference=uint8_t  # 08_Sens_MeasModel_ST3
      namespaces:
        symbol props CR_Types_Namespace
    c08_Sens_Moduln_Md_ST3: type-emitter=TYPE_EMITTER_ARA, type-reference=uint8_t  # 08_Sens_Moduln_Md_ST3
      namespaces:
        symbol props CR_Types_Namespace
    c08_UInt_SNA_na: type-emitter=TYPE_EMITTER_ARA, type-reference=uint8_t  # 08_UInt_SNA=-
      namespaces:
        symbol props CR_Types_Namespace
    c08_UInt_SNA_na1: type-emitter=TYPE_EMITTER_ARA, type-reference=uint8_t  # 08_UInt_SNA=-
      namespaces:
        symbol props DataTypes
    c08_dB_0_20_0d1: type-emitter=TYPE_EMITTER_ARA, type-reference=uint8_t  # 08_dB_0-20_0,1
      namespaces:
        symbol props CR_Types_Namespace
    c08_dB_0_50_0d2: type-emitter=TYPE_EMITTER_ARA, type-reference=uint8_t  # 08_dB_0-50_0,2
      namespaces:
        symbol props CR_Types_Namespace
    c08_dB_0_5_0d02: type-emitter=TYPE_EMITTER_ARA, type-reference=uint8_t  # 08_dB_0-5_0,02
      namespaces:
        symbol props CR_Types_Namespace
    c08_dB_m254_0_1: type-emitter=TYPE_EMITTER_ARA, type-reference=uint8_t  # 08_dB_-254-0_1
      namespaces:
        symbol props CR_Types_Namespace
    c08_dBsm_0_2d54_0d01: type-emitter=TYPE_EMITTER_ARA, type-reference=uint8_t  # 08_dBsm_0-2,54_0,01
      namespaces:
        symbol props CR_Types_Namespace
    c08_deg_m10_p10_0d1_ST3: type-emitter=TYPE_EMITTER_ARA, type-reference=uint8_t  # 08_°_-10-+10_0,1_ST3
      namespaces:
        symbol props CR_Types_Namespace
    c08_m_0_1d02_0d004_no_SNA: type-emitter=TYPE_EMITTER_ARA, type-reference=uint32_t  # 08_m_0-1,02_0,004_SNA=-
      namespaces:
        symbol props CR_Types_Namespace
    c08_m_0_2k5_0k01_NACPT_ST3: type-emitter=TYPE_EMITTER_ARA, type-reference=uint8_t  # 08_m_0-2,53_0,01_NACPT_ST3
      namespaces:
        symbol props CR_Types_Namespace
    c08_m_p_s_0_0d663_0d0026_No_SNA: type-emitter=TYPE_EMITTER_ARA, type-reference=uint8_t  # 08_m/s_0-0,663_0,0026_SNA=-
      namespaces:
        symbol props CR_Types_Namespace
    c08_m_sq_p_s_m0d01_p0d01_0d00008: type-emitter=TYPE_EMITTER_ARA, type-reference=uint8_t  # 08_m²/s_m0,01-0,01_0,00008
      namespaces:
        symbol props CR_Types_Namespace
    c08_perc_0_100_1: type-emitter=TYPE_EMITTER_ARA, type-reference=uint8_t  # 08_%_0-100_1
      namespaces:
        symbol props CR_Types_Namespace
    c08_rad_0_0d044323_0d0001745: type-emitter=TYPE_EMITTER_ARA, type-reference=uint8_t  # 08_rad_0-0,044323_0,0001745
      namespaces:
        symbol props CR_Types_Namespace
    c08_rad_0_0d0886714_0d0001745: type-emitter=TYPE_EMITTER_ARA, type-reference=uint8_t  # 08_rad_0-0.0886714_0,0001745
      namespaces:
        symbol props CR_Types_Namespace
    c08_rad_0_3d1416_0d01232_no_SNA: type-emitter=TYPE_EMITTER_ARA, type-reference=uint8_t  # 08_rad_0-3,1416_0,01232_SNA=-
      namespaces:
        symbol props CR_Types_Namespace
    c10_dB_m30_30_0d1: type-emitter=TYPE_EMITTER_ARA, type-reference=uint16_t  # 10_db_-30-+30_0,1
      namespaces:
        symbol props CR_Types_Namespace
    c10_deg_m180_180_1: type-emitter=TYPE_EMITTER_ARA, type-reference=uint16_t  # 10_°_-180-+180_1
      namespaces:
        symbol props CR_Types_Namespace
    c10_m_0_400_0d5: type-emitter=TYPE_EMITTER_ARA, type-reference=uint16_t  # 10_m_0-400_0,5
      namespaces:
        symbol props CR_Types_Namespace
    c16_0_3000_1: type-emitter=TYPE_EMITTER_ARA, type-reference=uint16_t  # 16_0-3000_1
      namespaces:
        symbol props CR_Types_Namespace
    c16_0_6000_1: type-emitter=TYPE_EMITTER_ARA, type-reference=uint16_t  # 16_0-6000_1
      namespaces:
        symbol props CR_Types_Namespace
    c16_CRC_woSNA: type-emitter=TYPE_EMITTER_ARA, type-reference=uint16_t  # 16_CRC_w/oSNA
      namespaces:
        symbol props TypeRef
    c16_UInt_SNA_na: type-emitter=TYPE_EMITTER_ARA, type-reference=uint16_t  # 16_UInt_SNA=-
      namespaces:
        symbol props DataTypes
    c16_dBsm_m100_p100_0d0035: type-emitter=TYPE_EMITTER_ARA, type-reference=uint16_t  # 16_-100-+100_0.0035
      namespaces:
        symbol props CR_Types_Namespace
    c16_m_0_500_0d1: type-emitter=TYPE_EMITTER_ARA, type-reference=uint16_t  # 16_m_0-500_0,1
      namespaces:
        symbol props CR_Types_Namespace
    c16_m_per_s_0_130_0d01: type-emitter=TYPE_EMITTER_ARA, type-reference=uint16_t  # 16_m/s_0-130_0,01
      namespaces:
        symbol props CR_Types_Namespace
    c16_m_per_s_m130_0_0d01: type-emitter=TYPE_EMITTER_ARA, type-reference=uint16_t  # 16_m/s_-130-0_0,01
      namespaces:
        symbol props CR_Types_Namespace
    c16_ms_0_65534_1: type-emitter=TYPE_EMITTER_ARA, type-reference=uint16_t  # 16_ms_0-65534_1
      namespaces:
        symbol props CR_Types_Namespace
    c16_rad_0_1d57_0d001: type-emitter=TYPE_EMITTER_ARA, type-reference=uint16_t  # 16_rad_0-1,57_0,001
      namespaces:
        symbol props CR_Types_Namespace
    c16_rad_m157_0_0d001: type-emitter=TYPE_EMITTER_ARA, type-reference=uint16_t  # 16_rad_-157_0_0,001
      namespaces:
        symbol props CR_Types_Namespace
    c16_rad_m1d571_1d57_0d0001745: type-emitter=TYPE_EMITTER_ARA, type-reference=uint16_t  # 16_rad_-1,571_1,57_0,0001745
      namespaces:
        symbol props CR_Types_Namespace
    c24_km_0_999999k9_0k1_Invld_SNA: type-emitter=TYPE_EMITTER_ARA, type-reference=uint32_t  # 24_km_0-999999,9_0,1_Invld_SNA
      namespaces:
        symbol props TypeRef
    c32_m_0_500_0d001: type-emitter=TYPE_EMITTER_ARA, type-reference=uint32_t  # 32_m_0-500_0,001
      namespaces:
        symbol props CR_Types_Namespace
    c32_m_per_s_m200_100_0d001: type-emitter=TYPE_EMITTER_ARA, type-reference=uint32_t  # 32_m/s_-200-+100_0,001
      namespaces:
        symbol props CR_Types_Namespace
    c32_ms_0_4294967294_1: type-emitter=TYPE_EMITTER_ARA, type-reference=uint32_t  # 32_ms_0-4294967294_1
      namespaces:
        symbol props CR_Types_Namespace
    c32_ns_0_4294967295_1_noSNA: type-emitter=TYPE_EMITTER_ARA, type-reference=uint32_t  # 32_ns_0-4294967295_1_noSNA
      namespaces:
        symbol props CR_Types_Namespace
    c64_0_0_1d84467E19_1_SNA: type-emitter=TYPE_EMITTER_ARA, type-reference=uint64_t  # 64_0_0-1.84467E+19_1_SNA
      namespaces:
        symbol props CR_Types_Namespace
    c64_ms_1_1d84467E19_1: type-emitter=TYPE_EMITTER_ARA, type-reference=uint64_t  # 64_ms_1-1.84467E+19_1
      namespaces:
        symbol props CR_Types_Namespace
    c8_rad_0_1d404_0d006: type-emitter=TYPE_EMITTER_ARA, type-reference=uint8_t  # 08_rad_0-1,404_0,006
      namespaces:
        symbol props CR_Types_Namespace
    c8_rad_m1d404_0_0d006: type-emitter=TYPE_EMITTER_ARA, type-reference=uint8_t  # 08_rad_-1,404_0_0,006
      namespaces:
        symbol props CR_Types_Namespace
    uint16_t: category=VALUE, type-emitter=cstdint  # unsigned integer 16bit
    uint32_t: category=VALUE, type-emitter=cstdint  # unsigned integer 32bit
    uint64_t: category=VALUE, type-emitter=cstdint  # unsigned integer 64bit
    uint8_t: category=VALUE, type-emitter=cstdint  # unsigned integer 8bit
    string: category=STRING, type-emitter=TYPE_EMITTER_ARA
      namespaces:
        symbol props ara
        symbol props diag
    ARR_Stat_REC_600: category=ARRAY, array-size=600, cpp-template-argument{category=STRUCTURE, template-type=REC_Uint8_Uint16_Uint16_AdAR}, type-emitter=TYPE_EMITTER_ARA
      namespaces:
        symbol props ARR_Stat_REC_600
package /DataTypes/ModelManagement
  mode declaration group MachineStates: initial-mode=Startup
    5 x mode:
      Running: value=0
      Restart: value=3
      Off: value=4
      Startup: value=1
      Shutdown: value=2
package /E2EProfileConfigurationSet
  e 2 e profile configuration set E2E
    e 2 e profile configuration E2E_Profile_5: data-id-mode=ALL-16-BIT, max-delta-counter=3, max-error-state-init=0, max-error-state-invalid=0, max-error-state-valid=0, min-ok-state-init=1, min-ok-state-invalid=1, min-ok-state-valid=1, profile-name=PROFILE_06, window-size=10
    e 2 e profile configuration E2E_Profile_6: data-id-mode=ALL-16-BIT, max-delta-counter=3, max-error-state-init=0, max-error-state-invalid=0, max-error-state-valid=0, min-ok-state-init=1, min-ok-state-invalid=1, min-ok-state-valid=1, profile-name=PROFILE_06, window-size=10
    e 2 e profile configuration E2E_Profile_7: data-id-mode=ALL-16-BIT, max-delta-counter=3, max-error-state-init=0, max-error-state-invalid=0, max-error-state-valid=0, min-ok-state-init=1, min-ok-state-invalid=1, min-ok-state-valid=1, profile-name=PROFILE_07, window-size=10
package /Machine
  machine IDC6_M_P1_XAVIER: machine-design=IDC_Adpative
    function-groups:
      mode declaration group prototype MachineState: type=MachineStates
    module-instantiations:
      log and trace instantiation LogAndTraceInstantiation
        ethernet network configuration EthernetNetworkConfiguration: communication-connector=EthernetConnector, tcp-port=49361
    processor IDC6_M_P1
      6 x processor core:
        IDC6_M_Core{0..5}: core-id={0..5}
package /Machine/ProcessToMachineMappings
  process to machine mapping set SW_to_HW_Mappings
    4 x process to machine mapping, all with machine=IDC6_M_P1_XAVIER:
      BaseApplication_IDC6_M: process=BaseApplication
      SelfDiagnosticAgent_IDC6_M: process=SelfDiagnosticAgent
      DiagnosticManager_IDC6_M: process=DiagnosticManagerDeamon
      TestBaseApplication_IDC6_M: process=TestBaseApplication
package /Machine/StartupConfigSets
  startup config set startupConf
    startup config STARTUP_CONFIG_DEFAULT: scheduling-policy=SCHEDULING-POLICY-ROUND-ROBIN, scheduling-priority=20, startup-option{option-argument=./etc/application.json, option-kind=COMMAND-LINE-SHORT-FORM, option-name=c}
package /ServiceInstances
  5 x provided someip service instance:
    SI_ECU_Stat_IDC_M_P_ST3_Base_ADAS6: service-interface=SomeIpSI_ECU_Stat_IDC_M_P_ST3, someip-event-props=event=SomeIpEv_ECU_Stat_IDC_M_P_ST3, sd-server-config=ServerSd_SI_ECU_Stat_IDC_M_P_ST3_Base_ADAS6, service-instance-id=10
      someip provided event group SomeIpEG_SI_ECU_STAT: event-group=EG_SI_ECU_STAT, multicast-threshold=0, sd-server-event-group-timing-config=ServerEgSd_SomeIpEG_SI_ECU_STAT
    dummyServiceOneInterface_Base_ADAS6: service-interface=SomeIpdummyServiceInterface, someip-event-props=event=SomeIpaDummyEvent, someip-method-props=method=SomeIpaDummyMethod, sd-server-config=ServerSd_dummyServiceOneInterface_Base_ADAS6, service-instance-id=12347
      someip provided event group SomeIpdummyOneEventGroup: event-group=dummyOneEventGroup, multicast-threshold=0, sd-server-event-group-timing-config=ServerEgSd_SomeIpdummyOneEventGroup
    dummyServiceThreeInterface_Base_ADAS6: service-interface=SomeIpdummyServiceThreeInterface, someip-event-props=event=SomeIpTwoDummyEvent, someip-method-props=method=SomeIpgetDummyDataTwo, sd-server-config=ServerSd_dummyServiceThreeInterface_Base_ADAS6, service-instance-id=12348
      e-2-e-event-protection-propss:
        end 2 end event protection props E2E_Props_P7_P: data-ids=58, e-2-e-profile-configuration=E2E_Profile_7, event=SomeIpTwoDummyEvent, max-data-length=976568, min-data-length=560
      someip provided event group SomeIpdummyTwoEventGroup: event-group=dummyTwoEventGroup, multicast-threshold=0, sd-server-event-group-timing-config=ServerEgSd_SomeIpdummyTwoEventGroup
    dummyServiceTwoInterface_Base_ADAS6: service-interface=SomeIpdummyServiceTwoInterface, someip-event-props=event=SomeIpThreeDummyEvent, someip-method-props=method=SomeIpsetDummyDataThree, sd-server-config=ServerSd_dummyServiceTwoInterface_Base_ADAS6, service-instance-id=12349
      e-2-e-event-protection-propss:
        end 2 end event protection props E2E_Props_P6_P: data-ids=56, e-2-e-profile-configuration=E2E_Profile_6, event=SomeIpThreeDummyEvent, max-data-length=1650, min-data-length=112
      someip provided event group SomeIpdummyThreeEventGroup: event-group=dummyThreeEventGroup, multicast-threshold=0, sd-server-event-group-timing-config=ServerEgSd_SomeIpdummyThreeEventGroup
    comDummyServiceOneInterface_testBase_ADAS6: service-interface=SomeIpcomDummyServiceOneInterface, someip-event-props=event=SomeIpaComDummyEvent, sd-server-config=ServerSd_comDummyServiceOneInterface_testBase_ADAS6, service-instance-id=12345
      someip provided event group SomeIpcomDummyOneEventGroup: event-group=comDummyOneEventGroup, multicast-threshold=0, sd-server-event-group-timing-config=ServerEgSd_SomeIpcomDummyOneEventGroup
  provided user defined service instance SelfDiagAgent_ProvidedBindingServiceInstance_DiagComApi: service-interface=DiagComApi_Binding
  18 x required someip service instance, all with required-minor-version=0:
    PN14_Master_stat1_ST3_Base_ADAS6: service-interface=SomeIpSI_PN14_Master_stat1_ST3, required-service-instance-id=1, sd-client-config=ClientSd_PN14_Master_stat1_ST3_Base_ADAS6
      someip required event group SomeIpEG_SI_PN14_ProdMd_Stat_ST3: event-group=EG_SI_PN14_ProdMd_Stat_ST3, sd-client-event-group-timing-config=ClientEgSd_SomeIpEG_SI_PN14_ProdMd_Stat_ST3
    SI_CR_FL_Sens_OutputData_Pr7_ST3_Base_ADAS6: service-interface=SomeIpSI_CR_FL_Sens_OutputData_Pr7_ST3, required-service-instance-id=41611, sd-client-config=ClientSd_SI_CR_FL_Sens_OutputData_Pr7_ST3_Base_ADAS6
      e-2-e-event-protection-propss:
        end 2 end event protection props E2E_Props_P7_C_SomeIpEv_CR_FL_Sens_OutputData_Pr7_ST3: data-ids=10, e-2-e-profile-configuration=E2E_Profile_7, event=SomeIpEv_CR_FL_Sens_OutputData_Pr7_ST3, max-data-length=976568, min-data-length=560
      someip required event group SomeIpEG_IG_CR_FL_Sens_OutputData_Pr7_ST3: event-group=EG_SomeIpSI_CR_FL_Sens_OutputData_Pr7_ST3, sd-client-event-group-timing-config=ClientEgSd_SomeIpEG_IG_CR_FL_Sens_OutputData_Pr7_ST3
    SI_CR_FL_SuppSens_Ifc_Pr6_ST3_Base_ADAS6: service-interface=SomeIpSI_CR_FL_SuppSens_Ifc_Pr6_ST3, required-service-instance-id=41614, sd-client-config=ClientSd_SI_CR_FL_SuppSens_Ifc_Pr6_ST3_Base_ADAS6
      e-2-e-event-protection-propss:
        end 2 end event protection props E2E_Props_P6_C_SomeIpEv_CR_FL_SuppSens_Ifc_Pr6_ST3: data-ids=552, e-2-e-profile-configuration=E2E_Profile_6, event=SomeIpEv_CR_FL_SuppSens_Ifc_Pr6_ST3, max-data-length=7152, min-data-length=432
      someip required event group SomeIpEG_SomeIpEv_CR_FL_SuppSens_Ifc_Pr6_ST3: event-group=EG_SomeIpEv_CR_FL_SuppSens_Ifc_Pr6_ST3, sd-client-event-group-timing-config=ClientEgSd_SomeIpEG_SomeIpEv_CR_FL_SuppSens_Ifc_Pr6_ST3
    SI_CR_FR_Sens_OutputData_Pr7_ST3_Base_ADAS6: service-interface=SomeIpSI_CR_FR_Sens_OutputData_Pr7_ST3, required-service-instance-id=41610, sd-client-config=ClientSd_SI_CR_FR_Sens_OutputData_Pr7_ST3_Base_ADAS6
      e-2-e-event-protection-propss:
        end 2 end event protection props E2E_Props_P7_C_SomeIpEv_CR_FR_Sens_OutputData_Pr7_ST3: data-ids=9, e-2-e-profile-configuration=E2E_Profile_7, event=SomeIpEv_CR_FR_Sens_OutputData_Pr7_ST3, max-data-length=976568, min-data-length=560
      someip required event group SomeIpEG_SomeIpSI_CR_FR_Sens_OutputData_Pr7_ST3: event-group=EG_SomeIpSI_CR_FR_Sens_OutputData_Pr7_ST3, sd-client-event-group-timing-config=ClientEgSd_SomeIpEG_SomeIpSI_CR_FR_Sens_OutputData_Pr7_ST3
    SI_CR_FR_SuppSens_Ifc_Pr6_ST3_Base_ADAS6: service-interface=SomeIpSI_CR_FR_SuppSens_Ifc_Pr6_ST3, required-service-instance-id=41615, sd-client-config=ClientSd_SI_CR_FR_SuppSens_Ifc_Pr6_ST3_Base_ADAS6
      e-2-e-event-protection-propss:
        end 2 end event protection props E2E_Props_P6_C_SomeIpEv_CR_FR_SuppSens_Ifc_Pr6_ST3: data-ids=553, e-2-e-profile-configuration=E2E_Profile_6, event=SomeIpEv_CR_FR_SuppSens_Ifc_Pr6_ST3, max-data-length=7152, min-data-length=432
      someip required event group SomeIpEG_SomeIpSI_CR_FR_SuppSens_Ifc_Pr6_ST3: event-group=EG_SomeIpSI_CR_FR_SuppSens_Ifc_Pr6_ST3, sd-client-event-group-timing-config=ClientEgSd_SomeIpEG_SomeIpSI_CR_FR_SuppSens_Ifc_Pr6_ST3
    SI_CR_RL_Sens_OutputData_Pr7_ST3_Base_ADAS6: service-interface=SomeIpSI_CR_RL_Sens_OutputData_Pr7_ST3, required-service-instance-id=41612, sd-client-config=ClientSd_SI_CR_RL_Sens_OutputData_Pr7_ST3_Base_ADAS6
      e-2-e-event-protection-propss:
        end 2 end event protection props E2E_Props_P7_C_SomeIpEv_CR_RL_Sens_OutputData_Pr7_ST3: data-ids=11, e-2-e-profile-configuration=E2E_Profile_7, event=SomeIpEv_CR_RL_Sens_OutputData_Pr7_ST3, max-data-length=976568, min-data-length=560
      someip required event group SomeIpEG_SomeIpSI_CR_RL_Sens_OutputData_Pr7_ST3: event-group=EG_SomeIpSI_CR_RL_Sens_OutputData_Pr7_ST3, sd-client-event-group-timing-config=ClientEgSd_SomeIpEG_SomeIpSI_CR_RL_Sens_OutputData_Pr7_ST3
    SI_CR_RL_SuppSens_Ifc_Pr6_ST3_Base_ADAS6: service-interface=SomeIpSI_CR_RL_SuppSens_Ifc_Pr6_ST3, required-service-instance-id=41616, sd-client-config=ClientSd_SI_CR_RL_SuppSens_Ifc_Pr6_ST3_Base_ADAS6
      e-2-e-event-protection-propss:
        end 2 end event protection props E2E_Props_P6_C_SomeIpEv_CR_RL_SuppSens_Ifc_Pr6_ST3: data-ids=554, e-2-e-profile-configuration=E2E_Profile_6, event=SomeIpEv_CR_RL_SuppSens_Ifc_Pr6_ST3, max-data-length=7152, min-data-length=432
      someip required event group SomeIpEG_SomeIpSI_CR_RL_SuppSens_Ifc_Pr6_ST3: event-group=EG_SomeIpSI_CR_RL_SuppSens_Ifc_Pr6_ST3, sd-client-event-group-timing-config=ClientEgSd_SomeIpEG_SomeIpSI_CR_RL_SuppSens_Ifc_Pr6_ST3
    SI_CR_RR_Sens_OutputData_Pr7_ST3_Base_ADAS6: service-interface=SomeIpSI_CR_RR_Sens_OutputData_Pr7_ST3, required-service-instance-id=41613, sd-client-config=ClientSd_SI_CR_RR_Sens_OutputData_Pr7_ST3_Base_ADAS6
      e-2-e-event-protection-propss:
        end 2 end event protection props E2E_Props_P7_C_SomeIpEv_SI_CR_RR_Sens_OutputData_Pr7_ST3: data-ids=7, e-2-e-profile-configuration=E2E_Profile_7, event=SomeIpEv_SI_CR_RR_Sens_OutputData_Pr7_ST3, max-data-length=976568, min-data-length=560
      someip required event group SomeIpEG_SomeIpSI_CR_RR_Sens_OutputData_Pr7_ST3: event-group=EG_SomeIpSI_CR_RR_Sens_OutputData_Pr7_ST3, sd-client-event-group-timing-config=ClientEgSd_SomeIpEG_SomeIpSI_CR_RR_Sens_OutputData_Pr7_ST3
    SI_CR_RR_SuppSens_Ifc_Pr6_ST3_Base_ADAS6: service-interface=SomeIpSI_CR_RR_SuppSens_Ifc_Pr6_ST3, required-service-instance-id=41617, sd-client-config=ClientSd_SI_CR_RR_SuppSens_Ifc_Pr6_ST3_Base_ADAS6
      e-2-e-event-protection-propss:
        end 2 end event protection props E2E_Props_P6_C_SomeIpEv_CR_RR_SuppSens_Ifc_Pr6_ST3: data-ids=555, e-2-e-profile-configuration=E2E_Profile_6, event=SomeIpEv_CR_RR_SuppSens_Ifc_Pr6_ST3, max-data-length=7152, min-data-length=432
      someip required event group SomeIpEG_SomeIpSI_CR_RR_SuppSens_Ifc_Pr6_ST3: event-group=EG_SomeIpSI_CR_RR_SuppSens_Ifc_Pr6_ST3, sd-client-event-group-timing-config=ClientEgSd_SomeIpEG_SomeIpSI_CR_RR_SuppSens_Ifc_Pr6_ST3
    SI_DI_Odo_Pr5_ST3_Base_ADAS6: service-interface=SomeIpSI_DI_Odo_Pr5_ST3, required-service-instance-id=1, sd-client-config=ClientSd_SI_DI_Odo_Pr5_ST3_Base_ADAS6
      e-2-e-event-protection-propss:
        end 2 end event protection props E2E_Props_P05_186_C: data-ids=186, data-length=48, e-2-e-profile-configuration=E2E_Profile_5, event=SomeIpEv_SI_DI_Odo_Pr5_ST3, max-data-length=7088, min-data-length=7088
      someip required event group SomeIpEG_SI_DI_Odo_Pr5_ST3: event-group=EG_SI_DI_Odo_Pr5_ST3, sd-client-event-group-timing-config=ClientEgSd_SomeIpEG_SI_DI_Odo_Pr5_ST3
    SI_Ign_Stat_Pr5_ST3_Base_ADAS6: service-interface=SomeIpSI_Ign_Stat_Pr5_ST3, required-service-instance-id=1, sd-client-config=ClientSd_SI_Ign_Stat_Pr5_ST3_Base_ADAS6
      e-2-e-event-protection-propss:
        end 2 end event protection props E2E_Props_P05_51_C: data-ids=51, data-length=32, e-2-e-profile-configuration=E2E_Profile_5, event=SomeIpEv_SI_Ign_Stat_Pr5_ST3, max-data-length=7088, min-data-length=7088
      someip required event group SomeIpEG_SI_Ign_Stat_Pr5_ST3: event-group=EG_SI_Ign_Stat_Pr5_ST3, sd-client-event-group-timing-config=ClientEgSd_SomeIpEG_SI_Ign_Stat_Pr5_ST3
    SI_MRR_Sens_OutputData_Pr7_ST3_Base_ADAS6: service-interface=SomeIpSI_MRR_Sens_OutputData_Pr7_ST3, required-service-instance-id=41609, sd-client-config=ClientSd_SI_MRR_Sens_OutputData_Pr7_ST3_Base_ADAS6
      e-2-e-event-protection-propss:
        end 2 end event protection props E2E_Props_P7_C_SomeIpEv_MRR_Sens_OutputData_Pr7_ST3: data-ids=8, e-2-e-profile-configuration=E2E_Profile_7, event=SomeIpEv_MRR_Sens_OutputData_Pr7_ST3, max-data-length=976568, min-data-length=560
      someip required event group SomeIpEG_SomeIpSI_MRR_Sens_OutputData_Pr7_ST3: event-group=EG_SomeIpSI_MRR_Sens_OutputData_Pr7_ST3, sd-client-event-group-timing-config=ClientEgSd_SomeIpEG_SomeIpSI_MRR_Sens_OutputData_Pr7_ST3
    SI_MRR_SuppSens_Ifc_Pr6_ST3_Base_ADAS6: service-interface=SomeIpSI_MRR_SuppSens_Ifc_Pr6_ST3, required-service-instance-id=41608, sd-client-config=ClientSd_SI_MRR_SuppSens_Ifc_Pr6_ST3_Base_ADAS6
      e-2-e-event-protection-propss:
        end 2 end event protection props E2E_Props_P6_C_SomeIpEv_MRR_SuppSens_Ifc_Pr6_ST3: data-ids=549, e-2-e-profile-configuration=E2E_Profile_6, event=SomeIpEv_MRR_SuppSens_Ifc_Pr6_ST3, max-data-length=7160, min-data-length=440
      someip required event group SomeIpSI_SomeIpSI_MRR_SuppSens_Ifc_Pr6_ST3: event-group=SI_SomeIpSI_MRR_SuppSens_Ifc_Pr6_ST3, sd-client-event-group-timing-config=ClientEgSd_SomeIpSI_SomeIpSI_MRR_SuppSens_Ifc_Pr6_ST3
    SI_PT4_PTCoor4_Pr5_ST3_Base_ADAS6: service-interface=SomeIpSI_PT4_PTCoor4_Pr5_ST3, required-service-instance-id=1, sd-client-config=ClientSd_SI_PT4_PTCoor4_Pr5_ST3_Base_ADAS6
      e-2-e-event-protection-propss:
        end 2 end event protection props E2E_Props_P05_196_C: data-ids=196, data-length=32, e-2-e-profile-configuration=E2E_Profile_5, event=SomeIpEv_SI_PT4_PTCoor4_Pr5_ST3, max-data-length=7088, min-data-length=7088
      someip required event group SomeIpEG_SI_PT4_PTCoor4_Pr5_ST3: event-group=EG_SI_PT4_PTCoor4_Pr5_ST3, sd-client-event-group-timing-config=ClientEgSd_SomeIpEG_SI_PT4_PTCoor4_Pr5_ST3
    comDummyServiceTwoInterface_Base_ADAS6: service-interface=SomeIpcomDummyServiceTwoInterface, required-service-instance-id=12346, sd-client-config=ClientSd_comDummyServiceTwoInterface_Base_ADAS6
      someip required event group SomeIpcomDummyTwoEventGroup: event-group=comDummyTwoEventGroup, sd-client-event-group-timing-config=ClientEgSd_SomeIpcomDummyTwoEventGroup
    dummyServiceOneInterface_testBase_ADAS6: service-interface=SomeIpdummyServiceInterface, someip-method-props=method=SomeIpaDummyMethod, required-service-instance-id=12347, sd-client-config=ClientSd_dummyServiceOneInterface_testBase_ADAS6
      someip required event group SomeIpdummyOneEventGroup: event-group=dummyOneEventGroup, sd-client-event-group-timing-config=ClientEgSd_SomeIpdummyOneEventGroup
    dummyServiceThreeInterface_testBase_ADAS6: service-interface=SomeIpdummyServiceThreeInterface, someip-method-props=method=SomeIpgetDummyDataTwo, required-service-instance-id=12348, sd-client-config=ClientSd_dummyServiceThreeInterface_testBase_ADAS6
      e-2-e-event-protection-propss:
        end 2 end event protection props E2E_Props_P7_C: data-ids=58, e-2-e-profile-configuration=E2E_Profile_7, event=SomeIpTwoDummyEvent, max-data-length=976568, min-data-length=560
      someip required event group SomeIpdummyTwoEventGroup: event-group=dummyTwoEventGroup, sd-client-event-group-timing-config=ClientEgSd_SomeIpdummyTwoEventGroup
    dummyServiceTwoInterface_testBase_ADAS6: service-interface=SomeIpdummyServiceTwoInterface, someip-method-props=method=SomeIpsetDummyDataThree, required-service-instance-id=12349, sd-client-config=ClientSd_dummyServiceTwoInterface_testBase_ADAS6
      e-2-e-event-protection-propss:
        end 2 end event protection props E2E_Props_P6_C: data-ids=56, e-2-e-profile-configuration=E2E_Profile_6, event=SomeIpThreeDummyEvent, max-data-length=1650, min-data-length=112
      someip required event group SomeIpdummyThreeEventGroup: event-group=dummyThreeEventGroup, sd-client-event-group-timing-config=ClientEgSd_SomeIpdummyThreeEventGroup
  required user defined service instance DiagnosticManager_RequiredBindingServiceInstance_DiagComApi: service-interface=DiagComApi_Binding
package /ServiceInstances/ServiceInstanceToMachineMappings
  23 x someip service instance to machine mapping:
    PN14_Master_stat1_ST3_Base_ADAS6Mapping: communication-connector=IDC_M_P_MAIN_20, service-instance=PN14_Master_stat1_ST3_Base_ADAS6, udp-port=40000
    SI_CR_FL_Sens_OutputData_Pr7_ST3_Base_ADAS6Mapping: communication-connector=IDC_M_P_MAIN_21, service-instance=SI_CR_FL_Sens_OutputData_Pr7_ST3_Base_ADAS6, udp-port=50000
    SI_CR_FL_SuppSens_Ifc_Pr6_ST3_Base_ADAS6Mapping: communication-connector=IDC_M_P_MAIN_21, service-instance=SI_CR_FL_SuppSens_Ifc_Pr6_ST3_Base_ADAS6, udp-port=40000
    SI_CR_FR_Sens_OutputData_Pr7_ST3_Base_ADAS6Mapping: communication-connector=IDC_M_P_MAIN_21, service-instance=SI_CR_FR_Sens_OutputData_Pr7_ST3_Base_ADAS6, udp-port=50000
    SI_CR_FR_SuppSens_Ifc_Pr6_ST3_Base_ADAS6Mapping: communication-connector=IDC_M_P_MAIN_21, service-instance=SI_CR_FR_SuppSens_Ifc_Pr6_ST3_Base_ADAS6, udp-port=40000
    SI_CR_RL_Sens_OutputData_Pr7_ST3_Base_ADAS6Mapping: communication-connector=IDC_M_P_MAIN_21, service-instance=SI_CR_RL_Sens_OutputData_Pr7_ST3_Base_ADAS6, udp-port=50000
    SI_CR_RL_SuppSens_Ifc_Pr6_ST3_Base_ADAS6Mapping: communication-connector=IDC_M_P_MAIN_21, service-instance=SI_CR_RL_SuppSens_Ifc_Pr6_ST3_Base_ADAS6, udp-port=40000
    SI_CR_RR_Sens_OutputData_Pr7_ST3_Base_ADAS6Mapping: communication-connector=IDC_M_P_MAIN_21, service-instance=SI_CR_RR_Sens_OutputData_Pr7_ST3_Base_ADAS6, udp-port=50000
    SI_CR_RR_SuppSens_Ifc_Pr6_ST3_Base_ADAS6Mapping: communication-connector=IDC_M_P_MAIN_21, service-instance=SI_CR_RR_SuppSens_Ifc_Pr6_ST3_Base_ADAS6, udp-port=40000
    SI_DI_Odo_Pr5_ST3_Base_ADAS6Mapping: communication-connector=IDC_M_P_MAIN_20, service-instance=SI_DI_Odo_Pr5_ST3_Base_ADAS6, udp-port=40000
    SI_ECU_Stat_IDC_M_P_ST3_Base_ADAS6Mapping: communication-connector=IDC_M_P_MAIN_127, service-instance=SI_ECU_Stat_IDC_M_P_ST3_Base_ADAS6, udp-port=40002
    SI_Ign_Stat_Pr5_ST3_Base_ADAS6Mapping: communication-connector=IDC_M_P_MAIN_20, service-instance=SI_Ign_Stat_Pr5_ST3_Base_ADAS6, udp-port=40000
    SI_MRR_Sens_OutputData_Pr7_ST3_Base_ADAS6Mapping: communication-connector=IDC_M_P_MAIN_21, service-instance=SI_MRR_Sens_OutputData_Pr7_ST3_Base_ADAS6, udp-port=50000
    SI_MRR_SuppSens_Ifc_Pr6_ST3_Base_ADAS6Mapping: communication-connector=IDC_M_P_MAIN_21, service-instance=SI_MRR_SuppSens_Ifc_Pr6_ST3_Base_ADAS6, udp-port=40000
    SI_PT4_PTCoor4_Pr5_ST3_Base_ADAS6Mapping: communication-connector=IDC_M_P_MAIN_20, service-instance=SI_PT4_PTCoor4_Pr5_ST3_Base_ADAS6, udp-port=40000
    comDummyServiceTwoInterface_Base_ADAS6Mapping: communication-connector=IDC_M_P_MAIN_21, service-instance=comDummyServiceTwoInterface_Base_ADAS6, udp-port=40000
    dummyServiceOneInterface_Base_ADAS6Mapping: communication-connector=IDC_M_P_MAIN_21, service-instance=dummyServiceOneInterface_Base_ADAS6, udp-port=40000
    dummyServiceThreeInterface_Base_ADAS6Mapping: communication-connector=IDC_M_P_MAIN_21, service-instance=dummyServiceThreeInterface_Base_ADAS6, udp-port=40000
    dummyServiceTwoInterface_Base_ADAS6Mapping: communication-connector=IDC_M_P_MAIN_21, service-instance=dummyServiceTwoInterface_Base_ADAS6, udp-port=40000
    comDummyServiceOneInterface_testBase_ADAS6Mapping: communication-connector=testBase_ADAS6, service-instance=comDummyServiceOneInterface_testBase_ADAS6, udp-port=40000
    dummyServiceOneInterface_testBase_ADAS6Mapping: communication-connector=testBase_ADAS6, service-instance=dummyServiceOneInterface_testBase_ADAS6, udp-port=40000
    dummyServiceThreeInterface_testBase_ADAS6Mapping: communication-connector=testBase_ADAS6, service-instance=dummyServiceThreeInterface_testBase_ADAS6, udp-port=40000
    dummyServiceTwoInterface_testBase_ADAS6Mapping: communication-connector=testBase_ADAS6, service-instance=dummyServiceTwoInterface_testBase_ADAS6, udp-port=40000
package /ServiceInstances/ServiceInstanceToPortPrototypeMappings
  25 x service instance to port prototype mapping:
    PPort1_BaseApplication_DummyServceOneInterface: port-prototype=BaseApplicationExecutableRootSwc.PPort1, process=BaseApplication, service-instance=dummyServiceOneInterface_Base_ADAS6
    PPort2_BaseApplication_dummyServceTwoInterface: port-prototype=BaseApplicationExecutableRootSwc.PPort2, process=BaseApplication, service-instance=dummyServiceTwoInterface_Base_ADAS6
    PPort3_BaseApplication_dummyServiceThreeInterface: port-prototype=BaseApplicationExecutableRootSwc.PPort3, process=BaseApplication, service-instance=dummyServiceThreeInterface_Base_ADAS6
    RPort1_BaseApplication_comDummyServiceTwoInterface: port-prototype=BaseApplicationExecutableRootSwc.RPort1, process=BaseApplication, service-instance=comDummyServiceTwoInterface_Base_ADAS6
    ServicePortMapping137: port-prototype=BaseApplicationExecutableRootSwc.R_DI_Odo_Pr5_ST3, process=BaseApplication, service-instance=SI_DI_Odo_Pr5_ST3_Base_ADAS6
    ServicePortMapping139: port-prototype=BaseApplicationExecutableRootSwc.R_PN14_Master_stat1_ST3, process=BaseApplication, service-instance=PN14_Master_stat1_ST3_Base_ADAS6
    ServicePortMapping147: port-prototype=BaseApplicationExecutableRootSwc.R_PT4_PTCoor4_Pr5_ST3, process=BaseApplication, service-instance=SI_PT4_PTCoor4_Pr5_ST3_Base_ADAS6
    ServicePortMapping149: port-prototype=BaseApplicationExecutableRootSwc.R_Ign_Stat_Pr5_ST3, process=BaseApplication, service-instance=SI_Ign_Stat_Pr5_ST3_Base_ADAS6
    ServicePortMapping154: port-prototype=BaseApplicationExecutableRootSwc.P_ECU_Stat_IDC_M_P_ST3, process=BaseApplication, service-instance=SI_ECU_Stat_IDC_M_P_ST3_Base_ADAS6
    ServicePortMapping160: port-prototype=BaseApplicationExecutableRootSwc.R_SI_CR_FL_Sens_OutputData_Pr7_ST3, process=BaseApplication, service-instance=SI_CR_FL_Sens_OutputData_Pr7_ST3_Base_ADAS6
    ServicePortMapping162: port-prototype=BaseApplicationExecutableRootSwc.R_CR_FL_SuppSens_Ifc_Pr6_ST3, process=BaseApplication, service-instance=SI_CR_FL_SuppSens_Ifc_Pr6_ST3_Base_ADAS6
    ServicePortMapping164: port-prototype=BaseApplicationExecutableRootSwc.R_CR_FR_Sens_OutputData_Pr7_ST3, process=BaseApplication, service-instance=SI_CR_FR_Sens_OutputData_Pr7_ST3_Base_ADAS6
    ServicePortMapping166: port-prototype=BaseApplicationExecutableRootSwc.R_CR_RR_SuppSens_Ifc_Pr6_ST3, process=BaseApplication, service-instance=SI_CR_RR_SuppSens_Ifc_Pr6_ST3_Base_ADAS6
    ServicePortMapping168: port-prototype=BaseApplicationExecutableRootSwc.R_MRR_SuppSens_Ifc_Pr6_ST3, process=BaseApplication, service-instance=SI_MRR_SuppSens_Ifc_Pr6_ST3_Base_ADAS6
    ServicePortMapping170: port-prototype=BaseApplicationExecutableRootSwc.R_CR_RL_SuppSens_Ifc_Pr6_ST3, process=BaseApplication, service-instance=SI_CR_RL_SuppSens_Ifc_Pr6_ST3_Base_ADAS6
    ServicePortMapping172: port-prototype=BaseApplicationExecutableRootSwc.R_CR_RL_Sens_OutputData_Pr7_ST3, process=BaseApplication, service-instance=SI_CR_RL_Sens_OutputData_Pr7_ST3_Base_ADAS6
    ServicePortMapping174: port-prototype=BaseApplicationExecutableRootSwc.R_CR_RR_Sens_OutputData_Pr7_ST3, process=BaseApplication, service-instance=SI_CR_RR_Sens_OutputData_Pr7_ST3_Base_ADAS6
    ServicePortMapping176: port-prototype=BaseApplicationExecutableRootSwc.R_MRR_Sens_OutputData_Pr7_ST3, process=BaseApplication, service-instance=SI_MRR_Sens_OutputData_Pr7_ST3_Base_ADAS6
    ServicePortMapping178: port-prototype=BaseApplicationExecutableRootSwc.R_CR_FR_SuppSens_Ifc_Pr6_ST3, process=BaseApplication, service-instance=SI_CR_FR_SuppSens_Ifc_Pr6_ST3_Base_ADAS6
    SelfDiagAgent_ProvidedBindingServiceInstance_DiagComApi_toPort: port-prototype=SelfDiagnosticAgentExecutableRootSwc.amsr_DiagComApi, process=SelfDiagnosticAgent, service-instance=SelfDiagAgent_ProvidedBindingServiceInstance_DiagComApi
    SelfDiagAgent_RequiredBindingServiceInstance_DiagComApi_toPort: port-prototype=DiagnosticManagerDeamonExecutableRootSwc.DiagComApiDeamonPort, process=DiagnosticManagerDeamon, service-instance=DiagnosticManager_RequiredBindingServiceInstance_DiagComApi
    PPort1_TestBaseApplication_comDummyServiceOneInterface: port-prototype=TestBaseApplicationExecutableRootSwc.PPort1, process=TestBaseApplication, service-instance=comDummyServiceOneInterface_testBase_ADAS6
    RPort2_TestBaseApplication_dummyServceTwoInterface: port-prototype=TestBaseApplicationExecutableRootSwc.RPort2, process=TestBaseApplication, service-instance=dummyServiceTwoInterface_testBase_ADAS6
    RPort3_TestBaseApplication_DummyServceThreeInterface: port-prototype=TestBaseApplicationExecutableRootSwc.RPort3, process=TestBaseApplication, service-instance=dummyServiceThreeInterface_testBase_ADAS6
    Rport1_TestBaseApplication_dummyServceOneInterface: port-prototype=TestBaseApplicationExecutableRootSwc.RPort1, process=TestBaseApplication, service-instance=dummyServiceOneInterface_testBase_ADAS6
package /ServiceInstances/ServiceInstanceToSignalMappingSets
  5 x service instance to signal mapping set:
    PN14_Master_stat1_ST3_Base_ADAS6_MappingSet
      service instance to signal mapping PN14_Master_stat1_ST3_Base_ADAS6_Ev_SI_PN14_Master_stat1_ST3: service-instance=PN14_Master_stat1_ST3_Base_ADAS6
        event-element-mappings:
          {data-prototype-in-service-interface=element-in-impl-datatype={root-data-prototype=Ev_SI_PN14_Master_stat1_ST3, target-data-prototype=PN14_DDP_Sw2_Stat_ST3}, i-signal-triggering=PN14_DDP_Sw2_Stat_ST3}
          {data-prototype-in-service-interface=element-in-impl-datatype={root-data-prototype=Ev_SI_PN14_Master_stat1_ST3, target-data-prototype=PN14_DDP_Sw_Stat_ST3}, i-signal-triggering=PN14_DDP_Sw_Stat_ST3}
          {data-prototype-in-service-interface=element-in-impl-datatype={root-data-prototype=Ev_SI_PN14_Master_stat1_ST3, target-data-prototype=PN14_ExtBat_Charge_Actv_ST3}, i-signal-triggering=PN14_ExtBat_Charge_Actv_ST3}
          {data-prototype-in-service-interface=element-in-impl-datatype={root-data-prototype=Ev_SI_PN14_Master_stat1_ST3, target-data-prototype=PN14_PNSec_RechargeEnable_ST3}, i-signal-triggering=PN14_PNSec_RechargeEnable_ST3}
          {data-prototype-in-service-interface=element-in-impl-datatype={root-data-prototype=Ev_SI_PN14_Master_stat1_ST3, target-data-prototype=PN14_ProdMd_BatStat_ST3}, i-signal-triggering=PN14_ProdMd_BatStat_ST3}
          {data-prototype-in-service-interface=element-in-impl-datatype={root-data-prototype=Ev_SI_PN14_Master_stat1_ST3, target-data-prototype=PN14_ProdMd_Stat_ST3}, i-signal-triggering=PN14_ProdMd_Stat_ST3}
          {data-prototype-in-service-interface=element-in-impl-datatype={root-data-prototype=Ev_SI_PN14_Master_stat1_ST3, target-data-prototype=PN14_SupBat_Curr_ST3}, i-signal-triggering=PN14_SupBat_Curr_ST3}
          {data-prototype-in-service-interface=element-in-impl-datatype={root-data-prototype=Ev_SI_PN14_Master_stat1_ST3, target-data-prototype=PN14_SupBat_Stat_ST3}, i-signal-triggering=PN14_SupBat_Stat_ST3}
          {data-prototype-in-service-interface=element-in-impl-datatype={root-data-prototype=Ev_SI_PN14_Master_stat1_ST3, target-data-prototype=PN14_SupBat_Temp_ST3}, i-signal-triggering=PN14_SupBat_Temp_ST3}
          {data-prototype-in-service-interface=element-in-impl-datatype={root-data-prototype=Ev_SI_PN14_Master_stat1_ST3, target-data-prototype=PN14_SupBat_Volt_ST3}, i-signal-triggering=PN14_SupBat_Volt_ST3}
          {data-prototype-in-service-interface=element-in-impl-datatype={root-data-prototype=Ev_SI_PN14_Master_stat1_ST3, target-data-prototype=PN14_TransMd_Stat_ST3}, i-signal-triggering=PN14_TransMd_Stat_ST3}
          data-prototype-in-service-interface=Ev_SI_PN14_Master_stat1_ST3, i-signal-triggering=PN14_Master_stat1_ST3_SG
    SI_DI_Odo_Pr5_ST3_Base_ADAS6_MappingSet
      service instance to signal mapping SI_DI_Odo_Pr5_ST3_Base_ADAS6_Ev_SI_DI_Odo_Pr5_ST3: service-instance=SI_DI_Odo_Pr5_ST3_Base_ADAS6
        event-element-mappings:
          {data-prototype-in-service-interface=element-in-impl-datatype={root-data-prototype=Ev_SI_DI_Odo_Pr5_ST3, target-data-prototype=Odo_ST3}, i-signal-triggering=Odo_ST3_DI_Odo_Pr5_ST3}
          data-prototype-in-service-interface=Ev_SI_DI_Odo_Pr5_ST3, i-signal-triggering=DI_Odo_Pr5_ST3
    SI_ECU_Stat_IDC_M_P_ST3_Base_ADAS6_MappingSet
      service instance to signal mapping SI_ECU_Stat_IDC_M_P_ST3_Base_ADAS6_Ev_ECU_Stat_IDC_M_P_ST3: service-instance=SI_ECU_Stat_IDC_M_P_ST3_Base_ADAS6
        event-element-mappings:
          {data-prototype-in-service-interface=element-in-impl-datatype={root-data-prototype=Ev_ECU_Stat_IDC_M_P_ST3, target-data-prototype=Awake_Diag_Actv_IDC_M_P_ST3}, i-signal-triggering=Awake_Diag_Actv_IDC_M_P_ST3}
          {data-prototype-in-service-interface=element-in-impl-datatype={root-data-prototype=Ev_ECU_Stat_IDC_M_P_ST3, target-data-prototype=Awake_HAD_Actv_IDC_M_P_ST3}, i-signal-triggering=Awake_HAD_Actv_IDC_M_P_ST3}
          {data-prototype-in-service-interface=element-in-impl-datatype={root-data-prototype=Ev_ECU_Stat_IDC_M_P_ST3, target-data-prototype=Awake_Ignition_On_IDC_M_P_ST3}, i-signal-triggering=Awake_Ignition_On_IDC_M_P_ST3}
          {data-prototype-in-service-interface=element-in-impl-datatype={root-data-prototype=Ev_ECU_Stat_IDC_M_P_ST3, target-data-prototype=Awake_NwStart_IDC_M_P_ST3}, i-signal-triggering=Awake_NwStart_IDC_M_P_ST3}
          {data-prototype-in-service-interface=element-in-impl-datatype={root-data-prototype=Ev_ECU_Stat_IDC_M_P_ST3, target-data-prototype=ECU_Id_IDC_M_P_ST3}, i-signal-triggering=ECU_Id_IDC_M_P_ST3}
          {data-prototype-in-service-interface=element-in-impl-datatype={root-data-prototype=Ev_ECU_Stat_IDC_M_P_ST3, target-data-prototype=NwId_Rsrv_ST3}, i-signal-triggering=NwId_Rsrv_ST3}
          {data-prototype-in-service-interface=element-in-impl-datatype={root-data-prototype=Ev_ECU_Stat_IDC_M_P_ST3, target-data-prototype=WakeupRsn_IDC_M_P_ST3}, i-signal-triggering=WakeupRsn_IDC_M_P_ST3}
          data-prototype-in-service-interface=Ev_ECU_Stat_IDC_M_P_ST3, i-signal-triggering=ECU_Stat_IDC_M_P_ST3_SG
    SI_Ign_Stat_Pr5_ST3_Base_ADAS6_MappingSet
      service instance to signal mapping SI_Ign_Stat_Pr5_ST3_Base_ADAS6_Ev_SI_Ign_Stat_Pr5_ST3: service-instance=SI_Ign_Stat_Pr5_ST3_Base_ADAS6
        event-element-mappings:
          {data-prototype-in-service-interface=element-in-impl-datatype={root-data-prototype=Ev_SI_Ign_Stat_Pr5_ST3, target-data-prototype=ISw_Stat_ST3}, i-signal-triggering=ISw_Stat_ST3}
          {data-prototype-in-service-interface=element-in-impl-datatype={root-data-prototype=Ev_SI_Ign_Stat_Pr5_ST3, target-data-prototype=KG_StartSw_Psd_ST3}, i-signal-triggering=KG_StartSw_Psd_ST3}
          {data-prototype-in-service-interface=element-in-impl-datatype={root-data-prototype=Ev_SI_Ign_Stat_Pr5_ST3, target-data-prototype=Veh_Op_Mode_ST3}, i-signal-triggering=Veh_Op_Mode_ST3}
          data-prototype-in-service-interface=Ev_SI_Ign_Stat_Pr5_ST3, i-signal-triggering=Ign_Stat_Pr5_ST3
    SI_PT4_PTCoor4_Pr5_ST3_Base_ADAS6_MappingSet
      service instance to signal mapping SI_PT4_PTCoor4_Pr5_ST3_Base_ADAS6_Ev_SI_PT4_PTCoor4_Pr5_ST3: service-instance=SI_PT4_PTCoor4_Pr5_ST3_Base_ADAS6
        event-element-mappings:
          {data-prototype-in-service-interface=element-in-impl-datatype={root-data-prototype=Ev_SI_PT4_PTCoor4_Pr5_ST3, target-data-prototype=PT4_PTCoor_EngStartPN14_Stat_ST3}, i-signal-triggering=PT4_PTCoor_EngStartPN14_Stat_ST3}
          {data-prototype-in-service-interface=element-in-impl-datatype={root-data-prototype=Ev_SI_PT4_PTCoor4_Pr5_ST3, target-data-prototype=PT4_PTCoor_PT_Rdy_ST3}, i-signal-triggering=PT4_PTCoor_PT_Rdy_ST3}
          {data-prototype-in-service-interface=element-in-impl-datatype={root-data-prototype=Ev_SI_PT4_PTCoor4_Pr5_ST3, target-data-prototype=PT4_PTCoor_SSA_EngSp_ST3}, i-signal-triggering=PT4_PTCoor_SSA_EngSp_ST3}
          {data-prototype-in-service-interface=element-in-impl-datatype={root-data-prototype=Ev_SI_PT4_PTCoor4_Pr5_ST3, target-data-prototype=Rsrv1_PT4_PTCoor_PT_Rdy_Pr5_ST3}, i-signal-triggering=Rsrv1_PT4_PTCoor_PT_Rdy_Pr5_ST3}
          data-prototype-in-service-interface=Ev_SI_PT4_PTCoor4_Pr5_ST3, i-signal-triggering=PT4_PTCoor4_Pr5_ST3
package /ServiceInstances/SomeipSdTimingConfigs
  18 x someip sd client event group timing config, all with request-response-delay={max-value=0.02, min-value=0}, time-to-live=16777215:
    ClientEgSd_SomeIpEG_IG_CR_FL_Sens_OutputData_Pr7_ST3
    ClientEgSd_SomeIpEG_SI_DI_Odo_Pr5_ST3
    ClientEgSd_SomeIpEG_SI_Ign_Stat_Pr5_ST3
    ClientEgSd_SomeIpEG_SI_PN14_ProdMd_Stat_ST3
    ClientEgSd_SomeIpEG_SI_PT4_PTCoor4_Pr5_ST3
    ClientEgSd_SomeIpEG_SomeIpEv_CR_FL_SuppSens_Ifc_Pr6_ST3
    ClientEgSd_SomeIpEG_SomeIpSI_CR_FR_Sens_OutputData_Pr7_ST3
    ClientEgSd_SomeIpEG_SomeIpSI_CR_FR_SuppSens_Ifc_Pr6_ST3
    ClientEgSd_SomeIpEG_SomeIpSI_CR_RL_Sens_OutputData_Pr7_ST3
    ClientEgSd_SomeIpEG_SomeIpSI_CR_RL_SuppSens_Ifc_Pr6_ST3
    ClientEgSd_SomeIpEG_SomeIpSI_CR_RR_Sens_OutputData_Pr7_ST3
    ClientEgSd_SomeIpEG_SomeIpSI_CR_RR_SuppSens_Ifc_Pr6_ST3
    ClientEgSd_SomeIpEG_SomeIpSI_MRR_Sens_OutputData_Pr7_ST3
    ClientEgSd_SomeIpSI_SomeIpSI_MRR_SuppSens_Ifc_Pr6_ST3
    ClientEgSd_SomeIpcomDummyTwoEventGroup
    ClientEgSd_SomeIpdummyOneEventGroup
    ClientEgSd_SomeIpdummyThreeEventGroup
    ClientEgSd_SomeIpdummyTwoEventGroup
  18 x someip sd client service instance config, all with initial-find-behavior={initial-delay-max-value=0.035, initial-delay-min-value=0.035, initial-repetitions-base-delay=0.04, initial-repetitions-max=9}, service-find-time-to-live=6777215:
    ClientSd_PN14_Master_stat1_ST3_Base_ADAS6
    ClientSd_SI_CR_FL_Sens_OutputData_Pr7_ST3_Base_ADAS6
    ClientSd_SI_CR_FL_SuppSens_Ifc_Pr6_ST3_Base_ADAS6
    ClientSd_SI_CR_FR_Sens_OutputData_Pr7_ST3_Base_ADAS6
    ClientSd_SI_CR_FR_SuppSens_Ifc_Pr6_ST3_Base_ADAS6
    ClientSd_SI_CR_RL_Sens_OutputData_Pr7_ST3_Base_ADAS6
    ClientSd_SI_CR_RL_SuppSens_Ifc_Pr6_ST3_Base_ADAS6
    ClientSd_SI_CR_RR_Sens_OutputData_Pr7_ST3_Base_ADAS6
    ClientSd_SI_CR_RR_SuppSens_Ifc_Pr6_ST3_Base_ADAS6
    ClientSd_SI_DI_Odo_Pr5_ST3_Base_ADAS6
    ClientSd_SI_Ign_Stat_Pr5_ST3_Base_ADAS6
    ClientSd_SI_MRR_Sens_OutputData_Pr7_ST3_Base_ADAS6
    ClientSd_SI_MRR_SuppSens_Ifc_Pr6_ST3_Base_ADAS6
    ClientSd_SI_PT4_PTCoor4_Pr5_ST3_Base_ADAS6
    ClientSd_comDummyServiceTwoInterface_Base_ADAS6
    ClientSd_dummyServiceOneInterface_testBase_ADAS6
    ClientSd_dummyServiceThreeInterface_testBase_ADAS6
    ClientSd_dummyServiceTwoInterface_testBase_ADAS6
  5 x someip sd server event group timing config, all with request-response-delay={max-value=0, min-value=0}:
    ServerEgSd_SomeIpEG_SI_ECU_STAT
    ServerEgSd_SomeIpdummyOneEventGroup
    ServerEgSd_SomeIpdummyThreeEventGroup
    ServerEgSd_SomeIpdummyTwoEventGroup
    ServerEgSd_SomeIpcomDummyOneEventGroup
  5 x someip sd server service instance config, all with initial-offer-behavior={initial-delay-max-value=0.035, initial-delay-min-value=0.035, initial-repetitions-base-delay=0.15, initial-repetitions-max=2}, offer-cyclic-delay=10, request-response-delay={max-value=0, min-value=0}, service-offer-time-to-live=16777215:
    ServerSd_SI_ECU_Stat_IDC_M_P_ST3_Base_ADAS6
    ServerSd_dummyServiceOneInterface_Base_ADAS6
    ServerSd_dummyServiceThreeInterface_Base_ADAS6
    ServerSd_dummyServiceTwoInterface_Base_ADAS6
    ServerSd_comDummyServiceOneInterface_testBase_ADAS6
package /ServiceInterfaces
  20 x service interface:
    PN14_Master_stat1_ST3
      namespaces:
        symbol props SI_PN14_ProdMd_Stat_ST3
      events:
        data Ev_SI_PN14_Master_stat1_ST3: type=REC_PN14_Master_Stat1_ST3
    SI_CR_FL_Sens_OutputData_Pr7_ST3
      namespaces:
        symbol props SI_CR_FL_Sens_OutputData_Pr7_ST3
      events:
        data Ev_CR_FL_Sens_OutputData_Pr7_ST3: type=REC_CR_FL_Sens_OutputData_Pr7_ST3
    SI_CR_FL_SuppSens_Ifc_Pr6_ST3
      namespaces:
        symbol props SI_CR_FL_SuppSens_Ifc_Pr6_ST3
      events:
        data Ev_CR_FL_SuppSens_Ifc_Pr6_ST3: type=REC_CR_FL_SuppSens_Ifc_Pr6_ST3
    SI_CR_FR_Sens_OutputData_Pr7_ST3
      namespaces:
        symbol props SI_CR_FR_Sens_OutputData_Pr7_ST3
      events:
        data Ev_CR_FR_Sens_OutputData_Pr7_ST3: type=REC_CR_FR_Sens_OutputData_Pr7_ST3
    SI_CR_FR_SuppSens_Ifc_Pr6_ST3
      namespaces:
        symbol props SI_CR_FR_SuppSens_Ifc_Pr6_ST3
      events:
        data Ev_CR_FR_SuppSens_Ifc_Pr6_ST3: type=REC_CR_FR_SuppSens_Ifc_Pr6_ST3
    SI_CR_RL_Sens_OutputData_Pr7_ST3
      namespaces:
        symbol props SI_CR_RL_Sens_OutputData_Pr7_ST3
      events:
        data Ev_CR_RL_Sens_OutputData_Pr7_ST3: type=REC_CR_RL_Sens_OutputData_Pr7_ST3
    SI_CR_RL_SuppSens_Ifc_Pr6_ST3
      namespaces:
        symbol props SI_CR_RL_SuppSens_Ifc_Pr6_ST3
      events:
        data Ev_CR_RL_SuppSens_Ifc_Pr6_ST3: type=REC_CR_RL_SuppSens_Ifc_Pr6_ST3
    SI_CR_RR_Sens_OutputData_Pr7_ST3
      namespaces:
        symbol props SI_CR_RR_Sens_OutputData_Pr7_ST3
      events:
        data Ev_SI_CR_RR_Sens_OutputData_Pr7_ST3: type=REC_CR_RR_Sens_OutputData_Pr7_ST3
    SI_CR_RR_SuppSens_Ifc_Pr6_ST3
      namespaces:
        symbol props SI_CR_RR_SuppSens_Ifc_Pr6_ST3
      events:
        data Ev_CR_RR_SuppSens_Ifc_Pr6_ST3: type=REC_CR_RR_SuppSens_Ifc_Pr6_ST3
    SI_DI_Odo_Pr5_ST3
      namespaces:
        symbol props SI_DI_Odo_Pr5_ST3
      events:
        data Ev_SI_DI_Odo_Pr5_ST3: type=REC_DI_Odo_Pr5_ST3
    SI_ECU_Stat_IDC_M_P_ST3
      namespaces:
        symbol props SI_ECU_Stat_IDC_M_P_ST3
      events:
        data Ev_ECU_Stat_IDC_M_P_ST3: type=REC_ECU_Stat_IDC_M_P_ST3
    SI_Ign_Stat_Pr5_ST3
      namespaces:
        symbol props SI_Ign_Stat_Pr5_ST3
      events:
        data Ev_SI_Ign_Stat_Pr5_ST3: type=REC_Ign_Stat_Pr5_ST3
    SI_MRR_Sens_OutputData_Pr7_ST3
      namespaces:
        symbol props SI_MRR_Sens_OutputData_Pr7_ST3
      events:
        data Ev_MRR_Sens_OutputData_Pr7_ST3: type=REC_MRR_Sens_OutputData_Pr7_ST3
    SI_MRR_SuppSens_Ifc_Pr6_ST3
      namespaces:
        symbol props SI_MRR_SuppSens_Ifc_Pr6_ST3
      events:
        data Ev_MRR_SuppSens_Ifc_Pr6_ST3: type=REC_MRR_SuppSens_Ifc_Pr6_ST3
    SI_PT4_PTCoor4_Pr5_ST3
      namespaces:
        symbol props SI_PT4_PTCoor4_Pr5_ST3
      events:
        data Ev_SI_PT4_PTCoor4_Pr5_ST3: type=REC_PT4_PTCoor4_Pr5_ST3
    comDummyServiceTwoInterface
      namespaces:
        symbol props comDummyServiceTwoInterface
      events:
        data aComDummyTwoEvent: type=uint32_t
    dummyServiceOneInterface
      namespaces:
        symbol props dummyServiceOneInterface
      events:
        data OneDummyEvent: type=REC_aDummyRecord
      methods:
        operation getDummyDataOne: fire-and-forget=false
          arg ParameterIn: type=uint32_t, direction=IN
          arg ParameterOut: type=REC_aDummyRecord, direction=OUT
    dummyServiceThreeInterface
      namespaces:
        symbol props dummyServiceThreeInterface
      events:
        data TwoDummyEvent: type=REC_Uint8_Uint16_Uint16_AdAR
      methods:
        operation getDummyDataTwo: fire-and-forget=false
          arg UML_Parameter105: type=uint32_t, direction=OUT
    dummyServiceTwoInterface
      namespaces:
        symbol props dummyServiceTwoInterface
      events:
        data ThreeDummyEvent: type=REC_StatArray_AdAR
      methods:
        operation setDummyDataThree: fire-and-forget=false
          arg UML_Parameter106: type=uint16_t, direction=IN
    comDummyServiceOneInterface
      namespaces:
        symbol props comDummyServiceOneInterface
      events:
        data aComDummyOneEvent: type=ARR_Stat_REC_600
package /ServiceInterfaces/InterfaceMappingSets
  interface mapping set InterfaceMappingSet
    5 x interface mapping:
      PN14_Master_stat1_ST3_InterfaceMapping
        event mapping Ev_SI_PN14_Master_stat1_ST3_PN14_Master_stat1_ST3: data-element=PN14_Master_stat1_ST3, event=Ev_SI_PN14_Master_stat1_ST3
      SI_DI_Odo_Pr5_ST3_InterfaceMapping
        event mapping Ev_SI_DI_Odo_Pr5_ST3_DI_Odo_Pr5_ST3: data-element=DI_Odo_Pr5_ST3, event=Ev_SI_DI_Odo_Pr5_ST3
      SI_ECU_Stat_IDC_M_P_ST3_InterfaceMapping
        event mapping Ev_ECU_Stat_IDC_M_P_ST3_ECU_Stat_IDC_M_P_ST3: data-element=ECU_Stat_IDC_M_P_ST3, event=Ev_ECU_Stat_IDC_M_P_ST3
      SI_Ign_Stat_Pr5_ST3_InterfaceMapping
        event mapping Ev_SI_Ign_Stat_Pr5_ST3_Ign_Stat_Pr5_ST3: data-element=Ign_Stat_Pr5_ST3, event=Ev_SI_Ign_Stat_Pr5_ST3
      SI_PT4_PTCoor4_Pr5_ST3_InterfaceMapping
        event mapping Ev_SI_PT4_PTCoor4_Pr5_ST3_PT4_PTCoor4_Pr5_ST3: data-element=PT4_PTCoor4_Pr5_ST3, event=Ev_SI_PT4_PTCoor4_Pr5_ST3
package /ServiceInterfaces/ServiceInterfaceDeployments
  5 x signal based service interface deployment:
    PN14_Master_stat1_ST3_Base_ADAS6_SignalBasedDeployment: service-interface=PN14_Master_stat1_ST3
    SI_DI_Odo_Pr5_ST3_Base_ADAS6_SignalBasedDeployment: service-interface=SI_DI_Odo_Pr5_ST3
    SI_ECU_Stat_IDC_M_P_ST3_Base_ADAS6_SignalBasedDeployment: service-interface=SI_ECU_Stat_IDC_M_P_ST3
    SI_Ign_Stat_Pr5_ST3_Base_ADAS6_SignalBasedDeployment: service-interface=SI_Ign_Stat_Pr5_ST3
    SI_PT4_PTCoor4_Pr5_ST3_Base_ADAS6_SignalBasedDeployment: service-interface=SI_PT4_PTCoor4_Pr5_ST3
  20 x someip service interface deployment, all with service-interface-version={major-version=1, minor-version=0}:
    SomeIpSI_CR_FL_Sens_OutputData_Pr7_ST3: service-interface=SI_CR_FL_Sens_OutputData_Pr7_ST3, service-interface-id=41611
      someip event deployment SomeIpEv_CR_FL_Sens_OutputData_Pr7_ST3: event=Ev_CR_FL_Sens_OutputData_Pr7_ST3, event-id=32800, transport-protocol=UDP
      someip event group EG_SomeIpSI_CR_FL_Sens_OutputData_Pr7_ST3: event-group-id=0, event=SomeIpEv_CR_FL_Sens_OutputData_Pr7_ST3
    SomeIpSI_CR_FL_SuppSens_Ifc_Pr6_ST3: service-interface=SI_CR_FL_SuppSens_Ifc_Pr6_ST3, service-interface-id=41614
      someip event deployment SomeIpEv_CR_FL_SuppSens_Ifc_Pr6_ST3: event=Ev_CR_FL_SuppSens_Ifc_Pr6_ST3, event-id=32807, transport-protocol=UDP
      someip event group EG_SomeIpEv_CR_FL_SuppSens_Ifc_Pr6_ST3: event-group-id=0, event=SomeIpEv_CR_FL_SuppSens_Ifc_Pr6_ST3
    SomeIpSI_CR_FR_Sens_OutputData_Pr7_ST3: service-interface=SI_CR_FR_Sens_OutputData_Pr7_ST3, service-interface-id=41610
      someip event deployment SomeIpEv_CR_FR_Sens_OutputData_Pr7_ST3: event=Ev_CR_FR_Sens_OutputData_Pr7_ST3, event-id=32804, transport-protocol=UDP
      someip event group EG_SomeIpSI_CR_FR_Sens_OutputData_Pr7_ST3: event-group-id=0, event=SomeIpEv_CR_FR_Sens_OutputData_Pr7_ST3
    SomeIpSI_CR_FR_SuppSens_Ifc_Pr6_ST3: service-interface=SI_CR_FR_SuppSens_Ifc_Pr6_ST3, service-interface-id=41615
      someip event deployment SomeIpEv_CR_FR_SuppSens_Ifc_Pr6_ST3: event=Ev_CR_FR_SuppSens_Ifc_Pr6_ST3, event-id=32805, transport-protocol=UDP
      someip event group EG_SomeIpSI_CR_FR_SuppSens_Ifc_Pr6_ST3: event-group-id=0, event=SomeIpEv_CR_FR_SuppSens_Ifc_Pr6_ST3
    SomeIpSI_CR_RL_Sens_OutputData_Pr7_ST3: service-interface=SI_CR_RL_Sens_OutputData_Pr7_ST3, service-interface-id=41612
      someip event deployment SomeIpEv_CR_RL_Sens_OutputData_Pr7_ST3: event=Ev_CR_RL_Sens_OutputData_Pr7_ST3, event-id=32803, transport-protocol=UDP
      someip event group EG_SomeIpSI_CR_RL_Sens_OutputData_Pr7_ST3: event-group-id=0, event=SomeIpEv_CR_RL_Sens_OutputData_Pr7_ST3
    SomeIpSI_CR_RL_SuppSens_Ifc_Pr6_ST3: service-interface=SI_CR_RL_SuppSens_Ifc_Pr6_ST3, service-interface-id=41616
      someip event deployment SomeIpEv_CR_RL_SuppSens_Ifc_Pr6_ST3: event=Ev_CR_RL_SuppSens_Ifc_Pr6_ST3, event-id=32806, transport-protocol=UDP
      someip event group EG_SomeIpSI_CR_RL_SuppSens_Ifc_Pr6_ST3: event-group-id=0, event=SomeIpEv_CR_RL_SuppSens_Ifc_Pr6_ST3
    SomeIpSI_CR_RR_Sens_OutputData_Pr7_ST3: service-interface=SI_CR_RR_Sens_OutputData_Pr7_ST3, service-interface-id=41613
      someip event deployment SomeIpEv_SI_CR_RR_Sens_OutputData_Pr7_ST3: event=Ev_SI_CR_RR_Sens_OutputData_Pr7_ST3, event-id=32801, transport-protocol=UDP
      someip event group EG_SomeIpSI_CR_RR_Sens_OutputData_Pr7_ST3: event-group-id=0, event=SomeIpEv_SI_CR_RR_Sens_OutputData_Pr7_ST3
    SomeIpSI_CR_RR_SuppSens_Ifc_Pr6_ST3: service-interface=SI_CR_RR_SuppSens_Ifc_Pr6_ST3, service-interface-id=41617
      someip event deployment SomeIpEv_CR_RR_SuppSens_Ifc_Pr6_ST3: event=Ev_CR_RR_SuppSens_Ifc_Pr6_ST3, event-id=32802, transport-protocol=UDP
      someip event group EG_SomeIpSI_CR_RR_SuppSens_Ifc_Pr6_ST3: event-group-id=0, event=SomeIpEv_CR_RR_SuppSens_Ifc_Pr6_ST3
    SomeIpSI_DI_Odo_Pr5_ST3: service-interface=SI_DI_Odo_Pr5_ST3, service-interface-id=12804
      someip event deployment SomeIpEv_SI_DI_Odo_Pr5_ST3: event=Ev_SI_DI_Odo_Pr5_ST3, event-id=0, transport-protocol=UDP
      someip event group EG_SI_DI_Odo_Pr5_ST3: event-group-id=0, event=SomeIpEv_SI_DI_Odo_Pr5_ST3
    SomeIpSI_ECU_Stat_IDC_M_P_ST3: service-interface=SI_ECU_Stat_IDC_M_P_ST3, service-interface-id=41635
      someip event deployment SomeIpEv_ECU_Stat_IDC_M_P_ST3: event=Ev_ECU_Stat_IDC_M_P_ST3, event-id=32798, transport-protocol=UDP
      someip event group EG_SI_ECU_STAT: event-group-id=1, event=SomeIpEv_ECU_Stat_IDC_M_P_ST3
    SomeIpSI_Ign_Stat_Pr5_ST3: service-interface=SI_Ign_Stat_Pr5_ST3, service-interface-id=128
      someip event deployment SomeIpEv_SI_Ign_Stat_Pr5_ST3: event=Ev_SI_Ign_Stat_Pr5_ST3, event-id=0, transport-protocol=UDP
      someip event group EG_SI_Ign_Stat_Pr5_ST3: event-group-id=0, event=SomeIpEv_SI_Ign_Stat_Pr5_ST3
    SomeIpSI_MRR_Sens_OutputData_Pr7_ST3: service-interface=SI_MRR_Sens_OutputData_Pr7_ST3, service-interface-id=41609
      someip event deployment SomeIpEv_MRR_Sens_OutputData_Pr7_ST3: event=Ev_MRR_Sens_OutputData_Pr7_ST3, event-id=32808, transport-protocol=UDP
      someip event group EG_SomeIpSI_MRR_Sens_OutputData_Pr7_ST3: event-group-id=0, event=SomeIpEv_MRR_Sens_OutputData_Pr7_ST3
    SomeIpSI_MRR_SuppSens_Ifc_Pr6_ST3: service-interface=SI_MRR_SuppSens_Ifc_Pr6_ST3, service-interface-id=41608
      someip event deployment SomeIpEv_MRR_SuppSens_Ifc_Pr6_ST3: event=Ev_MRR_SuppSens_Ifc_Pr6_ST3, event-id=32809, transport-protocol=UDP
      someip event group SI_SomeIpSI_MRR_SuppSens_Ifc_Pr6_ST3: event-group-id=0, event=SomeIpEv_MRR_SuppSens_Ifc_Pr6_ST3
    SomeIpSI_PN14_Master_stat1_ST3: service-interface=PN14_Master_stat1_ST3, service-interface-id=14720
      someip event deployment SomeIpEv_SI_PN14_TransMd_Stat_ST3: event=Ev_SI_PN14_Master_stat1_ST3, event-id=0, transport-protocol=UDP
      someip event group EG_SI_PN14_ProdMd_Stat_ST3: event-group-id=0, event=SomeIpEv_SI_PN14_TransMd_Stat_ST3
    SomeIpSI_PT4_PTCoor4_Pr5_ST3: service-interface=SI_PT4_PTCoor4_Pr5_ST3, service-interface-id=14596
      someip event deployment SomeIpEv_SI_PT4_PTCoor4_Pr5_ST3: event=Ev_SI_PT4_PTCoor4_Pr5_ST3, event-id=6, transport-protocol=UDP
      someip event group EG_SI_PT4_PTCoor4_Pr5_ST3: event-group-id=0, event=SomeIpEv_SI_PT4_PTCoor4_Pr5_ST3
    SomeIpcomDummyServiceTwoInterface: service-interface=comDummyServiceTwoInterface, service-interface-id=4
      someip event deployment SomeIpaComDummyTwoEvent: event=aComDummyTwoEvent, event-id=32797, transport-protocol=UDP
      someip event group comDummyTwoEventGroup: event-group-id=3, event=SomeIpaComDummyTwoEvent
    SomeIpdummyServiceInterface: service-interface=dummyServiceOneInterface, service-interface-id=1
      someip event deployment SomeIpaDummyEvent: event=OneDummyEvent, event-id=32793, transport-protocol=UDP
      someip method deployment SomeIpaDummyMethod: method=getDummyDataOne, method-id=17, transport-protocol=UDP
      someip event group dummyOneEventGroup: event-group-id=2, event=SomeIpaDummyEvent
    SomeIpdummyServiceThreeInterface: service-interface=dummyServiceThreeInterface, service-interface-id=3
      someip event deployment SomeIpTwoDummyEvent: event=TwoDummyEvent, event-id=32795, transport-protocol=UDP
      someip method deployment SomeIpgetDummyDataTwo: method=getDummyDataTwo, method-id=18, transport-protocol=UDP
      someip event group dummyTwoEventGroup: event-group-id=4, event=SomeIpTwoDummyEvent
    SomeIpdummyServiceTwoInterface: service-interface=dummyServiceTwoInterface, service-interface-id=2
      someip event deployment SomeIpThreeDummyEvent: event=ThreeDummyEvent, event-id=32796, transport-protocol=UDP
      someip method deployment SomeIpsetDummyDataThree: method=setDummyDataThree, method-id=19, transport-protocol=UDP
      someip event group dummyThreeEventGroup: event-group-id=5, event=SomeIpThreeDummyEvent
    SomeIpcomDummyServiceOneInterface: service-interface=comDummyServiceOneInterface, service-interface-id=10
      someip event deployment SomeIpaComDummyEvent: event=aComDummyOneEvent, event-id=32794, transport-protocol=UDP
      someip event group comDummyOneEventGroup: event-group-id=1, event=SomeIpaComDummyEvent
  user defined service interface deployment DiagComApi_Binding: service-interface=DiagComApi
    user defined event deployment DaemonRequestResponse: event=DaemonRequestResponse
    user defined event deployment DiagRequest: event=DiagRequest
    4 x user defined method deployment:
      RequestData: method=RequestData
      Cancel: method=Cancel
      NotifyValue: method=NotifyValue
      NotifyResponse: method=NotifyResponse
package /ServiceInterfaces/TransformationPropsSet
  transformation props set TransformerConfiguration_Package
    ap someip transformation props SOMEIP_8bit: alignment=8, byte-order=little-endian
package /ServiceInterfaces/TransformationPropsToServiceInterfaceMappingSets
  transformation props to service interface element mapping set ServiceInterfaceTransformation
    20 x transformation props to service interface element mapping, all with transformation-props=SOMEIP_8bit:
      Ev_CR_FL_Sens_OutputData_Pr7_ST3TransProps: event=Ev_CR_FL_Sens_OutputData_Pr7_ST3
      Ev_CR_FL_SuppSens_Ifc_Pr6_ST3TransProps: event=Ev_CR_FL_SuppSens_Ifc_Pr6_ST3
      Ev_CR_FR_Sens_OutputData_Pr7_ST3TransProps: event=Ev_CR_FR_Sens_OutputData_Pr7_ST3
      Ev_CR_FR_SuppSens_Ifc_Pr6_ST3TransProps: event=Ev_CR_FR_SuppSens_Ifc_Pr6_ST3
      Ev_CR_RL_Sens_OutputData_Pr7_ST3TransProps: event=Ev_CR_RL_Sens_OutputData_Pr7_ST3
      Ev_CR_RL_SuppSens_Ifc_Pr6_ST3TransProps: event=Ev_CR_RL_SuppSens_Ifc_Pr6_ST3
      Ev_CR_RR_SuppSens_Ifc_Pr6_ST3TransProps: event=Ev_CR_RR_SuppSens_Ifc_Pr6_ST3
      Ev_ECU_Stat_IDC_M_P_ST3TransProps: event=Ev_ECU_Stat_IDC_M_P_ST3
      Ev_MRR_Sens_OutputData_Pr7_ST3TransProps: event=Ev_MRR_Sens_OutputData_Pr7_ST3
      Ev_MRR_SuppSens_Ifc_Pr6_ST3TransProps: event=Ev_MRR_SuppSens_Ifc_Pr6_ST3
      Ev_SI_CR_RR_Sens_OutputData_Pr7_ST3TransProps: event=Ev_SI_CR_RR_Sens_OutputData_Pr7_ST3
      Ev_SI_DI_Odo_Pr5_ST3TransProps: event=Ev_SI_DI_Odo_Pr5_ST3
      Ev_SI_Ign_Stat_Pr5_ST3TransProps: event=Ev_SI_Ign_Stat_Pr5_ST3
      Ev_SI_PN14_TransMd_Stat_ST3TransProps: event=Ev_SI_PN14_Master_stat1_ST3
      Ev_SI_PT4_PTCoor4_Pr5_ST3TransProps: event=Ev_SI_PT4_PTCoor4_Pr5_ST3
      aComDummyTwoEventTransProps: event=aComDummyTwoEvent
      aDummyMethodTransProps: event=OneDummyEvent, method=getDummyDataOne
      getDummyDataTwoTransProps: event=TwoDummyEvent, method=getDummyDataTwo
      setDummyDataThreeTransProps: event=ThreeDummyEvent, method=setDummyDataThree
      aComDummyEventTransProps: event=aComDummyOneEvent
package /SoftwareTypes/Interfaces
  5 x sender receiver interface, all with category=FUNCTIONAL:
    IF_PN14_Master_stat1_ST3: invalidation-policy{data-element=PN14_Master_stat1_ST3, handle-invalid=DONT-INVALIDATE}  # IF_PN14_ProdMd_Stat_ST3 | Powernet production mode state
      data PN14_Master_stat1_ST3: sw-calibration-access=READ-WRITE  # PN14_ProdMd_Stat_ST3 | SHORT: Powernet production mode state LONG: Powernet production mode state
    IG_DI_Odo_Pr5_ST3  # DriverInformation Odometer
      data DI_Odo_Pr5_ST3: sw-calibration-access=READ-WRITE  # SHORT: DriverInformation Odometer LONG: DriverInformation Odometer
    IG_ECU_Stat_IDC_M_P_ST3  # IF_WakeupRsn_IDC_M_P_ST3 | Wakeup reason
      data ECU_Stat_IDC_M_P_ST3: sw-calibration-access=READ-WRITE  # WakeupRsn_IDC_M_P_ST3
    IG_Ign_Stat_Pr5_ST3  # Ignition state
      data Ign_Stat_Pr5_ST3: sw-calibration-access=READ-WRITE  # SHORT: Ignition state LONG: Ignition state
    IG_PT4_PTCoor4_Pr5_ST3  # PT4_PTCoor4_Pr5_ST3
      data PT4_PTCoor4_Pr5_ST3: sw-calibration-access=READ-WRITE  # SHORT: PT4_PTCoor4_Pr5_ST3 LONG: PT4_PTCoor4_Pr5_ST3
package /Topology/Clusters
  ethernet cluster MAIN
    4 x ethernet physical channel, all with category=WIRED:
      MAIN_1
        network endpoint IDC6_MeasurementInterface: network-endpoint-addresses=ipv-4-configuration={ipv-4-address=10.1.17.99, network-mask=255.255.0.0}
        network endpoint NE_Base_ADAS6: network-endpoint-addresses=ipv-4-configuration={ipv-4-address=169.254.18.98, network-mask=255.255.0.0}
        network endpoint SomeIP_SD_NetworkEndpoint: network-endpoint-addresses=ipv-4-configuration={ipv-4-address=239.1.0.2, ipv-4-address-source=FIXED}
        vlan MAIN_1: vlan-identifier=1
      MAIN_127
        pdu triggering ECU_Stat_IDC_M_P_ST3: pdu=ECU_Stat_IDC_M_P_ST3, from IDC_Adpative
        network endpoint NE_Base_ADAS6: network-endpoint-addresses=ipv-4-configuration={ipv-4-address=10.127.17.98, network-mask=255.255.0.0}
        network endpoint SomeIP_SD_NetworkEndpoint_MAIN_127: network-endpoint-addresses=ipv-4-configuration={ipv-4-address=239.127.0.2, ipv-4-address-source=FIXED}
        vlan MAIN_127: vlan-identifier=127
      MAIN_20
        pdu triggering DI_OdoSpeedometer_ST3: pdu=DI_OdoSpeedometer_ST3, to IDC_Adpative
        pdu triggering Ign_Stat_ST3: pdu=Ign_Stat_ST3, to IDC_Adpative
        pdu triggering PN14_Master_stat1_ST3: pdu=PN14_Master_stat1_ST3, to IDC_Adpative
        pdu triggering PT4_PTCoor4_ST3: pdu=PT4_PTCoor4_ST3, to IDC_Adpative
        network endpoint NE_Base_ADAS6: network-endpoint-addresses=ipv-4-configuration={ipv-4-address=10.20.17.98, network-mask=255.255.0.0}
        network endpoint SomeIP_SD_NetworkEndpoint_MAIN_20: network-endpoint-addresses=ipv-4-configuration={ipv-4-address=239.20.0.2, ipv-4-address-source=FIXED}
        vlan MAIN_20: vlan-identifier=20
      MAIN_21
        network endpoint NE_Base_ADAS6: network-endpoint-addresses=ipv-4-configuration={ipv-4-address=10.21.17.98, network-mask=255.255.0.0}
        network endpoint SomeIP_SD_NetworkEndpoint_MAIN_21: network-endpoint-addresses=ipv-4-configuration={ipv-4-address=239.21.0.2, ipv-4-address-source=FIXED}
        network endpoint NE_testBase_ADAS6: network-endpoint-addresses=ipv-4-configuration=ipv-4-address=10.21.17.97
        vlan MAIN_21: vlan-identifier=21
package /Topology/HardwareComponents
  machine design IDC_Adpative: category=EXECUTION_CONTEXT
    ethernet communication connector IDC6_M_P_Logging: category=WIRED, unicast-network-endpoint=IDC6_MeasurementInterface
    ethernet communication connector IDC_M_P_MAIN_1: category=WIRED, unicast-network-endpoint=MAIN_1/NE_Base_ADAS6
    ethernet communication connector IDC_M_P_MAIN_127: category=WIRED, unicast-network-endpoint=MAIN_127/NE_Base_ADAS6
    ethernet communication connector IDC_M_P_MAIN_20: category=WIRED, unicast-network-endpoint=MAIN_20/NE_Base_ADAS6
    ethernet communication connector IDC_M_P_MAIN_21: category=WIRED, unicast-network-endpoint=MAIN_21/NE_Base_ADAS6
    ethernet communication connector EthernetConnector: unicast-network-endpoint=MAIN_21/NE_Base_ADAS6
    service-discover-configs:
      multicast-sd-ip-address=SomeIP_SD_NetworkEndpoint, someip-service-discovery-port=30490
      multicast-sd-ip-address=SomeIP_SD_NetworkEndpoint_MAIN_127, someip-service-discovery-port=30490
      multicast-sd-ip-address=SomeIP_SD_NetworkEndpoint_MAIN_20, someip-service-discovery-port=30490
      multicast-sd-ip-address=SomeIP_SD_NetworkEndpoint_MAIN_21, someip-service-discovery-port=30490
  machine design NDAS: category=EXECUTION_CONTEXT, service-discover-configs=someip-service-discovery={multicast-sd-ip-address=SomeIP_SD_NetworkEndpoint_MAIN_21, someip-service-discovery-port=30490}
    ethernet communication connector testBase_ADAS6: category=WIRED, unicast-network-endpoint=NE_testBase_ADAS6
package /ara/diag
  adaptive application sw component type DiagnosticManagerSwc
    provide/require port Persistency: provided-required-interface=PersistencyInterface
    require port DiagComApiDeamonPort: required-interface=DiagComApi
package /amsr/diag
  service interface DiagComApi
    namespaces:
      4 x symbol props:
        amsr
        diag
        service_interfaces
        diag_com_api
    events:
      data DaemonRequestResponse: type=DaemonRequestResponseType
      data DiagRequest: type=DiagRequestType
    methods:
      4 x operation, all with fire-and-forget=true:
        RequestData
          6 x arg, all with direction=IN:
            handle: type=HandleType
            instance_handle: type=InstanceHandle
            job_identifier: type=JobIdentifier
            meta_info: type=MetaInfoType
            request_data: type=ByteVectorType
            conversation_handle: type=ConversationHandle
        Cancel
          arg job_identifier: type=JobIdentifier, direction=IN
        NotifyValue
          4 x arg, all with direction=IN:
            handle: type=HandleType
            instance_handle: type=InstanceHandle
            conversation_handle: type=ConversationHandle
            byte_vector: type=ByteVectorType
        NotifyResponse
          arg response_type: type=HandleType, direction=IN
          arg job_identifier: type=JobIdentifier, direction=IN
          arg byte_vector: type=ByteVectorType, direction=IN
package /SoftwareDistribution/SoftwareCluster
  software cluster SoftwareClusterPlatform: contained-process=[SelfDiagnosticAgent, BaseApplication, DiagnosticManagerDeamon], design=temporarySoftwareClusterDesignPer, diagnostic-extract=DcmContributionSet, vendor-id=4660, version=1.0.0.0000
    diagnostic-addresss:
      address-semantics=PHYSICAL-ADDRESS, diagnostic-address=1
      address-semantics=FUNCTIONAL-ADDRESS, diagnostic-address=2
      address-semantics=FUNCTIONAL-ADDRESS, diagnostic-address=3
package /SoftwareDistribution/SoftwarePackage
  software package SoftwarePackagePlatform: software-cluster=SoftwareClusterPlatform
package /SoftwareDistribution/SoftwareClusterDesign
  software cluster design temporarySoftwareClusterDesignPer: contained-process=[DiagnosticManagerDeamonDesign, SelfDiagnosticAgentDesign, BaseApplicationProcessDesign], intended-target-machine=IDC_Adpative
