AUTOSAR XML (schema 00047)
package /vector
  machine LogMachine: machine-design=LogMachineDesign
    function-groups:
      mode declaration group prototype MachineState: type=MachineStates
    module-instantiations:
      log and trace instantiation LogAndTraceInstantiation
        ethernet network configuration EthernetNetworkConfiguration: communication-connector=EthernetConnector, tcp-port=49361
  machine design LogMachineDesign
    ethernet communication connector EthernetConnector: unicast-network-endpoint=NetworkEndpointLogd
  ethernet cluster Ethernet
    ethernet physical channel EthernetChannel1
      network endpoint NetworkEndpoint: network-endpoint-addresses=ipv-4-configuration={ipv-4-address=192.168.7.2, ipv-4-address-source=FIXED, ttl=5}
      network endpoint NetworkEndpointLogd: network-endpoint-addresses=ipv-4-configuration={ipv-4-address=10.21.17.98, ipv-4-address-source=FIXED, ttl=5}
      network endpoint SdMulticastEndpoint: network-endpoint-addresses=ipv-4-configuration=ipv-4-address=224.0.0.17
  mode declaration group MachineStates: initial-mode=MachineStates/Running
    5 x mode:
      Running: value=0
      Startup: value=1
      Shutdown: value=2
      Restart: value=3
      Off: value=4
  mode declaration group ApplicationStates
    mode Running: value=0
    mode Terminating: value=1
