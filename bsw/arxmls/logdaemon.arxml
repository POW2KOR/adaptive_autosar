AUTOSAR XML (schema 00047)
package /vector/bsw
  adaptive application sw component type amsr_vector_fs_log_daemon_swc
  executable amsr_vector_fs_log_daemon: category=PLATFORM_LEVEL
    root sw component prototype amsr_vector_fs_log_daemon_root_type
  process LogDaemonDefaultProcess: executable=amsr_vector_fs_log_daemon, log-trace-default-log-level=INFO, log-trace-log-mode=CONSOLE, log-trace-process-desc=Vector Log Daemon, log-trace-process-id=LOGD, state-dependent-startup-config{function-group-state=[MachineState.Startup, MachineState.Shutdown, MachineState.Restart, MachineState.Running], startup-config=StartupRunning}
    process state machine amsr_vector_fs_log_daemon_process_mode: type=ApplicationSatates
  process to machine mapping set LogProcessToMachineMapping
    process to machine mapping LogProcToMachineMapping: machine=LogMachine, non-os-module-instantiation=LogAndTraceInstantiation, process=LogDaemonDefaultProcess
  startup config set log_daemon_startup_config
    startup config StartupRunning: scheduling-policy=SCHEDULING-POLICY-FIFO, scheduling-priority=80, startup-option{option-argument=./etc/logging_config.json, option-kind=COMMAND-LINE-SHORT-FORM, option-name=l}
