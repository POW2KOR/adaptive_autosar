AUTOSAR XML (schema 00047)
package /vector/example
  adaptive application sw component type EmExample
  executable amsr_vector_fs_em_executionmanager_demo_application: category=APPLICATION_LEVEL
    root sw component prototype EmExampleRootSwc: application-type=EmExample
