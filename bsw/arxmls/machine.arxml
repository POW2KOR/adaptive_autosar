AUTOSAR XML (schema 00047)
package /mbition
  ethernet cluster mbition-example-ethernet-cluster
    ethernet physical channel mbition-example-physical-channel
      network endpoint mbition-example-network-endpoint: network-endpoint-addresses=ipv-4-configuration={ipv-4-address=10.20.1.97, ipv-4-address-source=FIXED, ttl=5}
      network endpoint mbition-example-sd-network-endpoint: network-endpoint-addresses=ipv-4-configuration=ipv-4-address=239.20.0.2
  machine design machine-design: service-discover-configs=someip-service-discovery={multicast-sd-ip-address=mbition-example-sd-network-endpoint, someip-service-discovery-port=30490}
    ethernet communication connector mbition-example-ethernet-connector: unicast-network-endpoint=mbition-example-network-endpoint
  mode declaration group MachineStates: initial-mode=Startup
    5 x mode:
      Running: value=0
      Startup: value=1
      Shutdown: value=2
      Restart: value=3
      Off: value=4
  mode declaration group ApplicationStates: initial-mode=Terminating
    mode Running: value=0
    mode Terminating: value=1
  machine example-machine: machine-design=machine-design
    function-groups:
      mode declaration group prototype application-mode-declaration-group-prototype: type=ApplicationStates
      mode declaration group prototype MachineState: type=MachineStates
    os module instantiation mbition-os-mod-instantiation
    generic module instantiation generic-mod-instantiation
    processor processor
      processor core core
