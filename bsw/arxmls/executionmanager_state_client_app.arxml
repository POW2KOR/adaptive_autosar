AUTOSAR XML (schema 00047)
package /mb/platform
  adaptive application sw component type executionmanager_state_client_app_sw_component_type
  executable executionmanager_state_client_app: category=APPLICATION_LEVEL
    root sw component prototype execution_manager_addon_root_swc: application-type=executionmanager_state_client_app_sw_component_type
