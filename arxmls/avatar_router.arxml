AUTOSAR XML (schema 00047)
package /mb/Design
  adaptive application sw component type AvatarRouterSample
  executable avatar_router: category=APPLICATION_LEVEL
    root sw component prototype AvatarRouterSampleRootSwc: application-type=AvatarRouterSample
package /mb/Deployment
  process avatar_router: executable=avatar_router, state-dependent-startup-config{function-group-state=MachineState.Running, startup-config=STARTUP_CONFIG_DEFAULT}
  process to machine mapping set MbAppsToMachineMapping
    process to machine mapping AvatarRouterToMachineMapping: machine=IDC6_M_P1_XAVIER, process=avatar_router
