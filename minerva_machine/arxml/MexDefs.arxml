AUTOSAR XML (schema 00047)
package /MICROSAR/ADAPTIVE
  sdg def StartupModelExtension
    sdg-classes:
      sdg class UserGroups: gid=DvMex:UserGroups, extends-meta-class=StartupConfig
        sdg primitive attribute userId: category=INTEGER, lower-multiplicity=0, upper-multiplicity=1, gid=DvMex:userId, max=2147483647, min=0
        sdg primitive attribute primaryGroupId: category=INTEGER, lower-multiplicity=0, upper-multiplicity=1, gid=DvMex:primaryGroupId, max=2147483647, min=0
        sdg primitive attribute secondaryGroupIds: category=INTEGER, lower-multiplicity=0, upper-multiplicity-infinite=true, gid=DvMex:secondaryGroupIds, max=2147483647, min=0
  sdg def ExecResourceGroupModelExtension
    sdg-classes:
      sdg class CGroup: gid=DvMex:CGroup, extends-meta-class=ResourceGroup
        sdg primitive attribute cgroupPath: category=STRING, lower-multiplicity=0, upper-multiplicity=1, gid=DvMex:cgroupPath
